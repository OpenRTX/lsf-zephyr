## CMakeLists.txt
```
# SPDX-License-Identifier: Apache-2.0

cmake_minimum_required(VERSION 3.20.0)
find_package(Zephyr REQUIRED HINTS $ENV{ZEPHYR_BASE})
project(wifi_mgr_test)

target_include_directories(app PRIVATE ../../include/wifi_manager)
FILE(GLOB app_sources src/*.c)
target_sources(app PRIVATE ${app_sources})
```

## Kconfig
```
# SPDX-License-Identifier: Apache-2.0

menu "Example Configuration"

    config CORRECT_WIFI_SSID
        string "WiFi SSID"
        default "xiaowei-yyds"

    config CORRECT_WIFI_PASSWORD
        string "WiFi password"
        default "xiaowei-yyds"

    config WRONG_WIFI_SSID
        string "WiFi SSID"
        default "not_exist"

    config WRONG_WIFI_PASSWORD
        string "WiFi password"
        default "111111111"
endmenu

source "Kconfig.zephyr"
```

## prj.conf
```kconfig
CONFIG_WIFI=y
CONFIG_CSK_WIFI_STATION=y
CONFIG_WIFI_MANAGER=y
CONFIG_NET_L2_ETHERNET=y
CONFIG_REBOOT=y

CONFIG_LOG=y
CONFIG_WIFI_LOG_LEVEL_ERR=y
CONFIG_WIFI_MANAGER_LOG_LEVEL_ERR=y

CONFIG_NEWLIB_LIBC=y
CONFIG_NEWLIB_LIBC_NANO=n

CONFIG_NETWORKING=y
CONFIG_NET_DHCPV4=y
CONFIG_NET_IPV4=y
CONFIG_NET_SOCKETS=y
CONFIG_NET_SOCKETS_POSIX_NAMES=y

CONFIG_NET_MGMT=y
CONFIG_NET_MGMT_EVENT=y
CONFIG_NET_MGMT_EVENT_STACK_SIZE=4096

CONFIG_NET_RX_STACK_SIZE=15360
CONFIG_NET_TX_STACK_SIZE=15360
CONFIG_NET_PKT_RX_COUNT=16
CONFIG_NET_PKT_TX_COUNT=16
CONFIG_NET_BUF_RX_COUNT=64
CONFIG_NET_BUF_TX_COUNT=64
CONFIG_NET_CONTEXT_NET_PKT_POOL=y

CONFIG_HEAP_MEM_POOL_SIZE=102400
CONFIG_SYSTEM_WORKQUEUE_STACK_SIZE=5120
CONFIG_SYSTEM_WORKQUEUE_PRIORITY=-1
CONFIG_MAIN_STACK_SIZE=10240
CONFIG_TEST_RANDOM_GENERATOR=y
CONFIG_INIT_STACKS=y
CONFIG_MAX_SCAN_APS_NUM=50

CONFIG_ZTEST=y
CONFIG_SYS_HEAP_RUNTIME_STATS=y
```

## src/main.c
```c
#include <logging/log.h>
#include <stdbool.h>
#include <zephyr.h>
#include <ztest.h>

#include "kernel.h"
#include "sys_clock.h"
#include "tc_util.h"
#include "wifi_manager/wifi_manager.h"
#include "ztest_assert.h"
#include "ztest_test.h"
LOG_MODULE_REGISTER(lib_wif_mgr_test, LOG_LEVEL_DBG);

extern void test_lib_wifi_mgr_enable_connect_cb(void);
extern void test_lib_wifi_mgr_disable_connect_cb(void);
extern wifi_mgr_connection_status_t
test_lib_wifi_mgr_get_sta_connect_status(k_timeout_t wait_time_ms);
extern wifi_mgr_connection_status_t
test_lib_wifi_mgr_get_sta_connect_status_while_no_register_callback(int timeout_seconds);
extern void test_wifi_mgr_storage_save_ap_assert(wifi_mgr_sta_config_t *sta_config);
extern void test_lib_wifi_mgr_sta_disable_and_call_api_then_enable(void);
extern void test_lib_wifi_mgr_auto_connect_then_disable_finally_enable(void);
extern void test_wifi_mgr_storage_delete_all_ap(void);
extern void test_lib_wifi_mgr_force_save_ap(void);
extern int test_lib_wifi_mgr_sta_get_connected_info(wifi_mgr_sta_config_t *got_sta_info);
extern void test_wifi_mgr_storage_save_ap_force(wifi_mgr_sta_config_t *in_sta_config);
extern void wifi_auto_connect_start_assert(int interval_ms);
extern void wifi_auto_connect_stop_assert();
extern void test_lib_wifi_mgr_clear_connect_status(void);
extern void test_lib_wifi_mgr_is_connecting_assert(k_timeout_t timeout);
extern void test_lib_wifi_mgr_is_disconnected_assert(k_timeout_t timeout);
extern int test_lib_wifi_mgr_connection_failed_assert(k_timeout_t timeout);

void test_lib_wifi_mgr_auto_connect_to_ap_with_correct_ssid_and_pwd_then_disable_finally_enable(
	void);

static wifi_mgr_sta_config_t correct_sta_config = {
	.ssid = CONFIG_CORRECT_WIFI_SSID,
	.pwd = CONFIG_CORRECT_WIFI_PASSWORD,
	.encryption_mode = CSK_WIFI_AUTH_WPA2_PSK,
};

static wifi_mgr_sta_config_t correct_ssid_wrong_pwd_sta_config = {
	.ssid = CONFIG_CORRECT_WIFI_SSID,
	.pwd = CONFIG_WRONG_WIFI_PASSWORD,
	.encryption_mode = CSK_WIFI_AUTH_WPA2_PSK,
};

static wifi_mgr_sta_config_t wrong_sta_config = {
	.ssid = CONFIG_WRONG_WIFI_SSID,
	.pwd = CONFIG_WRONG_WIFI_PASSWORD,
	.encryption_mode = CSK_WIFI_AUTH_WPA2_PSK,
};

K_SEM_DEFINE(async_scan_done, 0, 1);
K_QUEUE_DEFINE(scan_memory_leak);

#define CONTINUE_MEMORY_LEAK_TIMES 5

extern struct heap_t _system_heap;

static struct sys_heap_runtime_stats last_stat = { 0 };
static int memory_leak_count = 0;
static int memory_leaked_sum = 0;

static void wifi_disconnect_assert(void)
{
	int ret = 0;
	wifi_mgr_connection_status_t sta_status = 0;

	ret = wifi_mgr_sta_disconnect(false);
	zassert_equal(ret, 0, "disconnect failed");
	if (IS_ENABLED(CONFIG_CSK_WIFI_XR819S)) {
		ret = wifi_mgr_sta_disconnect(false);
		zassert_not_equal(ret, 0, "disconnect shouldn't retrun 0 if device has disconnected before. ret: %d", ret);
	}
	sta_status = wifi_mgr_sta_get_status();
	zassert_equal(sta_status, WIFI_MGR_STA_DISCONNECTED, "disconnect failed, actual status: %d",
		      sta_status);
}

static bool check_memory_leak(void)
{
	bool ret = false;

	if (last_stat.free_bytes == 0 && last_stat.allocated_bytes == 0) {
		sys_heap_runtime_stats_get((struct sys_heap *)(&_system_heap), &last_stat);
		ret = false;
	} else {
		struct sys_heap_runtime_stats stat;
		sys_heap_runtime_stats_get((struct sys_heap *)(&_system_heap), &stat);
		if (stat.free_bytes < last_stat.free_bytes) {
			ret = true;
		} else {
			ret = false;
		}
		memory_leaked_sum += (last_stat.free_bytes - stat.free_bytes);
		last_stat.allocated_bytes = stat.allocated_bytes;
		last_stat.free_bytes = stat.free_bytes;
	}
	return ret;
}

static inline int get_memory_leaked_num(void)
{
	return memory_leaked_sum;
}

static void memleak_check_scandone_cb(wifi_mgr_scan_info_t *aps_info, int ap_num, void *arg)
{
	if (check_memory_leak()) {
		memory_leak_count++;
		if (memory_leak_count >= CONTINUE_MEMORY_LEAK_TIMES) {
			int memory_leaked = get_memory_leaked_num();
			k_queue_append(&scan_memory_leak, &memory_leaked);
		}
	} else {
		LOG_DBG("reset memory leak count");
		memory_leak_count = 0;
	}
}

static void async_scan_done_cb(wifi_mgr_scan_info_t *aps_info, int ap_num, void *arg)
{
	if (ap_num > 0) {
		k_sem_give(&async_scan_done);
	}
}

void test_lib_wifi_mgr_setup(void)
{
	int ret;

	ret = wifi_mgr_init();
	zassert_equal(ret, 0, "wifi mgr init failed, ret: %d", ret);

	test_wifi_mgr_storage_delete_all_ap();

	test_lib_wifi_mgr_enable_connect_cb();
}

static void get_connected_info_assert(wifi_mgr_sta_config_t *expect_sta_info)
{
	zassert_true((expect_sta_info != NULL), "expect_sta_info cannot be NULL\n");

	int ret = 0;
	wifi_mgr_sta_config_t got_sta_info = { 0 };

	ret = test_lib_wifi_mgr_sta_get_connected_info(&got_sta_info);
	zassert_equal(ret, 0, "get connected info failed, ret: %d \n", ret);

	zassert_mem_equal(got_sta_info.ssid, expect_sta_info->ssid, sizeof(correct_sta_config.ssid),
			  "connected ssid are different to target one\n");
}

void test_lib_wifi_mgr_async_connect_then_async_disconnect(void)
{
	int ret = 0;
	wifi_mgr_connection_status_t connect_status = WIFI_MGR_STA_MAX;

	test_lib_wifi_mgr_clear_connect_status();
	ret = wifi_mgr_sta_connect(&correct_sta_config, true);
	zassert_equal(ret, 0, "wifi connect failed, ret: %d", ret);

	test_lib_wifi_mgr_is_connecting_assert(K_SECONDS(3));

	connect_status = test_lib_wifi_mgr_get_sta_connect_status(K_MSEC(10 * 1000));
	zassert_equal(connect_status, WIFI_MGR_STA_CONNECTED, "Failed to connect target wifi");

	get_connected_info_assert(&correct_sta_config);

	wifi_mgr_sta_disconnect(true);

	test_lib_wifi_mgr_is_disconnected_assert(K_SECONDS(5));
}

void test_lib_wifi_mgr_async_scan_and_auto_connect_then_disconnect(void)
{
	int ret = 0;
	wifi_mgr_connection_status_t connect_status = WIFI_MGR_STA_MAX;

	ret = wifi_mgr_add_scan_done_cb(async_scan_done_cb, NULL);
	zassert_equal(ret, 0, "add async scan done callback failed, ret: %d", ret);

	ret = wifi_mgr_scan_ap(NULL, true);
	zassert_equal(ret, 0, "async scan ap failed, ret: %d", ret);

	ret = k_sem_take(&async_scan_done, K_MSEC(3000));
	zassert_equal(ret, 0, "There are no async scan done event occur, ret: %d", ret);

	wifi_mgr_storage_save_ap_force(&correct_sta_config);

	wifi_auto_connect_start_assert(3000);

	connect_status = test_lib_wifi_mgr_get_sta_connect_status(K_MSEC(10 * 1000));
	zassert_equal(connect_status, WIFI_MGR_STA_CONNECTED,
		      "Failed to connect target wifi, connect_status: %d \n", connect_status);
	wifi_mgr_storage_delete_ap(&correct_sta_config);
	wifi_disconnect_assert();
	wifi_auto_connect_stop_assert();
}

void test_lib_wifi_mgr_sta_connect_with_correct_ssid_and_pwd_then_disconnect(void)
{
	int ret = 0;

	ret = wifi_mgr_sta_connect(&correct_sta_config, false);
	zassert_equal(ret, 0, "wifi connect failed, ret: %d", ret);

	get_connected_info_assert(&correct_sta_config);

	wifi_disconnect_assert();
}

void test_lib_wifi_mgr_sta_connect_with_correct_ssid_but_wrong_pwd(void)
{
	int ret = 0;
	int reason = 0;

	ret = wifi_mgr_sta_connect(&correct_ssid_wrong_pwd_sta_config, false);
	reason = test_lib_wifi_mgr_connection_failed_assert(K_MSEC(1000));
	zassert_not_equal(ret, 0, "wifi shouldn't connect success, ret: %d", ret);
	zassert_true(reason < 0, "Connection failed, reason: %d", reason);
	if (ret == 0) {
		wifi_mgr_sta_disconnect(false);
	}

}

void test_lib_wifi_mgr_auto_connect_to_ap_with_correct_ssid_and_pwd_then_disable_finally_enable(void)
{
	int ret = 0;
	wifi_mgr_connection_status_t sta_status = 0;

	wifi_mgr_connection_status_t connect_status = WIFI_MGR_STA_MAX;

	test_wifi_mgr_storage_delete_all_ap();
	test_wifi_mgr_storage_save_ap_assert(&correct_sta_config);

	test_wifi_mgr_storage_save_ap_force(&correct_sta_config);

	wifi_auto_connect_start_assert(1000);

	connect_status = test_lib_wifi_mgr_get_sta_connect_status(K_MSEC(10 * 1000));
	zassert_equal(connect_status, WIFI_MGR_STA_CONNECTED,
		      "Failed to connect target wifi, connect_status: %d \n", connect_status);

	/* Disonnect device manually */
	wifi_disconnect_assert();

	/* Make sure WiFi manager will reconnect to device automatically */
	connect_status = test_lib_wifi_mgr_get_sta_connect_status(K_MSEC(10 * 1000));
	zassert_equal(connect_status, WIFI_MGR_STA_CONNECTED,
		      "Failed to reconnect target wifi, connect_status: %d \n", connect_status);

	/* Disonnect device manually */
	wifi_disconnect_assert();
	wifi_mgr_auto_connect_stop();

	wifi_mgr_storage_delete_ap(&correct_sta_config);

	ret = wifi_mgr_sta_disable();
	zassert_equal(ret, 0, "wifi_mgr_sta_disable failed, ret: %d", ret);

	sta_status = wifi_mgr_sta_get_status();
	zassert_equal(sta_status, WIFI_MGR_STA_DISCONNECTED, "disconnect failed, actual status: %d",
		      sta_status);
	wifi_auto_connect_stop_assert();

	ret = wifi_mgr_sta_enable();
	zassert_equal(ret, 0, "wifi_mgr_sta_enable failed, ret: %d", ret);
}

void test_lib_wifi_mgr_auto_connect_to_ap_without_callback_then_disconnect_and_wait_reconnect_finally_disconnect(
	void)
{
	wifi_mgr_connection_status_t connect_status = WIFI_MGR_STA_MAX;

	/* Remove connection callback */
	test_lib_wifi_mgr_disable_connect_cb();

	test_wifi_mgr_storage_delete_all_ap();

	test_wifi_mgr_storage_save_ap_assert(&correct_sta_config);

	test_wifi_mgr_storage_save_ap_force(&correct_sta_config);

	wifi_auto_connect_start_assert(1000);

	TC_PRINT("%s: %u \n", __FUNCTION__, __LINE__);

	connect_status = test_lib_wifi_mgr_get_sta_connect_status_while_no_register_callback(10);
	zassert_equal(connect_status, WIFI_MGR_STA_CONNECTED,
		      "Failed to connect target wifi, connect_status: %d \n", connect_status);

	TC_PRINT("%s: %u \n", __FUNCTION__, __LINE__);

	/* Disonnect device manually */
	wifi_disconnect_assert();

	/* Make sure WiFi manager will reconnect to device automatically */
	connect_status = test_lib_wifi_mgr_get_sta_connect_status_while_no_register_callback(10);
	zassert_equal(connect_status, WIFI_MGR_STA_CONNECTED,
		      "Failed to reconnect target wifi, connect_status: %d \n", connect_status);

	wifi_mgr_storage_delete_ap(&correct_sta_config);
	wifi_auto_connect_stop_assert();
	wifi_disconnect_assert();

	test_lib_wifi_mgr_enable_connect_cb();
}

void test_lib_wifi_mgr_auto_connect_then_scan_finally_stop_auto_connect(void)
{
	int ret = 0;
	wifi_mgr_connection_status_t connect_status = WIFI_MGR_STA_MAX;
	test_wifi_mgr_storage_save_ap_assert(&correct_sta_config);
	wifi_mgr_connection_status_t sta_status = WIFI_MGR_STA_MAX;

	test_wifi_mgr_storage_save_ap_force(&correct_sta_config);

	wifi_auto_connect_start_assert(1000);

	connect_status = test_lib_wifi_mgr_get_sta_connect_status(K_MSEC(10 * 1000));
	zassert_equal(connect_status, WIFI_MGR_STA_CONNECTED,
		      "Failed to connect target wifi, connect_status: %d \n", connect_status);
	
	wifi_auto_connect_stop_assert();

	ret = wifi_mgr_scan_ap(NULL, false);
	zassert_true(ret > 0, "scan ap failed, ret: %d", ret);

	sta_status = wifi_mgr_sta_get_status();
	zassert_equal(sta_status, WIFI_MGR_STA_CONNECTED, "wifi_mgr_sta_get_status, actual status: %d",
		      sta_status);

	/* Disonnect device manually */
	wifi_disconnect_assert();

	/* Make sure WiFi manager will not reconnect to device automatically */
	connect_status = test_lib_wifi_mgr_get_sta_connect_status(K_MSEC(10 * 1000));
	zassert_not_equal(connect_status, WIFI_MGR_STA_CONNECTED,
		      "shoudn't connect success, connect_status: %d \n", connect_status);
	
	//wifi_mgr_storage_delete_ap(&correct_sta_config);	
	test_wifi_mgr_storage_delete_all_ap();	  

}


void test_lib_wifi_mgr_enable_auto_connect_on_connected_status_finally_disconnect(void) 
{
	int ret = 0;
	wifi_mgr_connection_status_t connect_status = WIFI_MGR_STA_MAX;

	ret = wifi_mgr_sta_connect(&correct_sta_config, false);
	zassert_equal(ret, 0, "wifi connect failed, ret: %d", ret);

	get_connected_info_assert(&correct_sta_config);
	test_wifi_mgr_storage_save_ap_force(&correct_sta_config);

	wifi_auto_connect_start_assert(1000);

	/* Disonnect device manually */
	wifi_disconnect_assert();

	/* Make sure WiFi manager will reconnect to device automatically */
	connect_status = test_lib_wifi_mgr_get_sta_connect_status(K_MSEC(10 * 1000));
	zassert_equal(connect_status, WIFI_MGR_STA_CONNECTED,
		      "Failed to reconnect target wifi, connect_status: %d \n", connect_status);

	wifi_auto_connect_stop_assert();
	wifi_mgr_storage_delete_ap(&wrong_sta_config);

	wifi_disconnect_assert();
}

void test_lib_wifi_mgr_auto_connect_to_ap_with_wrong_ssid_and_pwd(void)
{
	wifi_mgr_connection_status_t connect_status = WIFI_MGR_STA_MAX;

	test_wifi_mgr_storage_save_ap_assert(&wrong_sta_config);

	wifi_auto_connect_start_assert(3000);

	TC_PRINT("Found ssid in NVS storage, ssid: %s, password: %s \n", wrong_sta_config.ssid,
		 wrong_sta_config.pwd);

	connect_status = test_lib_wifi_mgr_get_sta_connect_status(K_MSEC(1000));
	zassert_not_equal(connect_status, WIFI_MGR_STA_CONNECTED, "Failed to connect target wifi, connect_status: %d", connect_status);

	wifi_mgr_storage_delete_ap(&wrong_sta_config);

	wifi_auto_connect_stop_assert();
}

void test_lib_wifi_mgr_check_memory_leak_for_scan(void)
{
	void *queue_get_data = NULL;
	int interval_ms = 100;

	test_wifi_mgr_storage_save_ap_assert(&wrong_sta_config);

	wifi_mgr_add_scan_done_cb(memleak_check_scandone_cb, NULL);

	wifi_auto_connect_start_assert(interval_ms);

	queue_get_data = k_queue_get(&scan_memory_leak, K_SECONDS(5));

	wifi_mgr_remove_scan_done_cb(memleak_check_scandone_cb);
	wifi_auto_connect_stop_assert();

	zassert_equal(queue_get_data, NULL, "It shouldn't memory leak, memory_leaked_sum: %d",
		      *((int *)(queue_get_data)));
}


static void test_lib_wifi_mgr_teardown(void)
{
	k_sleep(K_SECONDS(2));
	test_lib_wifi_mgr_disable_connect_cb();
}


void test_lib_wifi_mgr_storage_api(void)
{
	test_wifi_mgr_storage_delete_all_ap();
	test_wifi_mgr_storage_save_ap_force(&correct_sta_config);
}

void test_main(void)
{
	ztest_test_suite(
		lib_wifi_mgr_test,
		ztest_unit_test(test_lib_wifi_mgr_setup),
		ztest_unit_test(test_lib_wifi_mgr_storage_api),
		ztest_unit_test(test_lib_wifi_mgr_async_scan_and_auto_connect_then_disconnect),
		ztest_unit_test(test_lib_wifi_mgr_async_connect_then_async_disconnect),
		ztest_unit_test(
			test_lib_wifi_mgr_sta_connect_with_correct_ssid_and_pwd_then_disconnect),
		ztest_unit_test(
			test_lib_wifi_mgr_sta_connect_with_correct_ssid_but_wrong_pwd),
		ztest_unit_test(
			test_lib_wifi_mgr_auto_connect_to_ap_with_correct_ssid_and_pwd_then_disable_finally_enable),
		ztest_unit_test(
			test_lib_wifi_mgr_auto_connect_to_ap_without_callback_then_disconnect_and_wait_reconnect_finally_disconnect),
		ztest_unit_test(test_lib_wifi_mgr_auto_connect_then_scan_finally_stop_auto_connect),
		ztest_unit_test(test_lib_wifi_mgr_auto_connect_to_ap_with_wrong_ssid_and_pwd),
		ztest_unit_test(test_lib_wifi_mgr_enable_auto_connect_on_connected_status_finally_disconnect),
		ztest_unit_test(test_lib_wifi_mgr_auto_connect_then_disable_finally_enable),
		ztest_unit_test(test_lib_wifi_mgr_sta_disable_and_call_api_then_enable),
		ztest_unit_test(test_lib_wifi_mgr_check_memory_leak_for_scan),
		ztest_unit_test(test_lib_wifi_mgr_teardown));
	ztest_run_test_suite(lib_wifi_mgr_test);
}
```

## src/test_wifi_mgr_control.c
```c
#include <stdbool.h>
#include <stdint.h>
#include <zephyr.h>
#include <ztest.h>

#include "kernel.h"
#include "sys_clock.h"
#include "tc_util.h"
#include "wifi_manager/wifi_manager.h"
#include "ztest_assert.h"

extern void test_wifi_mgr_storage_save_ap_assert(wifi_mgr_sta_config_t *sta_config);


#define TEST_WIFI_MGR_COMMON_QUEUE_WAIT_TIMEOUT    (K_MSEC(500))

K_MSGQ_DEFINE(connected, 4, 1, 1);
K_SEM_DEFINE(connecting, 0, 1);
K_MSGQ_DEFINE(disconnected, 4 ,1, 1);

static wifi_mgr_sta_config_t correct_sta_config = {
	.ssid = CONFIG_CORRECT_WIFI_SSID,
	.pwd = CONFIG_CORRECT_WIFI_PASSWORD,
	.encryption_mode = CSK_WIFI_AUTH_WPA2_PSK,
};


void test_lib_wifi_mgr_clear_connect_status(void)
{
	k_msgq_purge(&connected);
}

static void connection_cb(wifi_mgr_connection_info_t *connection_info, void *arg)
{
	int ret = 0;

	// TC_PRINT("fun: %s, connection_info->status: %d \n", __FUNCTION__, connection_info->status);
	switch (connection_info->status) {
	case WIFI_MGR_STA_DISCONNECTED:
		do {
			ret = k_msgq_put(&disconnected, &(connection_info->reason), K_SECONDS(2));
			if (ret != 0) {
				k_msgq_purge(&disconnected);
			}
		} while (ret != 0);
		break;
	case WIFI_MGR_STA_CONNECTING:
		k_sem_give(&connecting);
		break;
	case WIFI_MGR_STA_CONNECTED:
		do {
			ret = k_msgq_put(&connected, &(connection_info->status), K_SECONDS(1));
			if (ret != 0) {
				k_msgq_purge(&connected);
			}
		} while (ret != 0);
		break;
	default:
		break;
	}

}
void test_lib_wifi_mgr_enable_connect_cb(void)
{
	int ret = 0;

	ret = wifi_mgr_sta_add_connection_cb(connection_cb, NULL);
	zassert_equal(ret, 0, "add connected_callback_failed");
}

void test_lib_wifi_mgr_disable_connect_cb(void)
{
	int ret = 0;
	
	ret = wifi_mgr_sta_remove_connection_cb(connection_cb);
}

int test_lib_wifi_mgr_sta_get_connected_info(wifi_mgr_sta_config_t *got_sta_info)
{
	int ret = 0;

	ret = wifi_mgr_sta_get_connected_info(got_sta_info);
	zassert_equal(ret, 0, "get connected info failed , ret: %d", ret);

	return ret;

}

void wifi_auto_connect_start_assert(int interval_ms)
{
	int ret = 0;
	wifi_mgr_autoconn_config_t autoconn_conf = {
		.interval_ms = interval_ms,
	};

	test_lib_wifi_mgr_clear_connect_status();
	ret = wifi_mgr_auto_connect_start(&autoconn_conf);
	zassert_equal(ret, 0, "auto connect start failed, ret: %d", ret);
}

void wifi_auto_connect_stop_assert()
{
	int ret = 0;

	ret = wifi_mgr_auto_connect_stop();
	zassert_equal(ret, 0, "auto connect stop failed, ret: %d", ret);
}

void test_lib_wifi_mgr_is_connecting_assert(k_timeout_t timeout)
{
	int ret = 0;

	k_sem_reset(&connecting);
	ret = k_sem_take(&connecting, timeout);
	zassert_equal(ret, 0, "get connecting event failed, ret: %d", ret);
}

void test_lib_wifi_mgr_is_disconnected_assert(k_timeout_t timeout)
{
	int ret = 0;
	int reason = 0;

	k_msgq_purge(&disconnected);
	ret = k_msgq_get(&disconnected, &reason, timeout);
	zassert_equal(ret, 0, "get disconnected event failed, ret: %d", ret);
}

int test_lib_wifi_mgr_connection_failed_assert(k_timeout_t timeout)
{
	int ret = 0;
	int reason = 0;

	ret = k_msgq_get(&disconnected, &reason, timeout);
	zassert_equal(ret, 0, "get connection failed event failed, ret: %d", ret);
	
	return reason;
}

wifi_mgr_connection_status_t test_lib_wifi_mgr_get_sta_connect_status_while_no_register_callback(int timeout_seconds)
{
	int cur_wait_time = 0;
	wifi_mgr_connection_status_t connect_status = WIFI_MGR_STA_MAX;

	do {
		if (cur_wait_time >= timeout_seconds) {
			break;
		}
		k_sleep(K_SECONDS(1));
		cur_wait_time++;
		connect_status = wifi_mgr_sta_get_status();
	} while (connect_status != WIFI_MGR_STA_CONNECTED);

	return connect_status;
}

wifi_mgr_connection_status_t test_lib_wifi_mgr_get_sta_connect_status(k_timeout_t wait_time_ms)
{
	int ret = 0;

	wifi_mgr_connection_status_t ret_status = WIFI_MGR_STA_MAX;
	wifi_mgr_connection_status_t queue_get_data = WIFI_MGR_STA_MAX;

	ret = k_msgq_get(&connected, &queue_get_data, wait_time_ms);
	if (ret == 0) {
		ret_status = queue_get_data;
	}

	return ret_status;
}

static void test_lib_wifi_mgr_sta_disable_and_check(void)
{
	int ret = 0;

	ret = wifi_mgr_sta_disable();
	zassert_equal(ret, 0, "wifi_mgr_sta_disable ret: %d", ret);
	test_wifi_mgr_storage_save_ap_assert(&correct_sta_config);

	wifi_mgr_autoconn_config_t autoconn_conf = {
		.interval_ms = 1000,
	};

	test_lib_wifi_mgr_clear_connect_status();
	ret = wifi_mgr_auto_connect_start(&autoconn_conf);
	zassert_equal(ret, -EIO, "wifi_mgr_auto_connect_start shouldn't return success");

	wifi_mgr_scan_info_t *aps_info;
	int ap_num = wifi_mgr_scan_ap(&aps_info, false);

	if (ap_num > 0) {
		k_free(aps_info);

	}
	zassert_equal(ap_num, -EIO, "wifi_mgr_scan_ap shouldn't return success");

	test_lib_wifi_mgr_clear_connect_status();
	ret = wifi_mgr_sta_connect(&correct_sta_config, false);
	zassert_equal(ret, -EIO, "wifi_mgr_sta_connect ret is not right, ret:%d", ret);


	ret = wifi_mgr_storage_delete_ap(&correct_sta_config);
	zassert_equal(ret, 0, "wifi_mgr_storage_delete_ap ret: %d", ret);
}


void test_lib_wifi_mgr_sta_disable_and_call_api_then_enable(void)
{
	int ret = 0;
	wifi_mgr_autoconn_config_t autoconn_conf = {
		.interval_ms = 1000,
	};

	test_lib_wifi_mgr_sta_disable_and_check();

	ret = wifi_mgr_sta_enable();
	zassert_equal(ret, 0, "wifi mgr sta enable ret: %d", ret);

	test_wifi_mgr_storage_save_ap_assert(&correct_sta_config);

	test_lib_wifi_mgr_enable_connect_cb();

	test_lib_wifi_mgr_clear_connect_status();
	ret = wifi_mgr_auto_connect_start(&autoconn_conf);
	zassert_equal(ret, 0, "wifi_mgr_auto_connect_start return ret:%d", ret);

	ret = test_lib_wifi_mgr_get_sta_connect_status(K_MSEC(10 * 1000));
	zassert_equal(ret, WIFI_MGR_STA_CONNECTED, "test_lib_wifi_mgr_sta_connect_status_assert");

	ret = wifi_mgr_sta_disconnect(false);
	zassert_equal(ret, 0, "wifi_mgr_sta_disconnect failed, ret: %d", ret);

}


void test_lib_wifi_mgr_auto_connect_then_disable_finally_enable(void)
{
	int ret = 0;
	wifi_mgr_autoconn_config_t autoconn_conf = {
		.interval_ms = 1000,
	};

	test_wifi_mgr_storage_save_ap_assert(&correct_sta_config);
	test_lib_wifi_mgr_enable_connect_cb();
	test_lib_wifi_mgr_clear_connect_status();

	ret = wifi_mgr_auto_connect_start(&autoconn_conf);
	zassert_equal(ret, 0, "auto connect start failed, ret: %d", ret);
	ret = wifi_mgr_sta_disable();
	zassert_equal(ret, 0, "wifi_mgr_sta_disable ret: %d", ret);

	ret = test_lib_wifi_mgr_get_sta_connect_status(K_MSEC(10 * 1000));
	zassert_not_equal(ret, WIFI_MGR_STA_CONNECTED, "test_lib_wifi_mgr_get_sta_connect_status is wrong: %d", ret);

	ret = wifi_mgr_sta_enable();
	zassert_equal(ret, 0, "wifi mgr sta enable ret: %d", ret);

}
```

## src/test_wifi_mgr_storage.c
```c
#include <logging/log.h>
#include <stdbool.h>
#include <zephyr.h>
#include <ztest.h>

#include "kernel.h"
#include "sys_clock.h"
#include "tc_util.h"
#include "wifi_manager/wifi_manager.h"
#include "ztest_assert.h"

void test_wifi_mgr_storage_delete_all_ap(void)
{
	wifi_mgr_sta_config_t *saved_infos;
	int saved_infos_num = wifi_mgr_storage_search_ap(&saved_infos, SEARCH_ALL, NULL);

	for (int i = 0; i < saved_infos_num; i++) {
		wifi_mgr_storage_delete_ap(&(saved_infos[i]));
	}

	k_free(saved_infos);
}

static void check_saved_ssid_is_exist(char *ssid)
{
	wifi_mgr_sta_config_t *saved_infos;
	int saved_infos_num = wifi_mgr_storage_search_ap(&saved_infos, SEARCH_ALL, NULL);

	zassert_true(saved_infos_num > 0, "wifi search ap info failed\n");

	wifi_mgr_sta_config_t *hit_infos;
	int hit_num = wifi_mgr_storage_search_ap(&hit_infos, SEARCH_BY_SSID,
						 ssid);

	zassert_true(hit_num > 0, "Can't find storage ap %s", ssid);

	k_free(hit_infos);
	k_free(saved_infos);
}

void test_wifi_mgr_storage_save_ap_force(wifi_mgr_sta_config_t *in_sta_config)
{
	int ret = 0;
	wifi_mgr_sta_config_t cur_sta_config = { 0 };

	memcpy((void *)&cur_sta_config, (void *)in_sta_config, sizeof(cur_sta_config));
	wifi_mgr_sta_config_t *sta_config = &cur_sta_config;

	ret = wifi_mgr_storage_save_ap_force(NULL);
	zassert_equal(ret, -EINVAL, "force save ap shouldn't succeed, ret: %d", ret);

	/* test api force replace the old one */
	sta_config->encryption_mode = CSK_WIFI_AUTH_OPEN;
	ret = wifi_mgr_storage_save_ap_force(sta_config);
	zassert_equal(ret, 0, "save ap force failed, ret:%d", ret);

	wifi_mgr_sta_config_t *hit_infos;
	int hit_num = wifi_mgr_storage_search_ap(&hit_infos, SEARCH_BY_SSID,
						 sta_config->ssid);

	zassert_equal(hit_num, 1, "Can't find storage ap %s", sta_config->ssid);
	zassert_equal(hit_infos->encryption_mode, CSK_WIFI_AUTH_OPEN, "Looks like ap overwrite failed, encryption_mode: %d", hit_infos->encryption_mode);
	k_free(hit_infos);

}

void test_wifi_mgr_storage_save_ap_assert(wifi_mgr_sta_config_t *sta_config)
{
	int ret = 0;

	ret = wifi_mgr_storage_save_ap(sta_config); /* Save AP info */
	zassert_true((ret == 0) || (ret == -EEXIST),
		     "wifi save ap info failed");

	check_saved_ssid_is_exist(sta_config->ssid);
}
```
