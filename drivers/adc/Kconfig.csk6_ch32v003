## drivers/adc/Kconfig.csk6_ch32v003
```kconfig
# CSK ADC driver configuration options

# Copyright (c) 2021 listenai Intelligent Technology (anhui) Co., Ltd.
# SPDX-License-Identifier: Apache-2.0

config ADC_CSK6_CH32V003
	bool "listenai CSK6 embedded controller (EC) ADC driver"
	default n
	select I2C
	select CSK6_EXMCU
	depends on HAS_CSK6
	help
	  This option enables the ADC driver for CSK6.

config ADC_CSK6_CH32V003_INIT_PRIO
	int "adc csk6 ch32v003 init priority"
	default 52
	depends on ADC_CSK6_CH32V003

config ADC_CSK6_CH32V003_THREAD_PRIO
	int "adc csk6 ch32v003 thread priority"
	default 0
	depends on ADC_CSK6_CH32V003

config ADC_CSK6_CH32V003_THREAD_STACK_SIZE
	int "adc csk6 ch32v003 thread stack size"
	default 2048
	depends on ADC_CSK6_CH32V003

config ADC_CSK6_CH32V003_INTERNAL_VREF
	int "adc csk6 ch32v003 internal vref"
	default 3300
	depends on ADC_CSK6_CH32V003
```

## drivers/counter/Kconfig
```kconfig
if COUNTER

rsource "Kconfig.csk6"
rsource "Kconfig.csk6_dual_timer"
rsource "Kconfig.csk6_gptchannel"

endif # COUNTER
```

## drivers/counter/Kconfig.bm8563
```kconfig
# Counter driver for csk clock

# Copyright (c) 2022 LISTENAI Corp.
# SPDX-License-Identifier: Apache-2.0

config COUNTER_BM8563
	bool "Counter driver for bm8563 RTC clock"
```

## drivers/counter/Kconfig.csk6
```kconfig
# Counter driver for csk clock

# Copyright (c) 2022 LISTENAI Corp.
# SPDX-License-Identifier: Apache-2.0

config COUNTER_CSK6
	bool "Counter driver for csk6 RTC clock"
```

## drivers/counter/Kconfig.csk6_dual_timer
```kconfig
# CSK DUAL TIMER driver configuration options

# Copyright (c) 2021 listenai Intelligent Technology (anhui) Co., Ltd.
# SPDX-License-Identifier: Apache-2.0

config COUNTER_CSK6_DUAL
	bool "listenai CSK6 embedded controller dual timer driver"
	default n
	help
	  	  This option enables the dual counter driver for CSK6. Say y if you wish to use dual counter on CSK6.

	  
```

## drivers/counter/Kconfig.csk6_gpt_timer
```kconfig
# CSK GPT TIMER driver configuration options

# Copyright (c) 2021 listenai Intelligent Technology (anhui) Co., Ltd.
# SPDX-License-Identifier: Apache-2.0

config COUNTER_CSK6_GPT
	bool "listenai CSK6 embedded controller gpt timer driver"
	depends on HAS_CSK6
	select HAS_CSK6_GPT
	default n
	help
	  This option enables the gpt counter driver for CSK6. Say y if you wish to use gpt counter on CSK6.

	  
```

## drivers/counter/Kconfig.csk6_gptchannel
```kconfig
# CSK GPT TIMER driver configuration options

# Copyright (c) 2021 listenai Intelligent Technology (anhui) Co., Ltd.
# SPDX-License-Identifier: Apache-2.0

config COUNTER_CSK6_GPTCHANNEL
	bool "listenai CSK6 embedded controller gptchannel driver"
	depends on HAS_CSK6
	select HAS_CSK6_GPT
	default n
	help
	  This option enables the gptchannel counter driver for CSK6. Say y if you wish to use gptchannel counter on CSK6.

	  
```

## drivers/crypto/Kconfig.csk6
```kconfig
# CSK Crypto configuration options

# Copyright (c) 2022 listenai Intelligent Technology Co., Ltd.
# SPDX-License-Identifier: Apache-2.0

menuconfig CRYPTO_CSK6
	bool "CSK6 CRYPTO"
	default y
	depends on HAS_CSK6
	help
	  Enable the csk6 CRYPTO driver.
```

## drivers/disk/Kconfig.csk6
```kconfig
# SPDX-License-Identifier: Apache-2.0

if SDMMC_CSK6

config SDMMC_NON_BLOCK_INIT
    bool "CSK6 SDMMC Non-Block Init"
    select EVENTS
    help
        Make the CSK6 SDMMC Driver init into non-block

config SDMMC_CSK6_SRAM_CACHE_ACCESS
    bool "CSK6 SDMMC SRAM Cache Access"
    select DMA
    select DMA_CSK6
    default n
    help
        CSK6 SDMMC SRAM Cache Access

config SDMMC_CSK6_SRAM_CACHE_SIZE
    int "CSK6 SDMMC SRAM Cache Size"
    default 51200
    depends on SDMMC_CSK6_SRAM_CACHE_ACCESS
    help 
        CSK6 SDMMC SRAM Cache Size

config SDMMC_CSK6_SRAM_CACHE_NUM
    int "CSK6 SDMMC SRAM Cache Number"
    default 1
    range 0 1
    depends on SDMMC_CSK6_SRAM_CACHE_ACCESS
    help
        CSK6 SDMMC SRAM Cache Number

config SDMMC_CSK6_SRAM_CACHE_DMA_COPY_THRESHOLD
    int "CSK6 SDMMC SRAM Cache dma copy threshold"
    default 5120
    depends on SDMMC_CSK6_SRAM_CACHE_ACCESS
    help
        CSK6 SDMMC SRAM Cache dma copy threshold

config SDMMC_CSK6_DMA_CHANNEL
    int "CSK6 SDMMMC DMA Channel"
    default 1
    depends on SDMMC_CSK6_SRAM_CACHE_ACCESS
    help 
        CSK6 SDMMMC DMA Channel

config SDMMC_CSK6_CRYPTO_ENABLE
    bool "Enable CSK6 SDMMC  encrypt/decrypt partition" 
    default n
    depends on MBEDTLS
    help 
        Enable CSK6 SDMMC  encrypt/decrypt partition

if SDMMC_CSK6_CRYPTO_ENABLE

config SDMMC_CSK6_CRYPTO_KEY
    string "Enable CSK6 SDMMC  encrypt/decrypt key"
    default "0123456789abcdef"
    help 
        Enable CSK6 SDMMC  encrypt/decrypt key

config SDMMC_CSK6_CRYPTO_BUFFER_SIZE
    hex "CSK6 SDMMC encrypt buffer size"
    default 0x200
    help 
        CSK6 SDMMC encrypt buffer size

config SDMMC_CSK6_CRYPTO_PARTITION_START_SECTOR
    hex "CSK6 SDMMC encrypt/decrypt partition start sector"
    default 0x00
    help 
        CSK6 SDMMC encrypt/decrypt partition address

config SDMMC_CSK6_CRYPTO_PARTITION_NUMBER_SECTOR
    hex "CSK6 SDMMC encrypt/decrypt partition number sector"
    default 0x00
    help 
        CSK6 SDMMC encrypt/decrypt partition size

endif
endif # SDMMC_CSK6
```

## drivers/display/Kconfig.csk6_lcd
```kconfig
config DISPLAY_CSK6_LCD
    bool "display csk6 lcd"
    default n
    depends on HAS_CSK6
```

## drivers/display/Kconfig.lwea2012
```kconfig
# Copyright (c) 2020 Rohit Gujarathi
# SPDX-License-Identifier: Apache-2.0

config LWEA2012
	bool "LWEA2012 memory display controller driver"
	depends on SPI
	help
        LWEA2012 memory display controller driver
```

## drivers/display/Kconfig.nv3030b
```kconfig
# NV3030B display driver configuration options

# Copyright (c) 2019 Marc Reilly <marc@cpdesign.com.au>
# SPDX-License-Identifier: Apache-2.0

menuconfig NV3030B
	bool "NV3030B display driver"
	depends on SPI
	help
	  Enable driver for NV3030B display driver.

choice NV3030B_PIXEL_FORMAT
	prompt "Color pixel format"
	default NV3030B_RGB565
	depends on NV3030B
	help
	  Specify the color pixel format for the NV3030B display controller.

config NV3030B_RGB888
	bool "RGB888"

config NV3030B_RGB565
	bool "RGB565"

endchoice
```

## drivers/display/Kconfig.spd2010
```kconfig
# Copyright (c) 2020 Rohit Gujarathi
# SPDX-License-Identifier: Apache-2.0

config SPD2010
	bool "LWEA2012 memory display controller driver"
	depends on SPI
	help
        LWEA2012 memory display controller driver

config SPD2010_DMA_CHANNEL
	int "spd2010 dma channel"
	default 2
	depends on SPD2010
	help
		spd2010 dma channel

config SPD2010_TOUCH
	bool "enable touch for spd2010"
	default n
	depends on SPD2010
	help
	   enable touch for spd2010


choice
prompt "pixel format"
config SPD2010_FIXEL_FORMAT_RGB565
	bool "RGB565"

config SPD2010_FIXEL_FORMAT_BGR565
	bool "BGR565"

config SPD2010_FIXEL_FORMAT_RGB888
	bool "BGR888"

endchoice

choice
prompt "orientation"
config SPD2010_ORIENTATION_NORMAL
	bool "orientation normal"

config SPD2010_ORIENTATION_180
	bool "orientation 180"

endchoice
```

## drivers/display/Kconfig.st7789v_csk6
```kconfig
# ST7789V display driver configuration options

# Copyright (c) 2019 Marc Reilly <marc@cpdesign.com.au>
# SPDX-License-Identifier: Apache-2.0

menuconfig ST7789V_CSK6
	bool "ST7789V display driver"
	depends on SPI
	help
	  Enable driver for ST7789V display driver.

config ST7789V_CSK6_DMA_CHANNEL
	int "ST7789V_CSK6_DMA_CHANNEL"
	default 0

choice ST7789V_PIXEL_FORMAT
	prompt "Color pixel format"
	default ST7789V_RGB565
	depends on ST7789V_CSK6
	help
	  Specify the color pixel format for the ST7789V display controller.

config ST7789V_RGB888
	bool "RGB888"

config ST7789V_RGB565
	bool "RGB565"

endchoice
```

## drivers/dma/Kconfig.csk6
```kconfig
# SPDX-License-Identifier: Apache-2.0

config DMA_CSK6
	bool "CSK6 DMA controller driver"
	default y
	depends on HAS_CSK6
	help
	  Enable the csk6 DMA driver.

config DMA_CSK6_BUFFER_CHECK
	bool "buffer address check"
	default n
	depends on DMA_CSK6
	help
	  Enable the buffer address check.
```

## drivers/entropy/Kconfig.csk6
```kconfig
# csk6 entropy generator driver configuration

# Copyright (c) 2021 listenai Intelligent Technology (anhui) Co., Ltd.
# SPDX-License-Identifier: Apache-2.0

config ENTROPY_CSK6_RNG
	bool "CSK6 entropy number generator driver"
	depends on HAS_CSK6
	select ENTROPY_HAS_DRIVER
	default y
	help
	  This option enables the entropy number generator for CSK6 SoCs.
```

## drivers/flash/Kconfig.csk6
```kconfig
# Copyright (c) 2021 LISTENAI Co., Ltd.
# SPDX-License-Identifier: Apache-2.0

config SOC_FLASH_CSK6
	bool "Listenai CSK6 flash driver"
	default y
	select FLASH_HAS_DRIVER_ENABLED
	select FLASH_HAS_PAGE_LAYOUT
	select CACHE_MANAGEMENT
	depends on HAS_CSK6
	help
	  Enable CSK6 internal flash driver.

config MPU_ALLOW_FLASH_WRITE
	bool "Add MPU access to write to flash"
	help
	  Enable this to allow MPU RWX access to flash memory

config CSK6_FLASH_STALL_SECOND_CORE
	bool  "Stall second core when write and erase flash"
	default y
	help
		Enable stall second core operation when write and erase flash.The second core of stall is triggered when the 
		flash area is written or erased using the driver.Because the CSK6's second core and flash driver cannot access 
		flash at the same time.If you are not running the second core or the second core does not access the flash region, 
		set this configuration to disable(n).

config FLASH_CSK6_LOCK
	bool "Listenai CSK6 spi flash lock API"
	default n
	depends on SOC_FLASH_CSK6
	help
	  Enable CSK6 internal spi flash lock API.
```

## drivers/gpio/Kconfig.csk6
```kconfig
# SPDX-License-Identifier: Apache-2.0

config GPIO_CSK6
	bool "CSK6 GPIO driver"
	default y
	depends on HAS_CSK6
	help
	  Enable the csk6 GPIO driver.
```

## drivers/gpio/Kconfig.csk6_ch32v003
```kconfig
# SPDX-License-Identifier: Apache-2.0

config GPIO_CSK6_CH32V003
	bool "CSK6 GPIO driver"
	default n
	depends on HAS_CSK6
	select I2C
	select CSK6_EXMCU
	help
	  Enable the csk6 GPIO driver.

config GPIO_CSK6_CH32V003_INIT_PRIORITY
	int "init priority"
	default 52
	depends on GPIO_CSK6_CH32V003
	help
	   init priority
```

## drivers/hwinfo/Kconfig
```kconfig
# HW Info driver configuration options

# Copyright (c) 2019 Alexander Wachter
# SPDX-License-Identifier: Apache-2.0

if HWINFO

config HWINFO_CSK6
	bool "listenai CSK6 device id"
	default y
	depends on HAS_CSK6
	help
	  Enable CSK6 hwinfo driver

endif
```
