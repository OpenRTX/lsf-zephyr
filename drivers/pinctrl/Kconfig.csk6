## drivers/pinctrl/Kconfig.csk6
```kconfig
# Copyright (c) 2021 listenai Intelligent Technology (anhui) Co., Ltd.
# SPDX-License-Identifier: Apache-2.0

config PINCTRL_CSK6
	bool "Pin controller driver for CSK6 MCUs"
	default y
	depends on HAS_CSK6
	help
	  Enable pin controller driver for CSK series MCUs
```

## dts/bindings/flash_controller/listenai,csk-flash-controller.yaml
```yaml
# SPDX-License-Identifier: Apache-2.0

description: LISTENAI CSK flash controller

compatible: "listenai,csk-flash-controller"

include: flash-controller.yaml
```

## dts/bindings/serial/listenai,csk-uart.yaml
```yaml
# SPDX-License-Identifier: Apache-2.0

description: Listenai UART

compatible: "listenai,csk-uart"

include: [uart-controller.yaml, pinctrl-device.yaml]

properties:
    reg:
      required: true

    interrupts:
      required: false
```
