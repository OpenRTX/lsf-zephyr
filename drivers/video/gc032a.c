/*
 * Copyright (c) 2022, listenai
 *
 * SPDX-License-Identifier: Apache-2.0
 */

#define DT_DRV_COMPAT galaxyc_gc032a

#include <zephyr.h>
#include <device.h>

#include <drivers/video.h>
#include <drivers/i2c.h>
#include <drivers/gpio.h>

#define LOG_LEVEL CONFIG_LOG_DEFAULT_LEVEL
#include <logging/log.h>
LOG_MODULE_REGISTER(gc032a);

/** 
  * @brief  GC032A ID  
  */  
#define  GC032A_ID    0x23

struct gc032a_data {
    const struct i2c_dt_spec i2c_bus;
    const struct gpio_dt_spec reset_gpios;
	const struct gpio_dt_spec pwdn_gpios;
	struct video_format fmt;
};

struct gc032a_reg {
	uint8_t addr;
	uint8_t value;
};

/*bgr565 */
static const struct gc032a_reg gc032a_init_grb_reg_tb[] = {
	{0xf3, 0xff}, {0xf7, 0x01}, {0xf8, 0x03}, {0xf9, 0xce}, {0xfa, 0x00}, {0xfc, 0x02},
	{0xfe, 0x02}, {0x81, 0x03}, {0xfe, 0x00}, {0x77, 0x64}, {0x78, 0x40}, {0x79, 0x60},

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	{0x46, 0x0f} //
};
/* 25M CLK & VGA & YUV(UYVY) & 15fps */
static const struct gc032a_reg gc032a_init_reg_tb[] = {
    /*System*/
	{0xf3,0xff},
	{0xf5,0x06},
	{0xf7,0x01},
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	{0x79,0x60},

	/*Analog&Cisctl*/
	{0xfe,0x00},
	{0x03,0x01},
	{0x04,0xce},
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	{0x12,0x89},

	/*blk*/
	{0xfe,0x00},
	{0x18,0x02},
	{0xfe,0x02},
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	{0x42,0x10},

	/*isp*/
	{0xfe,0x01},
	{0x0a,0xc5},
	{0x45,0x00},
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	{0x22,0xf6},

	/*Shading*/
	{0xfe,0x01},
	{0xc1,0x38},
	{0xc2,0x4c},
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	{0xdf,0x75},

	/*AWB*/ /*20170110*/
	{0xfe,0x01},
	{0x7c,0x09},
	{0x65,0x06},
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	{0xb9,0xb6},

	/*CC*/
	{0xfe,0x01},
	{0xd0,0x40},
	{0xd1,0xf8},
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	{0xfe,0x00},

	/*Gamma*/
	{0xfe,0x00},
	{0xba,0x00},
	{0xbb,0x04},
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	{0xcf,0xff},

	/*Auto Gamma*/                      
	{0xfe,0x00},
	{0x5a,0x08},
	{0x5b,0x0f},
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	{0x6f,0xff},

	/*Gain*/
	{0xfe,0x00},
	{0x70,0x50},

	/*AEC*/
	{0xfe,0x00},
	{0x4f,0x01},
	{0xfe,0x01},
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	{0x03,0xc0},

	/*measure window*/
	{0xfe,0x01},
	{0xcc,0x08},
	{0xcd,0x08},
	{0xce,0xa4},
	{0xcf,0xec},

	/*DNDD*/
	{0xfe,0x00},
	{0x81,0xb8},
	{0x82,0x12},
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	{0x8d,0x0a},

	/*Intpee*/
	{0xfe,0x00},
	{0x8f,0xaa},
	{0x90,0x9c},
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	{0x98,0x00},

	/*ASDE*/
	{0xfe,0x00},
	{0xa1,0x30},
	{0xa2,0x41},
	{0xa4,0x30},
	{0xa5,0x20},
	{0xaa,0x30},
	{0xac,0x32},

	/*YCP*/
	{0xfe,0x00},
	{0xd1,0x3c},
	{0xd2,0x3c},
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	{0xde,0x84},

	/*Banding*/
	{0xfe,0x00},
	{0x05,0x01},
	{0x06,0xad},
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	{0xfe,0x00},
};


static int gc032a_write_reg(const struct device *dev, uint8_t reg_addr,
			    uint8_t value)
{
	struct gc032a_data *drv_data = dev->data;
	struct i2c_msg msgs;
	uint8_t tx_buf[2];

	tx_buf[0] = reg_addr;
	tx_buf[1] = value;

	msgs.buf = tx_buf;
	msgs.len = 2;
	msgs.flags = I2C_MSG_WRITE | I2C_MSG_STOP;

	return i2c_transfer(drv_data->i2c_bus.bus, &msgs, 1, drv_data->i2c_bus.addr);
}


static int gc032a_read_reg(const struct device *dev, uint8_t reg_addr,
			   uint8_t *value)
{
	struct gc032a_data *drv_data = dev->data;
	struct i2c_msg msgs[2];

	msgs[0].buf = (uint8_t *)&reg_addr;
	msgs[0].len = 1;
	/*
	 * When using I2C to read the registers of the SCCB device,
	 * a stop bit is required after writing the register address
	 */
	msgs[0].flags = I2C_MSG_WRITE | I2C_MSG_STOP;

	msgs[1].buf = (uint8_t *)value;
	msgs[1].len = 1;
	msgs[1].flags = I2C_MSG_READ | I2C_MSG_STOP | I2C_MSG_RESTART;

	return i2c_transfer(drv_data->i2c_bus.bus, msgs, 2, drv_data->i2c_bus.addr);
}



int gc032a_modify_reg(const struct device *dev,
		      uint8_t reg_addr,
		      uint8_t clear_mask,
		      uint8_t value)
{
	int ret;
	uint8_t set_value;

	ret = gc032a_read_reg(dev, reg_addr, &set_value);

	if (ret == 0) {
		set_value = (set_value & (~clear_mask)) |
				(set_value & clear_mask);
		ret = gc032a_write_reg(dev, reg_addr, set_value);
	}


	return ret;
}

static int gc032a_write_all(const struct device *dev,
			    const struct gc032a_reg *regs,
			    uint16_t reg_num)
{
	uint16_t i = 0;
	int err;

	for (i = 0; i < reg_num; i++) {
		err = gc032a_write_reg(dev, regs[i].addr, regs[i].value);
		k_sleep(K_MSEC(10));
		if (err) {
			return err;
		}
	}

	return 0;
}

static int gc032a_set_fmt(const struct device *dev,
			  enum video_endpoint_id ep,
			  struct video_format *fmt)
{
	int ret = 0;

	if (fmt->pixelformat == VIDEO_PIX_FMT_VYUY && fmt->height == 480 && fmt->width == 640) {
		ret = gc032a_write_all(dev, gc032a_init_reg_tb, ARRAY_SIZE(gc032a_init_reg_tb));
		if (ret) {
			LOG_ERR("Unable to write gc032a config");
			return ret;
		}

		return 0;
	}
	if (fmt->pixelformat == VIDEO_PIX_FMT_RGB565 && fmt->height == 480 && fmt->width == 640) {
		ret = gc032a_write_all(dev, gc032a_init_grb_reg_tb,
				       ARRAY_SIZE(gc032a_init_grb_reg_tb));
		if (ret) {
			LOG_ERR("Unable to write gc032a config rgb565");
			return ret;
		}

		return 0;
	}
	LOG_ERR("video format unsupported \n");
    return -ENOTSUP;
}

static int gc032a_get_fmt(const struct device *dev,
			  enum video_endpoint_id ep,
			  struct video_format *fmt)
{
	return 0;
}

static int gc032a_stream_start(const struct device *dev)
{
	return 0;
}

static int gc032a_stream_stop(const struct device *dev)
{
	return 0;
}

static const struct video_format_cap fmts[] = {
	{
		.pixelformat = VIDEO_PIX_FMT_VYUY,
		.width_min = 640,
		.width_max = 640,
		.height_min = 480,
		.height_max = 480,
		.width_step = 0,
		.height_step = 0,
	},
	{
	    .pixelformat = VIDEO_PIX_FMT_RGB565,
	    .width_min = 640,
	    .width_max = 640,
	    .height_min = 480,
	    .height_max = 480,
	    .width_step = 0,
	    .height_step = 0,
	},
	{0}
};

static int gc032a_get_caps(const struct device *dev,
			   enum video_endpoint_id ep,
			   struct video_caps *caps)
{
	caps->format_caps = fmts;
	return 0;
}


static int gc032a_init(const struct device *dev)
{
	struct gc032a_data *drv_data = dev->data;
	int ret = 0;
	uint8_t pid;

	if (i2c_configure(drv_data->i2c_bus.bus,
			I2C_SPEED_SET(I2C_SPEED_STANDARD) | I2C_MODE_MASTER)) {
		LOG_ERR("I2C config failed!");
		return -EIO;
	}

	//check chip id
    ret = gc032a_read_reg(dev,0xf0,&pid);
	if (ret) {
		LOG_ERR("Unable to read gc032a pid");
		return -ENODEV;
	}

	if(pid != GC032A_ID){
		LOG_ERR("gc032a read PID err 0x%x", pid);
		return -ENODEV;		
	 }

	/* Configure Sensor */


	return 0;
}

static int gc032a_set_ctrl(const struct device *dev,
				unsigned int cid, void *value)
{
	int ret = 0;

	switch (cid) {	
	/*
		该sensor只有在mclk有输入时钟的情况下，i2c才能正常通信，所以并不能在内核设备初始化流程中进行sensor初始化。
		目前是通过set_ctrl来提供sensor初始化的api.
	*/
	case 0:
		ret = gc032a_init(dev);
		break;
	default:
		return -ENOTSUP;
	}

	return ret;
}

static const struct video_driver_api gc032a_driver_api = {
	.set_format = gc032a_set_fmt,
	.get_format = gc032a_get_fmt,
	.get_caps = gc032a_get_caps,
	.stream_start = gc032a_stream_start,
	.stream_stop = gc032a_stream_stop,
	.set_ctrl = gc032a_set_ctrl,
};

static int gc032a_init_0(const struct device *dev)
{
	struct gc032a_data *drv_data = dev->data;
	int ret = 0;

	if(drv_data->pwdn_gpios.port){
		gpio_pin_configure_dt(&drv_data->pwdn_gpios, GPIO_OUTPUT_ACTIVE);
		gpio_pin_set_dt(&drv_data->pwdn_gpios, 0);
	}

	if (drv_data->reset_gpios.port) {
        gpio_pin_configure_dt(&drv_data->reset_gpios, GPIO_OUTPUT_ACTIVE);
        gpio_pin_set_dt(&drv_data->reset_gpios, 0);
		k_sleep(K_MSEC(3));
        gpio_pin_set_dt(&drv_data->reset_gpios, 1);
		k_sleep(K_MSEC(1));
	}

	return ret;
}

static struct gc032a_data gc032a_data_0 =
{
    .i2c_bus = I2C_DT_SPEC_GET(DT_DRV_INST(0)),

#if DT_NODE_HAS_PROP(DT_DRV_INST(0), reset_gpios)
    .reset_gpios = GPIO_DT_SPEC_GET(DT_DRV_INST(0), reset_gpios),
#endif

#if DT_NODE_HAS_PROP(DT_DRV_INST(0), pwdn_gpios)
	.pwdn_gpios = GPIO_DT_SPEC_GET(DT_DRV_INST(0), pwdn_gpios),
#endif
};

DEVICE_DT_INST_DEFINE(0, &gc032a_init_0, NULL,
		    &gc032a_data_0, NULL,
		    POST_KERNEL, CONFIG_KERNEL_INIT_PRIORITY_DEVICE,
		    &gc032a_driver_api);
