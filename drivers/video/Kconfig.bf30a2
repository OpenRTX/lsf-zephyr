## drivers/video/Kconfig.bf30a2
```kconfig
# BF30A2

# Copyright (c) 2022 listenai
# SPDX-License-Identifier: Apache-2.0

config VIDEO_BF30A2
	bool "1/15 inch QVGA CMOS Image Sensor BF30A2"
	help
	  Enable driver for BF30A2 CMOS digital image sensor device.

config BF30A2_UNUSED_DEQUEUE
	bool "1/15 inch QVGA CMOS Image Sensor BF30A2"
    default n
	help
	  Enable driver for BF30A2 CMOS digital image sensor device.

config BF30A2_DECODE_TEST
    bool "1/15 inch QVGA CMOS Image Sensor BF30A2"
    default n
	help
	  Enable driver for BF30A2 CMOS digital image sensor device.
```

## drivers/video/Kconfig.csk6_dvp
```kconfig
# CSK6 DVP driver configuration options

# Copyright (c) 2022 listenai
# SPDX-License-Identifier: Apache-2.0

config VIDEO_CSK6_DVP
	bool "CSK6 CMOS Sensor Interface (DVP) driver"
    depends on HAS_CSK6
```

## drivers/video/Kconfig.gc032a
```kconfig
# gc032a

# SPDX-License-Identifier: Apache-2.0

config VIDEO_GC032A
	bool "GC032A CMOS digital image sensor"
    depends on HAS_CSK6
	help
	  Enable driver for GC032A CMOS digital image sensor devices

config VIDEO_GC032A_MANUAL_UV
	bool "Use fixed UV value"
	depends on VIDEO_GC032A
	help
	  Use fixed value as UV output instead of chip output
	
config VIDEO_GC032A_MANUAL_U_VALUE
	int "fixed U value"
	default 170
	help
	  fixed value as U output instead of chip output
	  
config VIDEO_GC032A_MANUAL_V_VALUE
	int "fixed V value"
	default 85
	help
	  fixed value as V output instead of chip output
```

## drivers/video/Kconfig.ov9655
```kconfig
# OV9655

# Copyright (c) 2022 listenai
# SPDX-License-Identifier: Apache-2.0

config VIDEO_OV9655
	bool "OV9655 CMOS digital image sensor"
	depends on I2C
	help
	  Enable driver for OV9655 CMOS digital image sensor device.

config VIDEO_OV9655_MANUAL_UV
	bool "Use fixed UV value"
	depends on VIDEO_OV9655
	help
	  Use fixed value as UV output instead of chip output
	
config VIDEO_OV9655_MANUAL_U_VALUE
	int "fixed U value"
	default 170
	help
	  fixed value as U output instead of chip output
	  
config VIDEO_OV9655_MANUAL_V_VALUE
	int "fixed V value"
	default 85
	help
	  fixed value as V output instead of chip output
```

## drivers/video/Kconfig.sco30iot
```kconfig
# SPDX-License-Identifier: Apache-2.0

config VIDEO_SCO30IOT
	bool "Support for the SCO30IOT out of tree driver"

choice SCO30IOT_FPS
	prompt "SCO30IOT working fps config"
	default SCO30IOT_FPS_30

	config SCO30IOT_FPS_30
		bool "SCO30IOT using 30 fps"
	config SCO30IOT_FPS_20
		bool "SCO30IOT using 20 fps"
	config SCO30IOT_FPS_15
		bool "SCO30IOT using 15 fps"
endchoice


config VIDEO_SCO30IOT
	bool "Support for the SCO30IOT out of tree driver"
```

## drivers/watchdog/Kconfig.csk6
```kconfig
# Microchip CSK6 Watchdog Timer configuration

# Copyright (c) 2022 listenai
# SPDX-License-Identifier: Apache-2.0

config WDT_CSK6
	bool "Microchip CSK series Watchdog Timer (WDT) driver"
	default y
	help
	  Enable WDT driver for Microchip CSK MCU series.

config WDT_CSK_SOURCE_NUM_PER_MS
	int
	default 32
	help
		Set the number of wdt register value per ms
```

## drivers/wifi/csk6/Kconfig.csk6
```kconfig
# Copyright 2020 Espressif Systems (Shanghai) PTE LTD

menuconfig WIFI_CSK6
	bool "CSK6 WiFi Driver"
	default y
	depends on HAS_CSK6
	help
	  Enable CSK6 SoC WiFi

if WIFI_CSK6

choice
    prompt "WiFi Offload Module"
	config CSK_WIFI_ESP32C3
		bool "ESP32C3"
		select ESP_HOSTED
		select GPIO
		select SPI

	config CSK_WIFI_XR819S
		bool "XR819S"
		select XR819S
		select GPIO
		select NVS
		select FLASH
		select FLASH_PAGE_LAYOUT
		select FLASH_MAP
		select MPU_ALLOW_FLASH_WRITE
endchoice

config CSK_WIFI_STATION
	bool "WiFi Station Enable"

config CSK_WIFI_SOFTAP
	bool "WiFi SoftAP Enable"

config WIFI_CTRL_STACK_SIZE
	int "Control Task Stack Size"
	default 8192

config WIFI_CTRL_PRIORITY
	int "Control Task Priority"
	default 4

if XR819S

config MAX_SCAN_APS_NUM
	int "WiFi Maximum Scan AP's Number"
	default 40

config WLAN_API_TIMEOUT
	int "WiFi Driver api timeout(s)"
	default 30

config NET_RX_ALLOC_TIMEOUT
	int "Net rx allocate buffer timeout(ms)"
	default 100

endif #XR819S

endif #WIFI_CSK6
```

## drivers/wifi/csk6001/Kconfig.csk6001
```kconfig
# Copyright 2020 Espressif Systems (Shanghai) PTE LTD

menuconfig WIFI_CSK6001
	bool "CSK6001 WiFi Driver"
	default y
	depends on HAS_CSK6001
	help
	  Enable CSK6001 SoC WiFi

if WIFI_CSK6001

choice
    prompt "WiFi Offload Module"
	config CSK_WIFI_ESP32C3
		bool "ESP32C3"
		select ESP_HOSTED
		select GPIO
		select SPI

	config CSK_WIFI_XR819S
		bool "XR819S"
		select XR819S
		select GPIO
		select FLASH
		select FLASH_MAP
		select FLASH_PAGE_LAYOU
		select FILE_SYSTEM
		select FILE_SYSTEM_LITTLEFS
endchoice

config CSK_WIFI_STATION
	bool "WiFi Station Enable"

config CSK_WIFI_SOFTAP
	bool "WiFi SoftAP Enable"

config WIFI_CTRL_STACK_SIZE
	int "Control Task Stack Size"
	default 8192

config WIFI_CTRL_PRIORITY
	int "Control Task Priority"
	default 4

if XR819S

config MAX_SCAN_APS_NUM
	int "WiFi Maximum Scan AP's Number"
	default 10

config WLAN_API_TIMEOUT
	int "WiFi Driver api timeout(s)"
	default 30

endif #XR819S

endif #WIFI_CSK6001
```

## dts/bindings/adc/listenai,csk-adc-ch32v003.yaml
```yaml
# SPDX-License-Identifier: Apache-2.0

description: CSK ADC node

compatible: "listenai,csk-adc-ch32v003"

include: [adc-controller.yaml, i2c-device.yaml]

properties:
    reg:
      required: true

    interrupts:
      required: false

    "#io-channel-cells":
      const: 1

io-channel-cells:
    - input
```

## dts/bindings/adc/listenai,csk-adc.yaml
```yaml
# SPDX-License-Identifier: Apache-2.0

description: CSK ADC node

compatible: "listenai,csk-adc"

include: [adc-controller.yaml, pinctrl-device.yaml]

properties:
    reg:
      required: true

    interrupts:
      required: true

    "#io-channel-cells":
      const: 1

io-channel-cells:
    - input
```

## dts/bindings/arm/listenai,csk-itcm.yaml
```yaml
# SPDX-License-Identifier: Apache-2.0

description: CSKITCM (Instruction Tightly Coupled Memory)

compatible: "listenai,csk-itcm"

include: base.yaml

properties:
    reg:
      required: true
```

## dts/bindings/audio/listenai,pwr-amp.yaml
```yaml
#
# Copyright (c) 2019, Linaro Limited
#
# SPDX-License-Identifier: Apache-2.0
#

description: CSK6 audio power amplifier interface

compatible: "listenai,pwr-amp"

include: base.yaml

properties:
    label:
      required: true
    enalbe-gpios:
      type: phandle-array
      required: true
      description: enable pin
```

## dts/bindings/counter/listenai,csk-gptchannel.yaml
```yaml
# Copyright (c) 2022 LISTENAI (ShenZhen) Co., Ltd.
# SPDX-License-Identifier: Apache-2.0

description: CSK counters

compatible: "listenai,csk-gptchannel"

include: [pwm-controller.yaml, base.yaml, pinctrl-device.yaml]

properties:
    channel-id:
      type: int
      required: true
      description: channel id num of the hardware gpt

    channel_mode:
      type: int
      required: true
      description: channel id num of the hardware gpt

    label:
      required: true

    clock-source:
      type: int
      required: false
      default: 1
      enum:
       - 1
       - 2
       - 3
      description: Config Pwm Clock Source. 1 for Peripheral Clock(200Mhz), 2 for External Clock(12Mhz) , 3 for Crystal Clock(24Mhz)

    mode:
      type: int
      required: false
      default: 1
      enum:
       - 1
       - 2
      description: PWM OutPut Mode. 1 for EDGE_ALIGNED, 2 for CENTRAL_ALIGNED.

    clock-prescaler:
      type: int
      required: false
      default: 1
      enum:
       - 1
       - 2
       - 4
       - 8
       - 16
       - 32
       - 64
       - 128
      description: PWM Peripheral Clock Prescaler.

    "#pwm-cells":
      const: 3

pwm-cells:
  - channel
  - period
  - flags
```

## dts/bindings/counter/listenai,csk-gpttimer.yaml
```yaml
# Copyright (c) 2022 LISTENAI (ShenZhen) Co., Ltd.
# SPDX-License-Identifier: Apache-2.0

description: CSK counters

compatible: "listenai,csk-gpttimer"

include: base.yaml

properties:
    channel-id:
      type: int
      required: true
      description: channel id num of the hardware gpt

    label:
      required: true
```

## dts/bindings/counter/listernai,csk-counter.yaml
```yaml
# Copyright (c) 2021, Kent Hall
# SPDX-License-Identifier: Apache-2.0

description: CSK counters

compatible: "listenai,csk-dual"

include: base.yaml

properties:
    label:
      required: true
```

## dts/bindings/counter/listernai,csk-gpttimer.yaml
```yaml
# Copyright (c) 2022 LISTENAI (ShenZhen) Co., Ltd.
# SPDX-License-Identifier: Apache-2.0

description: CSK counters

compatible: "listenai,csk-gpttimer"

include: base.yaml

properties:
    label:
      required: true
```

## dts/bindings/crypto/listenai,csk-crypto.yaml
```yaml
# SPDX-License-Identifier: Apache-2.0

description: CSK crypto node

compatible: "listenai,csk-crypto"

include: base.yaml

properties:
    reg:
      required: true

    interrupts:
      required: true
```

## dts/bindings/display/solomon,spd2010-display.yaml
```yaml
# Copyright (c) 2022, Byte-Lab d.o.o. <dev@byte-lab.com>
# SPDX-License-Identifier: Apache-2.0

description: SOLOMON SYSTECH LCD display controller

compatible: "solomon,spd2010-display"

include: [spi-device.yaml, display-controller.yaml]

properties:
    reset-gpios:
      type: phandle-array
      required: false
      description: |
        RESET pin.

        The RESET pin of LWEA2012 is active low.
        If connected directly the MCU pin should be configured
        as active low.

    cmd-data-gpios:
      type: phandle-array
      required: true
      description: |
        D/CX pin.

        The D/CX pin of LWEA2012 is active low (transmission command byte).
        If connected directly the MCU pin should be configured
        as active low.
    te-gpios:
      type: phandle-array
      required: false
      description: |
        TE pin.

        Frame head pulse signal. Utilize this signal when
        synchronizing RAM data write operations.

    backlight-pwms:
      type: phandle-array
      required: true
      description: |
        The backlight pwm is used to control the brightness of the LCD.

    bl—default-brightness:
      type: phandle-array
      required: true
      description: |
        The backlight pwm is used to control the brightness of the LCD.

    x-offset:
      type: int
      required: true
      description: The column offset in pixels of the LCD to the controller memory

    y-offset:
      type: int
      required: true
      description: The row offset in pixels of the LCD to the controller memory

    inversion-on:
      type: boolean
      description: |
        Enable Display Inversion
        Make a drawing with the inverted color of the frame memory.
```

## dts/bindings/entropy/listenai,csk-entropy.yaml
```yaml
# SPDX-License-Identifier: Apache-2.0

description: CSK entropy node

compatible: "listenai,csk-entropy"

include: base.yaml

properties:
    reg:
      required: true

    interrupts:
      required: true
```

## dts/bindings/gpio/listenai,csk-gpio-ch32003-port.yaml
```yaml
description: CH32V003 I2C-based GPIO expander

compatible: "listenai,csk-gpio-ch32003-port"

include: [gpio-controller.yaml, base.yaml]

properties:
    reg:
        required: true

    label:
        required: true

    pin_mask:
      type: int
      required: false

    "#gpio-cells":
      const: 2

gpio-cells:
  - pin
  - flags
```

## dts/bindings/gpio/listenai,csk-gpio-ch32003.yaml
```yaml
description: CH32V003 I2C-based GPIO expander


compatible: "listenai,csk-gpio-ch32003"

include: [i2c-device.yaml]

properties:
    label:
      required: true
```

## dts/bindings/gpio/listenai,csk-gpio-user.yaml
```yaml
# Copyright (c) 2018, Linaro Limited
# SPDX-License-Identifier: Apache-2.0

description: CSK GPIO User parent node

compatible: "listenai,csk-gpio-user"

child-binding:
    description: LISTENAI CSK GPIO KEYS child node
    properties:
       gpios:
          type: phandle-array
          required: true
       label:
          required: true
          type: string
          description: Human readable string describing the device (used as device_get_binding() argument)
```

## dts/bindings/gpio/listenai,csk-gpio.yaml
```yaml
description: CSK GPIO

compatible: "listenai,csk-gpio"

include: [gpio-controller.yaml, base.yaml]

properties:
    reg:
        required: true

    label:
        required: true

    "#gpio-cells":
        const: 2

gpio-cells:
  - pin
  - flags
```
