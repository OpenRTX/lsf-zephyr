## drivers/i2c/Kconfig.csk6
```kconfig
# CSK I2C driver configuration options

# Copyright (c) 2021 listenai Intelligent Technology (anhui) Co., Ltd.
# SPDX-License-Identifier: Apache-2.0

config I2C_CSK6
	bool "listenai CSK6 embedded controller (EC) I2C driver"
	default y
	depends on HAS_CSK6
	help
	  This option enables the I2C driver for CSK6.
	  Say y if you wish to use I2C modules on CSK6.
	  
```

## drivers/infrared/Kconfig
```kconfig
# INFRARED driver configuration options

# Copyright (c) 2023 Anhui(Shenzhen) Listenai Co., Ltd.
# SPDX-License-Identifier: Apache-2.0

menuconfig INFRARED
	bool "Infrared driver"
	help
	  Enable infrared driver.

config INFRARED_SHELL
	bool "INFRARED Shell"
	default n
	help
	  Enable INFRARED Shell for testing.


if INFRARED

source "drivers/infrared/Kconfig.csk6"

module = INFRARED
module-str = INFRARED
source "subsys/logging/Kconfig.template.log_config"

endif
```

## drivers/infrared/Kconfig.csk6
```kconfig
# CSK Infrared driver configuration options

# Copyright (c) 2023 listenai Intelligent Technology (anhui) Co., Ltd.
# SPDX-License-Identifier: Apache-2.0

config INFRARED_CSK6
	bool "listenai CSK6 device infrared driver"
	default n
	depends on HAS_CSK6
	select EVENTS
	help
	  Enable CSK6 INFRARED driver
```

## drivers/kscan/Kconfig.bl6xxx
```kconfig
# Copyright (c) listenai
# SPDX-License-Identifier: Apache-2.0

config KSCAN_BL6XXX
	bool "GL6XXX keyscan driver"
	depends on I2C
	help
		Enable driver for bl6xxx
```

## drivers/kscan/Kconfig.csk6
```kconfig
# Copyright (c) listenai
# SPDX-License-Identifier: Apache-2.0

config KSCAN_CSK6
	bool "CSK6 keysense driver"
	depends on ADC
	help
		Enable driver for CSK6 keysense

if KSCAN_CSK6

config KSCAN_CSK6_DEBOUNCE
	bool "CSK6 keysense sampling debounce"
	depends on KSCAN_CSK6
	help
		Enable driver for CSK6 keysense debounce

config KSCAN_CSK6_DEBOUNCE_TIME
	int "CSK6 keysense sampling debounce time"
	depends on KSCAN_CSK6_DEBOUNCE
	range 0 100
	default 5 
	help
		Keysense debounce time in ms

endif
```

## drivers/kscan/Kconfig.spd2010
```kconfig
# Copyright (c) listenai
# SPDX-License-Identifier: Apache-2.0

config KSCAN_SPD2010
	bool "SPD2010 keyscan driver"
	depends on I2C
	depends on SPD2010
	select SPD2010_TOUCH
	help
		SPD2010 integrates display and touch,
		and the initialization of touch depends on the display,
		so the touch function cannot be used alone

config KSCAN_SPD2010_DELAY_TIME_MS
	int "SPD2010 scan delay time without interrupt"
	default 5
	depends on KSCAN_SPD2010
	help
		SPD2010 scan delay time without interrupt

config KSCAN_SPD2010_RELEASE_WEIGHT
	int "SPD2010 release weight"
	default 20
	depends on KSCAN_SPD2010
	help
	  SPD2010 release weight

config KSCAN_SPD2010_REPORT_FILTER
	bool "SPD2010 report filter"
	default y
	depends on KSCAN_SPD2010
	help
	   SPD2010 report filter

config KSCAN_SPD2010_REPORT_FILTER_TIME_MS
	int "SPD2010 report filter time ms"
	default 50
	depends on KSCAN_SPD2010_REPORT_FILTER
	help
	  SPD2010 report filter time ms
```

## drivers/lte/Kconfig
```kconfig
menuconfig LTE
	bool "LTE drivers"
    select NETWORKING
    select NET_SOCKETS
    select NET_OFFLOAD
    select NET_SOCKETS_OFFLOAD


if LTE

choice LTE_OFFLOAD_MODULE
    prompt "LTE Module"
	config LTE_EC718
		bool "EC718"
		select EC718
		select UART_CSK6
		select UART_INTERRUPT_DRIVEN
endchoice

endif
```

## drivers/onewire/infrared/Kconfig
```kconfig
# INFRARED driver configuration options

# Copyright (c) 2023 Anhui(Shenzhen) Listenai Co., Ltd.
# SPDX-License-Identifier: Apache-2.0

menuconfig INFRARED
	bool "Infrared driver"
	help
	  Enable infrared driver.

if INFRARED

module = INFRARED
module-str = INFRARED
source "subsys/logging/Kconfig.template.log_config"

config INFRARED_SHELL
	bool "INFRARED Shell"
	default y
	depends on SHELL
	help
	  Enable INFRARED Shell for testing.

config INFRARED_CSK6
	bool "listenai CSK6 device id"
	default y
	depends on HAS_CSK6
	help
	  Enable CSK6 INFRARED driver

endif
```

## drivers/pinmux/Kconfig.csk6
```kconfig
# Copyright (c) 2021 listenai Systems (anhui) Co., Ltd.
# SPDX-License-Identifier: Apache-2.0

config PINMUX_CSK6
	bool "CSK6 PINMUX driver"
	default y
	depends on HAS_CSK6
	help
	  Enable driver for CSK6 PINMUX driver.
```

## drivers/pwm/Kconfig.csk6
```kconfig
# Copyright (c) 2021 listenai Systems (anhui) Co., Ltd.
# SPDX-License-Identifier: Apache-2.0

config PWM_CSK6
	bool "CSK6 PWM driver"
	depends on HAS_CSK6
	select HAS_CSK6_GPT
	default y
	help
	  This option enables the PWM driver for CSK6. Say y if you wish to use PWM port on CSK6.
```

## drivers/pwm/Kconfig.csk6_ch32v003
```kconfig
# Copyright (c) 2021 listenai Systems (anhui) Co., Ltd.
# SPDX-License-Identifier: Apache-2.0

config PWM_CSK6_CH32V003
	bool "CSK6 CH32V003 PWM driver"
	depends on HAS_CSK6
	select I2C
	select CSK6_EXMCU
	default n
	help
		CSK6 CH32V003 PWM driver

config PWM_CSK6_CH32V003_INIT_PRIORITY
	int "CSK6 CH32V003 PWM driver priority"
	depends on PWM_CSK6_CH32V003
	default 52
	help
		CSK6 CH32V003 PWM driver priority

config PWM_CSK6_CH32V003_DTG
	hex "CSK6 CH32V003 deadtime register value"
	depends on PWM_CSK6_CH32V003
	range 0 0xFF
	default 0
	help
	  CSK6 CH32V003 deadtime register value

config PWM_CSK6_CH32V003_BRAKE
	bool "CSK6 CH32V003 brake enable"
	depends on PWM_CSK6_CH32V003_DTG > 0
	default n
	help
	  CSK6 CH32V003 deadtime register value
```

## drivers/rtc/Kconfig.pcf8563
```kconfig
# NXP PCF8563 RTC

# Copyright (c) 2019-2023 Henrik Brix Andersen <henrik@brixandersen.dk>
# SPDX-License-Identifier: Apache-2.0

config RTC_PCF8563
	bool "NXP PCF8563 RTC driver"
	default n
	select I2C
	help
	  Enable the NXP PCF8563 RTC driver.

if RTC_PCF8563

choice RTC_PCF8563_OFFSET_MODE
	prompt "Offset mode"
	default RTC_PCF8563_OFFSET_MODE_SLOW
	depends on RTC_CALIBRATION
	help
	  Offset register mode selection.

config RTC_PCF8563_OFFSET_MODE_SLOW
	bool "Slow"
	help
	  Offset correction is made once per two hours and then correction pulses are applied once
	  per minute until the programmed correction values have been implemented (MODE = 0).

config RTC_PCF8563_OFFSET_MODE_FAST
	bool "Fast"
	help
	  Offset correction is made once per minute and then correction pulses are applied once per
	  second up to a maximum of 60 pulses. When correction values greater than 60 pulses are
	  used, additional correction pulses are made in the 59th second (MODE = 1).

endchoice

if RTC_ALARM || RTC_UPDATE

config RTC_PCF8563_THREAD_STACK_SIZE
	int "Stack size for the PCF8563 interrupt thread"
	default 512
	help
	  Size of the stack used for the thread handling interrupts and dispatching callbacks.

config RTC_PCF8563_THREAD_PRIO
	int "Priority for the PCF8563 interrupt thread"
	default 0
	help
	  Priority level for the thread handling interrupts and dispatching callbacks.

endif # RTC_ALARM || RTC_UPDATE

endif # RTC_PCF8563
```

## drivers/serial/Kconfig.csk6
```kconfig
# SPDX-License-Identifier: Apache-2.0

config UART_CSK6
	bool "CSK6 UART driver"
	default y
	select SERIAL_HAS_DRIVER
	select SERIAL_SUPPORT_INTERRUPT
	select PINMUX
	depends on HAS_CSK6
	help
	  Enable the csk6 UART driver.
```

## drivers/spi/Kconfig.csk6
```kconfig
# SPDX-License-Identifier: Apache-2.0

menuconfig SPI_CSK6
	bool "CSK6 SPI driver"
	default y
	depends on HAS_CSK6
	help
	  Enable the csk6 SPI driver.

if SPI_CSK6

config SPI_TX_DMA
	bool "Enable SPI TX DMA"
	default y
	select DMA

config SPI_RX_DMA
	bool "Enable SPI RX DMA"
	default y
	select DMA

config SPI_TX_RX_DMA_FAST_RELOAD
	bool "Enable SPI TX RX DMA fast reload"
	default n
	depends on SPI_TX_DMA
	depends on SPI_RX_DMA
	help
		Enable SPI TX RX DMA fast reload

endif #SPI_CSK6
```

## drivers/spi/Kconfig.csk6_fake
```kconfig
# SPDX-License-Identifier: Apache-2.0

menuconfig SPI_CSK6_FAKE
	bool "CSK6 Fake SPI driver"
	default n
	depends on HAS_CSK6
	depends on SOC_LS_ADSP_CSK6
	help
	  Enable the csk6 SPI driver.

if SPI_CSK6_FAKE


endif #SPI_CSK6_FAKE
```

## drivers/usb/device/Kconfig
```kconfig
if USB_DEVICE_DRIVER

config USB_DC_CSK6
	bool "USB device controller driver for CSK6 devices"
	default y
	depends on HAS_CSK6
	help
	  Enable USB support on the csk6 processors.

config USB_DC_CSK6_THREAD_STACK_SIZE
	int "USBD thread stack size"
	default 1024
	depends on USB_DC_CSK6
	help
	  Size of the stack for the work queue thread that is used in the driver
	  for handling the events from the USBD ISR, i.e. executing endpoint
	  callbacks and providing proper notifications to the USB device stack.

config USB_DC_CSK6_THREAD_COOP_PRIO
	int "USBD thread cooperative priority"
	range 0 NUM_COOP_PRIORITIES
	default 2
	depends on USB_DC_CSK6
	help
	   Priority of the driver's thread. The smaller the number, the higher the priority,

if USB_MCUX



endif # USB_MCUX


endif # USB_DEVICE_DRIVER
```
