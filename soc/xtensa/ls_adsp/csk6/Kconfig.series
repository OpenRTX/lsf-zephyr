## soc/xtensa/ls_adsp/csk6/Kconfig.series
```kconfig
# Copyright (c) 2021 ListenAI
# SPDX-License-Identifier: Apache-2.0

config SOC_SERIES_LS_CSK6
	bool "LS CSK6"
	select SOC_FAMILY_LS_ADSP
	select XTENSA
	select XTENSA_RESET_VECTOR
	select XTENSA_USE_CORE_CRT1
	select ATOMIC_OPERATIONS_BUILTIN
	help
	  ListenAI CSK6
```

## soc/xtensa/ls_adsp/csk6/Kconfig.soc
```kconfig
# Copyright (c) 2021 ListenAI
# SPDX-License-Identifier: Apache-2.0

choice
	prompt "LS CSK SoC Selection"

	config SOC_LS_ADSP_CSK6
		bool "ListenAI CSK6 SoC"
		depends on SOC_SERIES_LS_CSK6
		select HAS_CSK6
		select PINCTRL

endchoice


config HAS_CSK6
	bool
	depends on SOC_LS_ADSP_CSK6
	

DT_NODE_SRAM := $(dt_nodelabel_path,sram0)
DT_NODE_SOF := $(dt_nodelabel_path,sram1)

config RAM_SIZE
	int
	default $(dt_node_reg_size_int,$(DT_NODE_SRAM))

config RAM_BASE_ADDRESS
	hex
	default $(dt_node_reg_addr_hex,$(DT_NODE_SRAM))


config SOF_HEAP_SIZE
	int
	default $(dt_node_reg_size_int,$(DT_NODE_SOF))

config SOF_HEAP_ADDRESS
	hex
	default $(dt_node_reg_addr_hex,$(DT_NODE_SOF))
```

## subsys/usb/class/audio/Kconfig
```kconfig
# USB AUDIO configuration options

# Copyright (c) 2020 Nordic Semiconductor ASA
# SPDX-License-Identifier: Apache-2.0

config USB_DEVICE_AUDIO
	bool "USB Audio Device Class Driver"
	help
	  USB Audio Device Class driver.
	  Zephyr USB Audio Class is considered experimental
	  and not full.
	  Device configuration is done via dt overlay.

if USB_DEVICE_AUDIO

module = USB_AUDIO
module-str = USB Audio
source "subsys/logging/Kconfig.template.log_config"


config USB_DEVICE_AUDIO_MIN_VOLUME
	int "USB Audio Device Min Volume"
	default 0

config USB_DEVICE_AUDIO_MAX_VOLUME
	int "USB Audio Device Max Volume"
	default 32767

config USB_DEVICE_AUDIO_RES_VOLUME
	int "USB Audio Device Max Volume"
	default 1

endif #USB_DEVICE_AUDIO
```

## tests/boards/listenai_csk6/qspi/testcase.yaml
```yaml
tests:
  boards.csk6.flash:
    platform_allow: csk6002_9s_nano csk6002_c3_nano
    tags: flash
```

## tests/boards/listenai_csk6/sdtest/testcase.yaml
```yaml
tests:
  drivers.baords.csk6.sdtest:
    depends_on: sdmmc
    tags: drivers sdmmc
    platform_allow: csk6002_9s_nano 
    harness: ztest
    harness_config:
      fixture: sdcard
    
```

## tests/boards/listenai_csk6/wifi/testcase.yaml
```yaml
tests:
  tests.boards.listenai_csk6.wifi:
    depends_on: csk_wifi
    tags: drivers csk_wifi
    timeout: 300
    platform_allow: csk6002_c3_nano csk6011a_9s_nano csk6011a_c3_nano
```

## tests/boards/listenai_csk6/wifi_mgr_behavior/testcase.yaml
```yaml
common:
  depends_on: csk_wifi
tests:
  lib.wifimanager:
    platform_allow: csk6002_c3_nano csk6011a_9s_nano csk6011a_c3_nano
    timeout: 300
    tags: lib wifimanager
```

## tests/crypto/csk_mtls_alt/mbedtls/testcase.yaml
```yaml
common:
  min_flash: 65
  min_ram: 36
  tags: crypto mbedtls
  timeout: 400
tests:
  crypto.csk_mtls_alt.mbedtls:
    depends_on: crypto
    platform_allow: csk6002_9s_nano csk6002_c3_nano
```

## tests/drivers/boards/csk6/wifi/testcase.yaml
```yaml
tests:
  drivers.boards.csk6.wifi:
    depends_on: csk_wifi
    tags: drivers csk_wifi
    platform_allow: csk6002_9s_nano csk6002_c3_nano
```

## tests/drivers/dma/chan_blen_transfer/boards/csk6002_9s_nano.conf
```kconfig
CONFIG_DMA_TRANSFER_DRV_NAME="DMA_0"
CONFIG_DMA_TRANSFER_CHANNEL_NR_0=0
CONFIG_DMA_TRANSFER_CHANNEL_NR_1=0
```

## tests/drivers/dma/loop_transfer/boards/csk6002_9s_nano.conf
```kconfig
CONFIG_DMA_LOOP_TRANSFER_DRV_NAME="DMA_0"
CONFIG_DMA_LOOP_TRANSFER_CHANNEL_NR=4
CONFIG_HEAP_MEM_POOL_SIZE=16384
CONFIG_NOCACHE_MEMORY=y
```

## tests/drivers/ipm/testcase.yaml
```yaml
tests:
  drivers.ipc.mailbox:
    arch_exclude: posix xtensa
    platform_exclude: csk6002_9s_nano csk6002_c3_nano csk6011a_nano csk6011a_9s_nano csk6011a_c3_nano csk6012_nano csk6012_9s_nano csk6012_c3_nano
    tags: drivers ipc
```

## tests/drivers/pwm/pwm_api/testcase.yaml
```yaml
tests:
  drivers.pwm:
    tags: drivers pwm userspace
    platform_exclude: csk6002_9s_nano csk6002_c3_nano csk6011a_nano csk6011a_9s_nano csk6011a_c3_nano csk6012_nano csk6012_9s_nano csk6012_c3_nano
    filter: dt_alias_exists("pwm-0") or
            dt_alias_exists("pwm-1") or
            dt_alias_exists("pwm-2") or
            dt_alias_exists("pwm-3") or
            dt_compat_enabled("st,stm32-pwm")
    depends_on: pwm
```

## tests/drivers/spi/spi_loopback/boards/csk6002_c3_nano.conf
```kconfig
#
# SPDX-License-Identifier: Apache-2.0
#

CONFIG_ARM_MPU=n
CONFIG_HEAP_MEM_POOL_SIZE=10240
CONFIG_SPI_LOOPBACK_DRV_NAME="SPI_0"
```

## west.yml
```yaml
manifest:
  defaults:
    remote: listenai
  remotes:
    - name: listenai
      url-base: https://cloud.listenai.com/zephyr
    - name: scanpen_csk6_samples
      url-base: https://cloud.listenai.com/scanpen/csk6/samples/
    - name: lsf
      url-base: https://cloud.listenai.com/listenai/lsf-dev
    - name: scanpen_capabilities
      url-base: https://cloud.listenai.com/scanpen/capability
  projects:
    - name: zephyr
      repo-path: zephyr_downstream
      revision: f525c4d507d35b554008d32c69b8775249039b9a
      import:
        name-allowlist:
          - cmsis
          - mbedtls
    - name: csk6_cm33
      url: https://cloud.listenai.com/listenai/driver/csk6_cm33
      revision: 234a77af1b32a9b0f325df7ae2e031563497f0dd
      path: modules/hal/listenai/csk6_cm33
      groups:
        - hal
    - name: libmetal
      remote: listenai
      revision: 05bdf74c271cceba33385cb8b6793448b25ab4ec
      path: modules/hal/libmetal
      groups:
        - hal
    - name: protobuf-c
      remote: listenai
      revision: 033eb51d64cde459bcbd69c5ab5e09267975485e
      path: modules/lib/protobuf-c
    # - name: esp-hosted
    #   remote: listenai
    #   revision: c3e711fb857026a3017efac4c2c0c51f1846c855
    #   path: modules/lib/esp-hosted
    - name: mcuboot
      remote: listenai
      revision: 800a13229206735951848c69de25094d23725471
      path: bootloader/mcuboot
    - name: licak
      remote: listenai
      revision: v1.2.1
      path: modules/lib/licak
      clone-depth: 1
    - name: lisa_player
      remote: listenai
      revision: 0c05072250e56642a2354561fbc520ae3db479a6
      path: modules/lib/listenai/lisa_player
    - name: zport_sal
      remote: listenai
      revision: 746484202173ac51ce45d3017f9ea7e08e271727
      path: modules/lib/listenai/zport_sal
    - name: zport_esp
      remote: listenai
      revision: 60e258e642acb303c1f210c0e8ab6e52845e0383
      path: modules/lib/listenai/zport_esp
    - name: wifi_manager
      remote: listenai
      revision: 3452e5ba40beb657d287ff5e86d39f18883568a1
      path: modules/lib/wifi_manager
    - name: lvgl
      remote: listenai
      revision: ee0da287dd709e096655249d23d239dd6baf7ade
      path: modules/lib/gui/lvgl
      groups:
        - lvgl
    - name: csk_sqlite3
      remote: listenai
      revision: 5537947a8cb2cc029ba59bf88dbdbc0c68e01dd4
      path: modules/lib/csk_sqlite3
    - name: fatfs
      remote: listenai
      revision: 00316e7d4a41b1d4c0b492c94659b08b4fd63e9f
      path: modules/fs/fatfs
      groups:
        - fs
```
