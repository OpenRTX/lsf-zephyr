## dts/bindings/i2c/listenai,csk-i2c-ch32v003.yaml
```yaml
# SPDX-License-Identifier: Apache-2.0

description: CSK I2C node

compatible: "listenai,csk-i2c-ch32v003"

include: [i2c-device.yaml]

properties:
    reg:
      required: true
```

## dts/bindings/i2c/listenai,csk-i2c.yaml
```yaml
# SPDX-License-Identifier: Apache-2.0

description: CSK I2C node

compatible: "listenai,csk-i2c"

include: [i2c-controller.yaml, pinctrl-device.yaml]

properties:
    reg:
      required: true

    interrupts:
      required: true
```

## dts/bindings/infrared/listenai,csk-ir.yaml
```yaml
#
# Copyright (c) 2023 Anhui(Shenzhen) Listenai Co., Ltd.
#
# SPDX-License-Identifier: Apache-2.0
#

description: CSK IR

compatible: "listenai,csk-ir"

include: [base.yaml, pinctrl-device.yaml]

properties:
    interrupts:
      required: true
```

## dts/bindings/ipm/listenai,csk-mailbox.yaml
```yaml
# Copyright (c) 2021, ListenAI
# SPDX-License-Identifier: Apache-2.0

description: CSK MAILBOX

compatible: "listenai,csk-mailbox"

include: base.yaml

properties:
  reg:
      required: true

  interrupts:
      required: true

  label:
      required: true
```

## dts/bindings/kscan/betterlife,bl6xxx.yaml
```yaml
# Copyright (c) 2022 listenai
# SPDX-License-Identifier: Apache-2.0

description: BL6XXX capacitive touch panels

compatible: "betterlife,bl6xxx"

include: [kscan.yaml, i2c-device.yaml]

properties:
    int-gpios:
      type: phandle-array
      required: true
    reset-gpios:
      type: phandle-array
      required: false
```

## dts/bindings/kscan/listenai,csk-keysense.yaml
```yaml
# Copyright (c) 2022 listenai
# SPDX-License-Identifier: Apache-2.0

description: csk6 keysense driver

compatible: "listenai,csk-keysense"

include: [kscan.yaml, pinctrl-device.yaml]

properties:
    reg:
      required: true

    interrupts:
      required: true

    analogkey-trigger:
      type: array
      required: true
```

## dts/bindings/kscan/solomon,spd2010-kscan.yaml
```yaml
# Copyright (c) 2022 listenai
# SPDX-License-Identifier: Apache-2.0

description: spd2012 capacitive touch panels

compatible: "solomon,spd2010-kscan"

include: [kscan.yaml, i2c-device.yaml]

properties:
    int-gpios:
      type: phandle-array
      required: false
    reset-gpios:
      type: phandle-array
      required: false
```

## dts/bindings/kscan/solomon,spd2010.yaml
```yaml
# Copyright (c) 2022 listenai
# SPDX-License-Identifier: Apache-2.0

description: spd2012 capacitive touch panels

compatible: "solomon,spd2010"

include: [kscan.yaml, i2c-device.yaml]

properties:
    int-gpios:
      type: phandle-array
      required: true
    reset-gpios:
      type: phandle-array
      required: false
```

## dts/bindings/mmc/listenai,csk-sdmmc.yaml
```yaml
# SPDX-License-Identifier: Apache-2.0

description: csk sdmmc disk access

compatible: "listenai,csk-sdmmc"

include: [mmc.yaml, pinctrl-device.yaml]

properties:
  reg:
    required: true

  label:
    required: true

  interrupts:
    required: true

  pinctrl-0:
    required: true

  pinctrl-names:
    required: true
```

## dts/bindings/pinctrl/listenai,csk6-pinctrl.yaml
```yaml
# Copyright (c) 2021 ITE Corporation. All Rights Reserved.
# SPDX-License-Identifier: Apache-2.0
compatible: "listenai,csk-pinctrl"

include:
    - name: base.yaml
    - name: pincfg-node.yaml
      child-binding:
        property-allowlist:
          - bias-high-impedance
          - bias-pull-pin-default
          - bias-pull-up
          - bias-pull-down
          - input-enable

child-binding:
    description: |
        This binding gives a base representation of the CSK6 pins configration.
    properties:
        pinctrls:
          required: false
          type: phandle-array
          description: |
              CSK6 pin's configuration (pinctrl node, pin and function).
```

## dts/bindings/pinctrl/listenai,csk6-pinmux.yaml
```yaml
# SPDX-License-Identifier: Apache-2.0

description: LISTENAI CSK6 pinmux (aka IOCON) node

compatible: "listenai,csk-pinmux"

include: base.yaml

properties:
    reg:
      required: true

    "#pinmux-cells":
      type: int
      required: true
      const: 2
      description: Number of items in a pinmux specifier

pinmux-cells:
  - pin
  - function

pinctrl-cells:
  - pin
  - alt_func
```

## dts/bindings/pinctrl/listenai,csk6001-pinctrl.yaml
```yaml
# Copyright (c) 2021 ITE Corporation. All Rights Reserved.
# SPDX-License-Identifier: Apache-2.0
include: [base.yaml, pincfg-node.yaml]

description: LISTENAI CSK600x Pin controller Node

compatible: "listenai,csk-pinctrl"

child-binding:
    description: CSK Pinmux configuration child node
    properties:
        pinctrls:
            type: phandle-array
            required: false
            description: Pin alternate function selection
```

## dts/bindings/pwm/listenai,csk-ch32v003-pwm.yaml
```yaml
# Copyright (c) 2022 LISTENAI (ShenZhen) Co., Ltd.
# SPDX-License-Identifier: Apache-2.0

description: CSK CH32V003 PWM

compatible: "listenai,csk-ch32v003-pwm"

include: [pwm-controller.yaml, base.yaml, pinctrl-device.yaml]

properties:

    label:
      required: true

    clock-frequency:
      type: int
      required: true
      default: 48000000
      description: Config Pwm Clock Source. default 48Mhz

    clock-prescaler:
      type: int
      required: false
      default: 1
      description: PWM Peripheral Clock Prescaler.

    "#pwm-cells":
      const: 4

pwm-cells:
  - channel
  - period
  - flags
  - deadtime
```

## dts/bindings/pwm/listenai,csk-pwm.yaml
```yaml
description: CSK6 PWM

compatible: "listenai,csk-pwm"

include: [pwm-controller.yaml, base.yaml, pinctrl-device.yaml]

properties:
    label:
      required: true

    clock-source:
      type: int
      required: false
      default: 1
      enum:
       - 1
       - 2
       - 3
      description: Config Pwm Clock Source. 1 for Peripheral Clock(200Mhz), 2 for External Clock(12Mhz) , 3 for Crystal Clock(24Mhz)

    mode:
      type: int
      required: false
      default: 1
      enum:
       - 1
       - 2
      description: PWM OutPut Mode. 1 for EDGE_ALIGNED, 2 for CENTRAL_ALIGNED.

    clock-prescaler:
      type: int
      required: false
      default: 1
      enum:
       - 1
       - 2
       - 4
       - 8
       - 16
       - 32
       - 64
       - 128
      description: PWM Peripheral Clock Prescaler.

    "#pwm-cells":
      const: 2

pwm-cells:
  - channel
  - flags
```

## dts/bindings/rtc/bm8563.yaml
```yaml
#
# Copyright (c) 2019 Peter Bigot Consulting, LLC
#
# SPDX-License-Identifier: Apache-2.0
#

description: BM8563 I2C RTC/TCXO

compatible: "bm8563"

include: i2c-device.yaml

properties:
  reg:
    required: true

  32k-gpios:
    type: phandle-array
    required: false
    description: |

      32 KiHz open drain output

      The BM8563 defaults to providing a 32 KiHz square wave on this
      signal.  The driver does not make use of this, but applications
      may want access.

  int-gpios:
    type: phandle-array
    required: false
    description: |

      interrupt/square wave open drain output

      The BM8563 uses this signal to notify when an alarm has triggered,
      and also to produce a square wave aligned to the countdown chain.
      Both capabilities are used within the driver.  This signal must be
      present to support time set and read operations that preserve
      sub-second accuracy.
```

## dts/bindings/spi/listenai,csk-spi.yaml
```yaml
# Copyright (c) 2018, I-SENSE group of ICCS
# SPDX-License-Identifier: Apache-2.0

description: listenai csk spi controller

include: [spi-controller.yaml, pinctrl-device.yaml]

compatible: "listenai,csk-spi"

properties:
    reg:
      required: true

    interrupts:
      required: true

    spi-max-frequency:
      type: int
      required: false
      description: spi-max-frequency
```

## dts/bindings/sram/listenai,csk6-psram.yaml
```yaml
description: |
  CSK6 psram

compatible: "listenai,csk6-psram"

include: "mmio-sram.yaml"

child-binding:
  description: csk6 psram partions
  compatible: "listenai,csk6-psram-partition"
  include: "mmio-sram.yaml"
```

## dts/bindings/timer/listenai.gpttimer.yaml
```yaml
# Copyright (c) 2022 LISTENAI (ShenZhen) Co., Ltd.
# SPDX-License-Identifier: Apache-2.0

description: listenai gptimer peripheral

compatible: "listenai,csk-gpt"

include: base.yaml

properties:
    reg:
      required: true

    interrupts:
      required: true

    label:
      required: true
      
    gptfreq:
      type: int
      required: true
      description: gpt frequences

    pwm-channels:
      required: true
      type: int
      description: |
        Number of channels occupied by pwm. The timer has a total of eight channels,which can be shared by PWM and the timer. 
        This field defines the number of channels used for PWM, and the remaining channels are all used as csk-gpttmr.
      enum:
        - 0
        - 1
        - 2
        - 3
        - 4
        - 5
        - 6
        - 7
        - 8 
```

## dts/bindings/usb/listenai,csk-usbd.yaml
```yaml
# Copyright (c) 2021 listenai Intelligent Technology (anhui) Co., Ltd.
# SPDX-License-Identifier: Apache-2.0

description: |
    Listenai CSK USBFSOTG Controller in device mode

compatible: "listenai,csk-usbd"

include: usb-ep.yaml

properties:
    reg:
      required: true

    interrupts:
      required: true
```

## dts/bindings/video/byd,bf30a2.yaml
```yaml
# Copyright (c) 2022, listenai
# SPDX-License-Identifier: Apache-2.0

description: 1/15 inch QVGA CMOS Image Sensor

compatible: "byd,bf30a2"

properties:
    pd-gpios:
      type: phandle-array
      required: true
      description: pd-gpios
    pwr-gpios:
      type: phandle-array
      required: true
      description: power-gpios
    product-id:
      type: int
      required: false
      description: product-id
    csk6-spec:
      type: boolean
      required: false
      description: csk6-spec
    label:
      type: string
      required: true
      description: label
    reg :
      type: array
      required: true
      description: reg
    spi:
      type: phandle
      required: false
      description: spi-bus
    pwms:
      type: phandle-array
      required: true
      description: pwm output to xclk
    xclk-freq:
      type: int
      required: true
      description: xclk-freq

include: i2c-device.yaml
```

## dts/bindings/video/galaxyc,gc032a.yaml
```yaml
# SPDX-License-Identifier: Apache-2.0

description: GC032A CMOS video sensor

compatible: "galaxyc,gc032a"

properties:
    reset-gpios:
      type: phandle-array
      required: false
      description: |
        The RESET pin is asserted to disable the sensor causing a hard
        reset.  The sensor receives this as an active-low signal.

    pwdn-gpios:
      type: phandle-array
      required: false
      description: |
        The PWDN pin is asserted to disable the sensor causing a power
        down.  The sensor receives this as an active-high signal.

include: i2c-device.yaml
```

## dts/bindings/video/listenai,csk-dvp.yaml
```yaml
# Copyright (c) 2022, listenai
# SPDX-License-Identifier: Apache-2.0

description: listenai csk dvp controller

include: [base.yaml, pinctrl-device.yaml]

compatible: "listenai,csk-dvp"

properties:
    reg:
      required: true

    interrupts:
      required: true

    sensor-label:
      required: true
      type: string
      description: |
        label of connected sensor device

    clock-prescaler:
      type: int
      required: false
      description: |
        Prescaler of clock to dvp sensor. Clock Freq = 150MHz/clock-prescaler
        Perhaps the sensor's clock source is obtained elsewhere, so this option is not required

    data-align-type:
      type: string
      required: true
      description: |
        Interface has data bus pin D0~D11. When the number of actual buses 
        in use is less than 12, we can choose to use the high or low part 
        of the actual pin bus
      enum:
        - "low_align"
        - "high_align"

    pclk-polarity:
      type: string
      required: true
      enum:
        - "post_edge_sampling"
        - "negative_edge_sampling"

    hsync-polarity:
      type: string
      required: true
      enum:
        - "active_high"
        - "active_low"

    vsync-polarity:
      type: string
      required: true
      enum:
        - "active_high"
        - "active_low"
```

## dts/bindings/video/ovti,ov9655.yaml
```yaml
# Copyright (c) 2022, listenai
# SPDX-License-Identifier: Apache-2.0

description: OV9655 CMOS video sensor

compatible: "ovti,ov9655"

properties:
    reset-gpios:
      type: phandle-array
      required: false
      description: |
        The RESET pin is asserted to disable the sensor causing a hard
        reset.  The sensor receives this as an active-low signal.

    pwdn-gpios:
      type: phandle-array
      required: false
      description: |
        The PWDN pin is asserted to disable the sensor causing a power
        down.  The sensor receives this as an active-high signal.

include: i2c-device.yaml
```

## dts/bindings/video/smartsens,sco30iot.yaml
```yaml
# SPDX-License-Identifier: Apache-2.0

description: SCO30IOT CMOS video sensor

compatible: "smartsens,sco30iot"

properties:
    reset-gpios:
      type: phandle-array
      required: false
      description: |
        The RESET pin is asserted to disable the sensor causing a hard
        reset.  The sensor receives this as an active-low signal.

    pwdn-gpios:
      type: phandle-array
      required: false
      description: |
        The PWDN pin is asserted to disable the sensor causing a power
        down.  The sensor receives this as an active-high signal.

include: i2c-device.yaml
```

## dts/bindings/watchdog/csk,6-watchdog.yaml
```yaml
# Copyright (c) 2022 listenai
# SPDX-License-Identifier: Apache-2.0

description: listenai csk6 watchdog

compatible: "listenai,csk6-watchdog"

include: base.yaml

properties:
    reg:
      required: true

    label:
      required: true
```
