## dts/bindings/wifi/espressif,esp-hosted.yaml
```yaml
# SPDX-License-Identifier: Apache-2.0

description: esp-hosted wifi module

compatible: "espressif,esp-hosted"

include: [spi-device.yaml]

properties:
    dataready-gpios:
      type: phandle-array
      required: true

    handshake-gpios:
      type: phandle-array
      required: true

    reset-gpios:
      type: phandle-array
      required: true

    label:
      required: true
      type: string
```

## dts/bindings/wifi/wifi,xr819s.yaml
```yaml
# SPDX-License-Identifier: Apache-2.0

description: xr819s wifi module

compatible: "wifi,xr819s"

properties:
    dataready-gpios:
      type: phandle-array
      required: true

    reset-gpios:
      type: phandle-array
      required: true

    sdio-clk-gpios:
      type: phandle-array
      required: true

    sdio-cmd-gpios:
      type: phandle-array
      required: true

    sdio-dat0-gpios:
      type: phandle-array
      required: true

    label:
      required: true
      type: string
```

## modules/Kconfig.wifi_manager
```kconfig
# SPDX-License-Identifier: Apache-2.0

menuconfig WIFI_MANAGER
	bool "WiFi Manager Support"
	select NVS
	select FLASH
	select FLASH_PAGE_LAYOUT
	select FLASH_MAP
	select MPU_ALLOW_FLASH_WRITE


if WIFI_MANAGER

	config WIFI_MGR_WORKQ_STACK
		int "WiFi Manager Workq Stack"
		default 1024

	config WIFI_MGR_WORKQ_PRIORITY
		int "WiFi Manager Workq priority"
		default 5

	module = WIFI_MANAGER
	module-str = wifi_manager
	source "subsys/logging/Kconfig.template.log_config"
endif #WIFI_MANAGER
```

## modules/Kconfig.xradio_819s
```kconfig
# SPDX-License-Identifier: Apache-2.0

menuconfig XR819S
	bool "XR819S support"


if XR819S

menu "Threads Configuration"

config XR_UMAC_STACK
	int "XR819S uamc Thread Stack"
	default 2048

config XR_UMAC_PRIORITY
	int "XR819S uamc Thread priority"
	default 0

config XR_WPAS_STACK
	int "XR819S wpas Thread Stack"
	default 3072

config XR_WPAS_PRIORITY
	int "XR819S wpas Thread priority"
	default 0

config XR_WORKQUEUE_STACK
	int "XR819S workqueue Thread Stack"
	default 2048

config XR_WORKQUEUE_PRIORITY
	int "XR819S workqueue Thread priority"
	default 0

config XR_BH_STACK
	int "XR819S BH Thread Stack"
	default 2048

config XR_BH_PRIORITY
	int "XR819S BH Thread priority"
	default -1

config XR_WLAN_RESET_STACK
	int "XR819S wlan_reset Thread Stack"
	default 2048

config XR_WLAN_RESET_PRIORITY
	int "XR819S wlan_reset Thread priority"
	default -2

config XR_RX_PROC_STACK
	int "XR819S rx_proc Thread Stack"
	default 2048

config XR_RX_PROC_PRIORITY
	int "XR819S rx_proc Thread priority"
	default 1

config XR_OSTIMER_WORKQ_STACK
	int "OS Timer Workq Stack Size"
	default 2048

config XR_GPIO_WORKQ_STACK
	int "GPIO Workq Stack Size"
	default 2048

config XR_SDD_FILE
	string "Path to XR819S SDD File"
	help
	  XR819s SDD file

endmenu  #Threads Configuration

endif # XR819S
```

## modules/esp-hosted/Kconfig
```kconfig
# SPDX-License-Identifier: Apache-2.0

menuconfig ESP_HOSTED
	bool "ESP-Hosted support"
	select PROTOBUF_C

if ESP_HOSTED

config HOSTED_INIT_TIMEOUT
	int "Hosted Init Timeout(s)"
	default 3

config HOSTED_TRANSACTION_STACK
	int "Hosted Transaction Thread Stack"
	default 2048

config HOSTED_TRANSACTION_PRIORITY
	int "Hosted Transaction Thread priority"
	default -1

config HOSTED_PROCESS_RX_STACK
	int "Hosted Processing Thread Stack"
	default 2048

config HOSTED_PROCESS_RX_PRIORITY
	int "Hosted Processing Thread priority"
	default -1

config HOSTED_TX_QUEUE_LEN
	int "Hosted TX Queue Len"
	default 30

config HOSTED_RX_QUEUE_LEN
	int "Hosted RX Queue Len"
	default 30

config HOSTED_SERIALIF_QUEUE_LEN
	int "Hosted Serial if queue len"
	default 50

config HOSTED_NETIF_QUEUE_LEN
	int "Hosted Net if queue len"
	default 50

config HOSTED_PSRAM_BUFFER
    bool "Hosted PSRAM Buffer"
    default n
    depends on  CSK6_PSRAM

config HOSTED_BUFFER_HEAP_SIZE
    int "Hosted buffer heap size"
    default 48000
    help
        The size should be multiple times of 1600, when the times is equal to
        HOSTED_RX_QUEUE_LEN / HOSTED_TX_QUEUE_LEN, it could get a better performance.

endif # ESP_HOSTED
```

## samples/boards/csk6/apps/lisa_porting/Kconfig
```kconfig
# SPDX-License-Identifier: Apache-2.0

menu "Example Configuration"

    config EXAMPLE_WIFI_SSID
        string "WiFi SSID"
        default "TreeNewbear"
        #default "TP-LINK_LINGSI"

    config EXAMPLE_WIFI_PASSWORD
        string "WiFi password"
        default "csk_wifi_connect"
        #default "a123456789"

endmenu

config LISA_HEAP_ARENA_SIZE
	int "Size of the lisa mem malloc arena"
	default 0
	help
	  Indicate the size in bytes of the memory arena used for
	  lisa_mem's malloc() implementation.



source "Kconfig.zephyr"
```

## samples/boards/csk6/apps/lisa_porting/sample.yaml
```yaml
tests:
  sample.board.csk6.apps.lisa_porting:
    platform_allow: csk6002_c3_nano csk6002_9s_nano csk6011a_9s_nano
    tags: csk6
```

## samples/boards/csk6/apps/scanpen_ai/remote/boards/xtensa/csk6011a_s3_dytx/Kconfig.board
```kconfig
# Xtensa board configuration

# Copyright (c) 2021 ListenAI
# SPDX-License-Identifier: Apache-2.0

config  BOARD_CSK6011A_S3_DYTX
	bool "CSK6011A_S3_DYTX"
```

## samples/boards/csk6/apps/scanpen_ai/remote/boards/xtensa/csk6011a_s3_dytx/Kconfig.defconfig
```kconfig
# Copyright (c) 2021 ListenAI
#
# SPDX-License-Identifier: Apache-2.0

if BOARD_CSK6011A_S3_DYTX

config BOARD
	default "csk6011a_s3_dytx"

endif # BOARD_CSK6011A_S3_DYTX
```

## samples/boards/csk6/apps/scanpen_ai/remote/boards/xtensa/csk6011a_scanpen_dspcase/Kconfig.board
```kconfig
# Xtensa board configuration

# Copyright (c) 2021 ListenAI
# SPDX-License-Identifier: Apache-2.0

config  BOARD_CSK6011A_SCANPEN_DSPCASE
	bool "CSK6011A_SCANPEN_DSPCASE"
```

## samples/boards/csk6/apps/scanpen_ai/remote/boards/xtensa/csk6011a_scanpen_s3_tianhe/Kconfig.defconfig
```kconfig
# Copyright (c) 2021 ListenAI
#
# SPDX-License-Identifier: Apache-2.0

if BOARD_CSK6011A_SCANPEN_S3_TIANHE

config BOARD
	default "csk6011a_scanpen_s3_tianhe"

endif # BOARD_CSK6011A_SCANPEN_S3_TIANHE
```

## samples/boards/csk6/apps/scanpen_ai/remote/boards/xtensa/csk6011a_xr872_hklt/Kconfig.board
```kconfig
# Xtensa board configuration

# Copyright (c) 2021 ListenAI
# SPDX-License-Identifier: Apache-2.0

config  BOARD_CSK6011A_XR872_HKLT
	bool "CSK6011A_XR872_HKLT"
```

## samples/boards/csk6/apps/scanpen_ai/remote/boards/xtensa/csk6011a_xr872_hklt/Kconfig.defconfig
```kconfig
# Copyright (c) 2021 ListenAI
#
# SPDX-License-Identifier: Apache-2.0

if BOARD_CSK6011A_XR872_HKLT

config BOARD
	default "csk6011a_xr872_hklt"

endif # BOARD_CSK6011A_XR872_HKLT
```

## samples/boards/csk6/apps/scanpen_ai/remote/boards/xtensa/csk6011b_s3_thzy/Kconfig.board
```kconfig
# Xtensa board configuration

# Copyright (c) 2021 ListenAI
# SPDX-License-Identifier: Apache-2.0

config  BOARD_CSK6011B_S3_THZY
	bool "CSK6011B_S3_THZY"
```

## samples/boards/csk6/apps/scanpen_ai/remote/boards/xtensa/csk6011b_s3_thzy/Kconfig.defconfig
```kconfig
# Copyright (c) 2021 ListenAI
#
# SPDX-License-Identifier: Apache-2.0

if BOARD_CSK6011B_S3_THZY

config BOARD
	default "csk6011b_s3_thzy"

endif # BOARD_CSK6011B_S3_THZY
```

## samples/boards/csk6/apps/scanpen_ai/remote/boards/xtensa/csk6011b_scanpen_dspcase/Kconfig.defconfig
```kconfig
# Copyright (c) 2021 ListenAI
#
# SPDX-License-Identifier: Apache-2.0

if BOARD_CSK6011B_SCANPEN_DSPCASE

config BOARD
	default "csk6011b_scanpen_dspcase"

endif # BOARD_CSK6011B_SCANPEN_DSPCASE
```

## samples/boards/csk6/apps/scanpen_ai/remote/boards/xtensa/csk6011b_scanpen_dspcase/csk6011b_scanpen_dspcase_defconfig
```kconfig
# SPDX-License-Identifier: Apache-2.0

CONFIG_MAIN_STACK_SIZE=3072

CONFIG_SOC_SERIES_LS_CSK6=y
CONFIG_CONSOLE=y
CONFIG_UART_CONSOLE=y
CONFIG_SERIAL=y

CONFIG_GEN_ISR_TABLES=y
CONFIG_GEN_IRQ_VECTOR_TABLE=n

CONFIG_XTENSA_RESET_VECTOR=y

CONFIG_XTENSA_USE_CORE_CRT1=y

CONFIG_XTENSA_SMALL_VECTOR_TABLE_ENTRY=y

CONFIG_BUILD_OUTPUT_BIN=y
CONFIG_CLEANUP_INTERMEDIATE_FILES=y

CONFIG_NO_OPTIMIZATIONS=y
CONFIG_HEAP_MEM_POOL_SIZE=4096
```

## samples/boards/csk6/apps/scanpen_ai/remote/boards/xtensa/csk6011b_xxx_cxsd/Kconfig.board
```kconfig
# Xtensa board configuration

# Copyright (c) 2021 ListenAI
# SPDX-License-Identifier: Apache-2.0

config  BOARD_CSK6011B_XXX_CXSD
	bool "CSK6011B_XXX_CXSD"
```

## samples/boards/csk6/apps/scanpen_ai/remote/boards/xtensa/csk6011b_xxx_cxsd/Kconfig.defconfig
```kconfig
# Copyright (c) 2021 ListenAI
#
# SPDX-License-Identifier: Apache-2.0

if BOARD_CSK6011B_XXX_CXSD

config BOARD
	default "csk6011b_xxx_cxsd"

endif # BOARD_CSK6011B_XXX_CXSD
```

## samples/boards/csk6/driver/crypto/aes128_ecb/sample.yaml
```yaml
tests:
  sample.board.csk6.driver.crypto.aes128_ecb:
    platform_allow: csk6002_c3_nano csk6002_9s_nano
    tags: csk6
    timeout: 10
    harness: console
    harness_config:
      type: multi_line
      ordered: true
      regex:
        - "Output length \\(encryption\\): 16"
        - "ECB mode ENCRYPT - Match"
        - "Output length \\(decryption\\): 16"
        - "ECB mode DECRYPT - Match"
```

## samples/boards/csk6/driver/crypto/sample.yaml
```yaml
sample:
  description: An example to illustrate the usage of
    crypto APIs
  name: Crypto APIs
```

## samples/boards/csk6/driver/hwinfo/sample.yaml
```yaml
tests:
  sample.board.csk6.driver.hwinfo:
    platform_allow: csk6011a_nano
    tags: csk6
    harness: console
    timeout: 10
    harness_config:
      type: one_line
      regex:
        - "get device id success"
```

## samples/boards/csk6/driver/i2c/i2c_slave_vdev/common/slave/Kconfig
```kconfig
#
# Copyright (c) 2023 Anhui(Shenzhen) Listenai Co., Ltd.
# SPDX-License-Identifier: Apache-2.0
#

#
# I2C options
#
menuconfig I2C_SLAVE
	bool "I2C Slave Drivers"
	help
	  Enable I2C Slave Driver Configuration

if I2C_SLAVE

config I2C_SLAVE_INIT_PRIORITY
	int "Init priority"
	default 60
	help
	  I2C Slave device driver initialization priority.

config I2C_SLAVE_VIRTUAL_DEVICE
	bool "I2C Slave Virtual Device driver"
	help
	  Enable I2C Slave Virtual Device driver


endif # I2C_SLAVE
```

## samples/boards/csk6/driver/rtc/sample.yaml
```yaml
sample:
  name: rtc 

tests:
  sample.board.csk6.driver.rtc:
    platform_allow: csk6002_c3_nano csk6002_9s_nano csk6011a_nano
    tags: csk6
    timeout: 20
    harness: console
    harness_config:
      type: multi_line
      regex:
        - "^Counter alarm callback at \\d* ms(.*)"
        - "^RTC value: \\d*s$"
```
