## boards/arm/csk6002_9s_nano/Kconfig.board
```kconfig
# SPDX-License-Identifier: Apache-2.0

config BOARD_CSK6002_9S_NANO
   bool "csk6002_9s_nano Board"
   depends on SOC_CSK6001
```

## boards/arm/csk6002_9s_nano/Kconfig.defconfig
```kconfig
if BOARD_CSK6002_9S_NANO

config BOARD
   default "csk6002_9s_nano"

if WIFI

config XR_SDD_FILE
   default "sdd_xr819s_xtal_48.bin"

endif # WIFI

endif # BOARD_CSK6002_9S_NANO
```

## boards/arm/csk6002_9s_nano/csk6002_9s_nano_defconfig
```kconfig
# SPDX-License-Identifier: Apache-2.0

CONFIG_SOC_CSK6=y
CONFIG_BOARD_CSK6002_9S_NANO=y
CONFIG_SYS_CLOCK_HW_CYCLES_PER_SEC=300000000

# console
CONFIG_CONSOLE=y
CONFIG_UART_CONSOLE=y
CONFIG_SERIAL=y
CONFIG_PINMUX=y

CONFIG_MAIN_STACK_SIZE=2048
CONFIG_ISR_STACK_SIZE=2048
CONFIG_HEAP_MEM_POOL_SIZE=2048

CONFIG_FP16=n

CONFIG_ARM_MPU=y
CONFIG_HW_STACK_PROTECTION=y
CONFIG_FPU=n
CONFIG_FP_HARDABI=n
CONFIG_CSK6_PSRAM=n

CONFIG_CSK_WIFI_XR819S=y
```

## boards/arm/csk6002_c3_nano/Kconfig.board
```kconfig
# SPDX-License-Identifier: Apache-2.0

config BOARD_CSK6002_C3_NANO
   bool "csk6 PICO Board"
   depends on SOC_CSK6
```

## boards/arm/csk6002_c3_nano/csk6002_c3_nano_defconfig
```kconfig
# SPDX-License-Identifier: Apache-2.0

CONFIG_BOARD_CSK6002_C3_NANO=y
CONFIG_SOC_CSK6001=y
CONFIG_SYS_CLOCK_HW_CYCLES_PER_SEC=300000000

# console
CONFIG_CONSOLE=y
CONFIG_UART_CONSOLE=y
CONFIG_SERIAL=y
CONFIG_PINMUX=y

CONFIG_MAIN_STACK_SIZE=2048
CONFIG_ISR_STACK_SIZE=2048

CONFIG_FP16=n

CONFIG_ARM_MPU=y
CONFIG_HW_STACK_PROTECTION=y
CONFIG_FPU=n
CONFIG_FP_HARDABI=n
CONFIG_CSK6001_PSRAM=n

CONFIG_CSK_WIFI_ESP32C3=y
```

## boards/arm/csk6011a_9s_nano/Kconfig.board
```kconfig
# SPDX-License-Identifier: Apache-2.0

config BOARD_CSK6011A_9S_NANO
   bool "csk6011a_9s_nano Board"
   depends on SOC_CSK6
```

## boards/arm/csk6011a_9s_nano/Kconfig.defconfig
```kconfig
if BOARD_CSK6011A_9S_NANO

config BOARD
   default "csk6011a_9s_nano"

if WIFI

choice CSK_WIFI_OFFLOAD_MODULE
   prompt "WiFi Offload Module"
   default CSK_WIFI_XR819S

	config CSK_WIFI_ESP32C3
      bool "ESP32C3"

	config CSK_WIFI_XR819S
      bool "XR819S"

endchoice

config XR_SDD_FILE
   default "sdd_xr819s_xtal_48.bin"

endif # WIFI

endif # BOARD_CSK6011A_9S_NANO
```

## boards/arm/csk6011a_9s_scanpen/Kconfig.board
```kconfig
# SPDX-License-Identifier: Apache-2.0

config BOARD_CSK6011A_9S_SCANPEN
   bool "csk6011a_9s_scanpen Board"
   depends on SOC_CSK6
```

## boards/arm/csk6011a_9s_scanpen/Kconfig.defconfig
```kconfig
if BOARD_CSK6011A_9S_SCANPEN

config BOARD
   default "csk6011a_9s_scanpen"

endif # BOARD_CSK6011A_9S_SCANPEN
```

## boards/arm/csk6011a_c3_nano/Kconfig.board
```kconfig
# SPDX-License-Identifier: Apache-2.0

config BOARD_CSK6011A_C3_NANO
   bool "csk6011a_c3_nano Board"
   depends on SOC_CSK6
```

## boards/arm/csk6011a_c3_nano/Kconfig.defconfig
```kconfig
if BOARD_CSK6011A_C3_NANO

config BOARD
   default "csk6011a_c3_nano"

endif # BOARD_CSK6011A_C3_NANO
```

## boards/arm/csk6011a_nano/Kconfig.board
```kconfig
# SPDX-License-Identifier: Apache-2.0

config BOARD_CSK6011A_NANO
   bool "csk6011a_nano Board"
   depends on SOC_CSK6
```

## boards/arm/csk6011a_nano/Kconfig.defconfig
```kconfig
if BOARD_CSK6011A_NANO

config BOARD
   default "csk6011a_nano"

DT_CHOSEN_Z_PSRAM := zephyr,psram

config PSRAM_SIZE
	hex
	default "$(dt_chosen_reg_size_hex,$(DT_CHOSEN_Z_PSRAM))"

endif # BOARD_CSK6011A_NANO
```

## boards/arm/csk6012_9s_scanpen/Kconfig.board
```kconfig
# SPDX-License-Identifier: Apache-2.0

config BOARD_CSK6012_9S_SCANPEN
   bool "csk6002 9S_SCANPEN Board"
   depends on SOC_CSK6
```

## boards/arm/csk6012_9s_scanpen/Kconfig.defconfig
```kconfig
if BOARD_CSK6012_9S_SCANPEN

config BOARD
   default "csk6012_9s_scanpen"



endif # BOARD_CSK6012_9S_SCANPEN
```

## boards/arm/csk6012_c3_nano/Kconfig.defconfig
```kconfig
if BOARD_CSK6012_C3_NANO

config BOARD
   default "csk6012_c3_nano"

DT_CHOSEN_Z_PSRAM := zephyr,psram

config PSRAM_SIZE
	hex
	default "$(dt_chosen_reg_size_hex,$(DT_CHOSEN_Z_PSRAM))"
      
if WIFI

choice CSK_WIFI_OFFLOAD_MODULE
   prompt "WiFi Offload Module"
   default CSK_WIFI_ESP32C3

	config CSK_WIFI_ESP32C3
      bool "ESP32C3"

	config CSK_WIFI_XR819S
      bool "XR819S"

endchoice

endif # WIFI

if BT

choice BT_HCI_BUS_TYPE
	default CSK_BLE_ESP32C3
endchoice

endif # BT

endif # BOARD_CSK6012_C3_NANO
```

## boards/arm/csk6012_nano/Kconfig.defconfig
```kconfig
if BOARD_CSK6012_NANO

config BOARD
   default "csk6012_nano"

DT_CHOSEN_Z_PSRAM := zephyr,psram

config PSRAM_SIZE
	hex
	default "$(dt_chosen_reg_size_hex,$(DT_CHOSEN_Z_PSRAM))"
   
endif # BOARD_CSK6012_NANO
```

## boards/xtensa/ls_adsp_csk6/Kconfig.board
```kconfig
# Xtensa board configuration

# Copyright (c) 2021 ListenAI
# SPDX-License-Identifier: Apache-2.0

config  BOARD_LS_ADSP_CSK6
	bool "ListenAI ADSP CSK6"
```

## boards/xtensa/ls_adsp_csk6/Kconfig.defconfig
```kconfig
# Copyright (c) 2021 ListenAI
#
# SPDX-License-Identifier: Apache-2.0

if BOARD_LS_ADSP_CSK6

config BOARD
	default "ls_adsp_csk6"

endif # BOARD_LS_ADSP_CSK6
```

## drivers/Kconfig
```kconfig
# drivers configuration options

# Copyright (c) 2015 Intel Corporation
# SPDX-License-Identifier: Apache-2.0

menu "CSK Device Drivers"

rsource "serial/Kconfig"

rsource "entropy/Kconfig"

rsource "gpio/Kconfig"

rsource "spi/Kconfig"

rsource "i2c/Kconfig"

rsource "pwm/Kconfig"

rsource "pinmux/Kconfig"

rsource "adc/Kconfig"

rsource "watchdog/Kconfig"

rsource "flash/Kconfig"

rsource "counter/Kconfig"

rsource "dma/Kconfig"

rsource "usb/Kconfig"

rsource "crypto/Kconfig"

rsource "wifi/Kconfig"

rsource "hwinfo/Kconfig"

rsource "kscan/Kconfig"

rsource "video/Kconfig"

rsource "misc/Kconfig"

rsource "disk/Kconfig"

rsource "pinctrl/Kconfig"

endmenu
```

## drivers/adc/Kconfig.csk6
```kconfig
# CSK ADC driver configuration options

# Copyright (c) 2021 listenai Intelligent Technology (anhui) Co., Ltd.
# SPDX-License-Identifier: Apache-2.0

config ADC_CSK6
	bool "listenai CSK6 embedded controller (EC) ADC driver"
	default y
	depends on HAS_CSK6
	help
	  This option enables the ADC driver for CSK6.
	  Say y if you wish to use ADC modules on CSK6.
```
