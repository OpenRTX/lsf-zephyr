## CMakeLists.txt
```
# SPDX-License-Identifier: Apache-2.0

cmake_minimum_required(VERSION 3.20.0)

set(SUPPORT_BOARDS csk6012_nano csk6011a_nano)
if(NOT ${BOARD} IN_LIST SUPPORT_BOARDS)
    message("Please choose one of the following boards:")
    foreach(item ${SUPPORT_BOARDS})
        message(STATUS ${item})
    endforeach()
    message(FATAL_ERROR "\nThe project does not support the ${BOARD}")
endif()

find_package(Zephyr HINTS $ENV{ZEPHYR_BASE})
project(entropy)

target_sources(app PRIVATE src/main.c)
```

## sample.yaml
```
tests:
  sample.board.csk6.driver.entropy:
    platform_allow: csk6011a_nano
    tags: csk6
    timeout: 10
    harness: console
    harness_config:
      type: one_line
      ordered: true
      regex:
        - "entropy sample done"
```

## prj.conf
```kconfig
# CONFIG_LOG=y
# CONFIG_LOG_MODE_MINIMAL=y

CONFIG_ENTROPY_GENERATOR=y
CONFIG_ENTROPY_CSK6_RNG=y
```

## boards/csk6011a_nano.overlay
```dts
/*
 * Copyright (c) 2023 Anhui(Shenzhen) Listenai Co., Ltd.
 *
 * SPDX-License-Identifier: Apache-2.0
 */

&trng {
	status = "okay";
};
```

## src/main.c
```c
/*
 * Copyright (c) 2023 Anhui(Shenzhen) Listenai Co., Ltd.
 *
 * SPDX-License-Identifier: Apache-2.0
 */

#include <drivers/entropy.h>
#include <zephyr.h>

#define LOG_LEVEL CONFIG_LOG_DEFAULT_LEVEL
#include <logging/log.h>
LOG_MODULE_REGISTER(sample);

#define ENTROPY_LEN_MAX 256
uint8_t entropy_buf[ENTROPY_LEN_MAX];

static void dump_entropy(const char *entropy_buf, uint32_t len)
{
	printk("entropy buf dump: \n");

	for (uint32_t cnt = 0; cnt < len; cnt++) {

		printk("%.2x  ", entropy_buf[cnt]);
		if (0 == ((cnt + 1) % 16)) {
			printk("\n");
		}
	}

	printk("\n");
}

void main(void)
{
	const struct device *dev;
	int ret = 0;

	dev = device_get_binding(DT_LABEL(DT_CHOSEN(zephyr_entropy)));
	if (!dev) {
		printk("error: no random device %s\r\n", DT_LABEL(DT_CHOSEN(zephyr_entropy)));
		return;
	}

	printk("start get entropy sample \r\n");

	ret = entropy_get_entropy(dev, entropy_buf, ENTROPY_LEN_MAX);
	if (ret != 0) {
		printk("error: get entropy failed %d\r\n", ret);
		return;
	}

	dump_entropy(entropy_buf, ENTROPY_LEN_MAX);

	printk("entropy sample done \r\n");

	while (1) {
		k_sleep(K_MSEC(1000));
	}
}
```
