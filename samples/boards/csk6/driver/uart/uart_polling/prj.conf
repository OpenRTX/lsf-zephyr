## CMakeLists.txt
```
# SPDX-License-Identifier: Apache-2.0

cmake_minimum_required(VERSION 3.20.0)

set(SUPPORT_BOARDS csk6012_nano csk6011a_nano)
if(NOT ${BOARD} IN_LIST SUPPORT_BOARDS)
    message("Please choose one of the following boards:")
    foreach(item ${SUPPORT_BOARDS})
        message(STATUS ${item})
    endforeach()
    message(FATAL_ERROR "\nThe project does not support the ${BOARD}")
endif()

find_package(Zephyr REQUIRED HINTS $ENV{ZEPHYR_BASE})
project(uart)

target_sources(app PRIVATE src/main.c)
```

## sample.yaml
```
tests:
  sample.board.csk6.driver.uart:
    platform_allow: csk6011a_nano
    timeout: 20
    tags: csk6
    harness: console
    harness_config:
      type: one_line
      regex:
        - "devices UART_0 is ready"
```

## prj.conf
```kconfig
CONFIG_LOG=y
CONFIG_LOG_MODE_IMMEDIATE=y
CONFIG_UART_INTERRUPT_DRIVEN=y
CONFIG_UART_CSK6=y
CONFIG_PRINTK=y
```

## boards/csk6002_9s_nano.overlay
```dts
&csk6002_9s_nano_pinctrl{
    pinctrl_uart0_rx_default: uart0_rx_default{
        pinctrls = <UART0_RXD_GPIOA_02>;              //rx pin
    };
    
    pinctrl_uart0_tx_default: uart0_tx_default{
        pinctrls = <UART0_TXD_GPIOA_03>;              //tx pin
    };
};
```

## boards/csk6011a_9s_nano.overlay
```dts
&csk6011a_9s_nano_pinctrl{
    pinctrl_uart0_rx_default: uart0_rx_default{
        pinctrls = <UART0_RXD_GPIOA_02>;              //rx pin
    };
    
    pinctrl_uart0_tx_default: uart0_tx_default{
        pinctrls = <UART0_TXD_GPIOA_03>;              //tx pin
    };
};
```

## boards/csk6011a_nano.overlay
```dts
&pinctrl{
    pinctrl_uart0_rx_default: uart0_rx_default{
        pinctrls = <UART0_RXD_GPIOA_02>;              //rx pin
    };
    
    pinctrl_uart0_tx_default: uart0_tx_default{
        pinctrls = <UART0_TXD_GPIOA_03>;              //tx pin
    };
};
```

## boards/csk6012_nano.overlay
```dts
/*
 * Copyright (c) 2023 Anhui(Shenzhen) Listenai Co., Ltd.
 *
 * SPDX-License-Identifier: Apache-2.0
 */
&pinctrl {
	pinctrl_uart0_rx_default: uart0_rx_default{
		pinctrls = <UART0_RXD_GPIOA_02>;              //rx pin
	};

	pinctrl_uart0_tx_default: uart0_tx_default{
		pinctrls = <UART0_TXD_GPIOA_03>;              //tx pin
	};
};
```

## src/main.c
```c
/*
 * Copyright (c) 2023 Anhui(Shenzhen) Listenai Co., Ltd.
 *
 * SPDX-License-Identifier: Apache-2.0
 */
#include <string.h>

#include <devicetree.h>
#include <drivers/uart.h>
#include <kernel.h>
#include <logging/log.h>
#include <sys/printk.h>
#include <zephyr.h>
LOG_MODULE_REGISTER(sample, LOG_LEVEL_INF);
#define UART0 DT_NODELABEL(uart0)

void main(void)
{
	char rx_char;
	const struct device *uart = DEVICE_DT_GET(UART0);
	if (!device_is_ready(uart)) {
		LOG_ERR("device:%s is not ready!", uart->name);
		return;
	}
	LOG_INF("devices %s is ready", uart->name);

	while (1) {
		if (uart_poll_in(uart, &rx_char) == 0) { /*read a char*/
			uart_poll_out(uart, rx_char);	 /*send a char*/
		}
	}
	return;
}
```
