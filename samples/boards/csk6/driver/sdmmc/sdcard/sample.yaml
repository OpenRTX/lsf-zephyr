## samples/boards/csk6/driver/sdmmc/sdcard/sample.yaml
```yaml
tests:
  sample.board.csk6.driver.sdcard:
    platform_allow: csk6002_9s_nano
    tags: csk6
    build_only: true
    
```

## samples/boards/csk6/driver/video/bf30a2/sample/drivers/Kconfig.bf30a2
```kconfig
# BF30A2

# Copyright (c) 2022 listenai
# SPDX-License-Identifier: Apache-2.0

config VIDEO_BF30A2
	bool "1/15 inch QVGA CMOS Image Sensor BF30A2"
	help
	  Enable driver for BF30A2 CMOS digital image sensor device.

config VIDEO_BF30A2_RECEIVE_BUF_NUM
	int "Must be greater than or equal to 2"
	default 2
	help
	  Config the number of buffers that the bf30a2 driver receives raw data.

config VIDEO_BF30A2_RECEIVE_THREAD_PRIORITY
	int "the priority of thread"
	default 1
	help
	  Config the priority of thread.

config VIDEO_BF30A2_TIMER_TIMEOUT
	int "timeout of ms"
	default 5
	help
	  Config the timeout value for timer.
```

## samples/boards/csk6/gpio_led/sample.yaml
```yaml
sample:
  name: csk6 gpio_led Sample
tests:
  sample.board.csk6.gpio_led:
    tags: LED gpio
    filter: dt_enabled_alias_with_parent_compat("led0", "gpio-leds")
    depends_on: gpio
    harness: led
```

## samples/boards/csk6/subsys/fs/fat_fs/Kconfig
```kconfig
if FILE_SYSTEM

config FLASH
	default y

config FLASH_MAP
	default y

config FLASH_PAGE_LAYOUT
	default y

if FAT_FILESYSTEM_ELM

DT_CHOSEN_Z_FLASH_SYSFS_STORAGE := zephyr,flash_sysfs_storage
DT_CHOSEN_Z_FLASH_CONTROLLER := zephyr,flash_controller
DT_CHOSEN_Z_INN_FLASH := zephyr,flash

config DISK_DRIVER_FLASH
	default y

config DISK_FLASH_START
	default "$(dt_chosen_reg_addr_hex,$(DT_CHOSEN_Z_FLASH_SYSFS_STORAGE))"

config DISK_FLASH_DEV_NAME
	default "$(dt_chosen_label,$(DT_CHOSEN_Z_FLASH_CONTROLLER))"

config DISK_VOLUME_SIZE
	default "$(dt_chosen_reg_size_hex,$(DT_CHOSEN_Z_FLASH_SYSFS_STORAGE))"


config DISK_FLASH_MAX_RW_SIZE
	default 4096
	#default $(dt_node_int_prop_hex,$(DT_CHOSEN_Z_INN_FLASH),erase-block-size)

config DISK_FLASH_ERASE_ALIGNMENT
	default 0x1000
	#default "$(dt_node_int_prop_hex,$(DT_CHOSEN_Z_INN_FLASH),erase-block-size)"

config DISK_ERASE_BLOCK_SIZE
	default 0x1000
	#default "$(dt_node_int_prop_hex,$(DT_CHOSEN_Z_INN_FLASH),erase-block-size)"


config FLASH_LOG_LEVEL
	default 4


endif # FILE_SYSTEM_FATFS
		
endif #FILE_SYSTEM

source "Kconfig.zephyr"
```

## samples/boards/csk6/subsys/psram/sample.yaml
```yaml
tests:
  sample.board.csk6.dma_memcpy:
    platform_allow: csk6002_c3_nano
    tags: csk6
```

## samples/boards/csk6/subsys/usb/cdc_acm/sample.yaml
```yaml
sample:
  name: CDC ACM USB
tests:
  sample.usb.cdc-acm.buildonly:
    tags: usb
    build_only: true
```

## samples/boards/csk6001/driver/adc/sample.yaml
```yaml
tests:
  sample.board.csk6001.driver.adc:
    platform_allow: csk6002_c3_nano
    tags: csk6
```

## samples/boards/csk6001/driver/display_kscan/sample.yaml
```yaml
sample:
  description: Sample application for displays
  name: display_sample
tests:
  sample.board.csk6001.display.kscan:
    platform_allow: csk6002_c3_nano
    tags: csk6
```

## samples/boards/csk6001/driver/keysense/sample.yaml
```yaml
sample:
  name: keysense 

tests:
  sample.board.csk6001.driver.keysense:
    platform_allow: csk6001_tester
    tags: csk6001
```

## samples/boards/csk6001/driver/spi_master_slave/sample.yaml
```yaml
tests:
  sample.board.csk6001.spi_master_slave:
    platform_allow: csk6001_tester
    tags: csk6001
```

## samples/boards/csk6001/network/wifi_softap/sample.yaml
```yaml
tests:
  sample.board.csk6001.network.wifi_softap:
    platform_allow: csk6002_c3_nano csk6002_9s_nano
    tags: csk6001
```

## samples/boards/csk6001/subsys/load_ap/sample.yaml
```yaml
sample:
  name: Load_ap Sample
tests:
  sample.board.csk6001.driver.load_ap:
    platform_allow: csk6001_tester
    tags: csk6001
```

## samples/boards/csk6001/subsys/lowpower/sample.yaml
```yaml
sample:
  name: lowpower Sample
tests:
  sample.board.csk6001.driver.lowpower:
    platform_allow: csk6001_tester
    tags: csk6001
```

## samples/boards/csk6001/subsys/sof_host/Kconfig
```kconfig
# Private config options for load sencond core firmware app

# SPDX-License-Identifier: Apache-2.0

# Workaround for not being able to have commas in macro arguments

DT_CHOSEN_Z_FLASH_SYSFS_STORAGE := zephyr,flash_sysfs_storage
DT_CHOSEN_Z_FLASH_CONTROLLER := zephyr,flash_controller
DT_CHOSEN_Z_INN_FLASH := zephyr,flash
DT_CHOSEN_Z_IPC_SHM := zephyr,ipc_shm

if USB_MASS_STORAGE

	config DISK_FLASH_START
		default "$(dt_chosen_reg_addr_hex,$(DT_CHOSEN_Z_FLASH_SYSFS_STORAGE))"

	config DISK_FLASH_DEV_NAME
		default "$(dt_chosen_label,$(DT_CHOSEN_Z_FLASH_CONTROLLER))"

	config DISK_VOLUME_SIZE
		default "$(dt_chosen_reg_size_hex,$(DT_CHOSEN_Z_FLASH_SYSFS_STORAGE))"


	config DISK_FLASH_MAX_RW_SIZE
		default 4096
		#default $(dt_node_int_prop_hex,$(DT_CHOSEN_Z_INN_FLASH),erase-block-size)

	config DISK_FLASH_ERASE_ALIGNMENT
		default 0x1000
		#default "$(dt_node_int_prop_hex,$(DT_CHOSEN_Z_INN_FLASH),erase-block-size)"

	config DISK_ERASE_BLOCK_SIZE
		default 0x1000
		#default "$(dt_node_int_prop_hex,$(DT_CHOSEN_Z_INN_FLASH),erase-block-size)"
endif


#SOF IPC MEMORY CONFIG
config SOF_IPC_SHM_BASE_ADDRESS
	default "$(dt_chosen_reg_addr_hex,$(DT_CHOSEN_Z_IPC_SHM))"

config SOF_IPC_SHM_SIZE
	default "$(dt_chosen_reg_size_hex,$(DT_CHOSEN_Z_IPC_SHM))"
	help
	  This option specifies size of the memory region to be used
	  for the SOF IPC shared memory

menu "Example Configuration"

    config EXAMPLE_WIFI_SSID
        string "WiFi SSID"
        default "wifi_ssid"

    config EXAMPLE_WIFI_PASSWORD
        string "WiFi password"
        default "wifi_password"

endmenu


config LISA_HEAP_ARENA_SIZE
	int "Size of the lisa mem malloc arena"
	default 0
	help
	  Indicate the size in bytes of the memory arena used for
	  lisa_mem's malloc() implementation.

source "Kconfig.zephyr"
```

## samples/subsys/fs/littlefs/sample.yaml
```yaml
sample:
  name: littlefs filesystem sample
tests:
  sample.filesystem.littlefs:
    build_only: true
    platform_allow: csk6011a_nano csk6012_nano

    tags: filesystem
```

## soc/arm/csk6/Kconfig.defconfig
```kconfig
# ESP32 board configuration


if SOC_CSK6


config SOC
	default "csk6"

config NUM_IRQS
	default 32

config HAS_CSK6_GPT
	bool
	help
	  Set if the general purpose timer (GPT) module is present in the SoC.

DT_CSK6_FLASH := $(dt_nodelabel_path,flash0)
DT_CSK6_FLASH_WRITE_BLOCK_SIZE := $(dt_node_int_prop_int,$(DT_CSK6_FLASH),write-block-size)

config FLASH_WRITE_BLOCK_SIZE
	int
	default "$(DT_CSK6_FLASH_WRITE_BLOCK_SIZE)" if "$(dt_node_has_prop,flash0,write-block-size)"
	default 1
	help
	  Number of flash write block size
endif
```

## soc/arm/csk6/Kconfig.soc
```kconfig
# SPDX-License-Identifier: Apache-2.0

config SOC_CSK6
	bool "SOC_CSK6"
	select ARM
	select CPU_CORTEX_M33
	select CPU_CORTEX_M_HAS_DWT
	select CPU_HAS_ARM_SAU
	select CPU_HAS_FPU
	select CPU_HAS_MPU
	select CPU_HAS_ARM_MPU
	select ARMV8_M_DSP
	select CPU_CORTEX_M_HAS_SYSTICK
	select HAS_CSK6
	select CPU_HAS_CUSTOM_FIXED_SOC_MPU_REGIONS

config HAS_CSK6
	bool
	select HAS_CMSIS_CORE
	depends on SOC_CSK6


if SOC_CSK6

	config CSK6_PSRAM
		bool "Enable CSK6 PSRAM"
		default n
		help
			Enable CSK6 PSRAM

endif # SOC_CSK6
```

## soc/arm/csk6/exmcu/kconfig
```kconfig
config CSK6_EXMCU
    bool "csk6 exmcu"
    default n
    select I2C
    select MUTEX
    help
        CSK6_EXMCU

config CSK6_EXMCU_INIT_PRIORITY
    int "csk6 exmcu int priority"
    default 51
    depends on CSK6_EXMCU
    help
        csk6 exmcu int priority

config CSK6_CH32V003_INIT_DELAY_MS
    int "csk6 ch32v003 init delay ms"
    default 40
    depends on CSK6_EXMCU
    help
       csk6 ch32v003 init delay ms

config CSK6_CH32V003_NON_BLOCK_INIT
    bool "csk6 ch32v003 non block initialization"
    default n
    depends on CSK6_EXMCU
```

## soc/xtensa/esp32/Kconfig.defconfig
```kconfig
# ESP32 board configuration

# Copyright (c) 2017 Intel Corporation
# SPDX-License-Identifier: Apache-2.0

if SOC_ESP32

config SOC
	default "esp32"


if SMP

config SCHED_IPI_SUPPORTED
	default y

config SCHED_CPU_MASK
	default y

config MP_NUM_CPUS
	default 2

config MINIMAL_LIBC_OPTIMIZE_STRING_FOR_SIZE
	default n

config LOG_DETECT_MISSED_STRDUP
	default n

endif
endif
```

## soc/xtensa/ls_adsp/Kconfig.soc
```kconfig
# ListenAI CSK6 SoC series selection
#
# Copyright (c) 2021 ListenAI
# SPDX-License-Identifier: Apache-2.0

source "soc/xtensa/ls_adsp/*/Kconfig.series"
```

## soc/xtensa/ls_adsp/csk6/Kconfig.defconfig.series
```kconfig
# Copyright (c) 2021 ListenAI
# SPDX-License-Identifier: Apache-2.0

DT_CHOSEN_Z_SRAM0 := zephyr,sram
DT_CHOSEN_Z_PSRAM_AP := zephyr,psram_ap
DT_CHOSEN_Z_PSRAM_SHARE := zephyr,psram_share

if SOC_SERIES_LS_CSK6

# This series does not have MISC0.
# Since EXCSAVE7 is unused by Zephyr, use it instead.
config XTENSA_KERNEL_CPU_PTR_SR
	default "EXCSAVE2"

config SOC_SERIES
	string
	default "csk6"

config SOC_TOOLCHAIN_NAME
	string
	default "ls_csk_adsp"

config SOC
	string
	default "ls_csk6"

config SMP
	default n

config XTENSA_TIMER
	default y

config SYS_CLOCK_HW_CYCLES_PER_SEC
	default 300000000 if XTENSA_TIMER

config SYS_CLOCK_TICKS_PER_SEC
	default 50000

config KERNEL_ENTRY
	default "__start"

config MULTI_LEVEL_INTERRUPTS
	default n

config 2ND_LEVEL_INTERRUPTS
	default n

config DYNAMIC_INTERRUPTS
	default y

config LOG
	default y

config CP_XIP
	bool "Enable DSP runs in xip mode"
	default n
		
config CP_XIP_RUN_ADDRESS
	hex "DSP XIP run address"
	default 0x68500000 if CP_XIP

config CP_XIP_MAX_SIZE
	hex "DSP XIP max size"
	default 0x300000 if CP_XIP	

# To prevent test uses TEST_LOGGING_MINIMAL
config TEST_LOGGING_DEFAULTS
	default n
	depends on TEST


config SRAM0_START
	hex
	default "$(dt_chosen_reg_addr_hex,$(DT_CHOSEN_Z_SRAM0))"
	help
	  psram cp start address

config SRAM0_SIZE
	hex
	default "$(dt_chosen_reg_size_hex,$(DT_CHOSEN_Z_SRAM0))"
	help
	  psram cp start size

config PSRAM_AP_START
	hex
	default "$(dt_chosen_reg_addr_hex,$(DT_CHOSEN_Z_PSRAM_AP))"
	help
	  psram ap start address

config PSRAM_AP_SIZE
	hex
	default "$(dt_chosen_reg_size_hex,$(DT_CHOSEN_Z_PSRAM_AP))"
	help
	  psram ap start size

config PSRAM_SHARE_START
	hex
	default "$(dt_chosen_reg_addr_hex,$(DT_CHOSEN_Z_PSRAM_SHARE))"
	help
	  psram share start address

config PSRAM_SHARE_SIZE
	hex
	default "$(dt_chosen_reg_size_hex,$(DT_CHOSEN_Z_PSRAM_SHARE))"
	help
	  psram share start size

endif # SOC_SERIES_LS_CSK6
```
