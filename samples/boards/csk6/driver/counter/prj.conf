## CMakeLists.txt
```
# SPDX-License-Identifier: Apache-2.0

cmake_minimum_required(VERSION 3.20.0)

set(SUPPORT_BOARDS csk6012_nano csk6011a_nano)
if(NOT ${BOARD} IN_LIST SUPPORT_BOARDS)
    message("Please choose one of the following boards:")
    foreach(item ${SUPPORT_BOARDS})
        message(STATUS ${item})
    endforeach()
    message(FATAL_ERROR "\nThe project does not support the ${BOARD}")
endif()

find_package(Zephyr REQUIRED HINTS $ENV{ZEPHYR_BASE})
project(rtc)

target_sources(app PRIVATE src/main.c)
```

## sample.yaml
```
sample:
  name: rtc

tests:
  sample.board.csk6.driver.rtc:
    platform_allow: csk6011a_nano
    tags: csk6
    timeout: 20
    harness: console
    harness_config:
      type: multi_line
      regex:
        - "^Counter alarm callback at \\d* ms(.*)"
        - "^RTC value: \\d*s$"
```

## prj.conf
```kconfig
CONFIG_STDOUT_CONSOLE=y
CONFIG_PRINTK=y

CONFIG_COUNTER=y
CONFIG_COUNTER_CSK6=y
```

## boards/csk6011a_nano.overlay
```dts
/*
 * Copyright (c) 2023 Anhui(Shenzhen) Listenai Co., Ltd.
 *
 * SPDX-License-Identifier: Apache-2.0
 */

&gpt0 {
	compatible = "listenai,csk-gpt";
	pwm-channels = <6>;
};
```

## src/main.c
```c
/*
 * Copyright (c) 2023 Anhui(Shenzhen) Listenai Co., Ltd.
 *
 * SPDX-License-Identifier: Apache-2.0
 */

#include <errno.h>
#include <string.h>

#include <device.h>
#include <drivers/counter.h>
#include <kernel.h>
#include <sys/printk.h>
#include <zephyr.h>

#define DELAY_US	   1000000
#define ALARM_CHANNEL_ID_0 0
#define ALARM_CHANNEL_ID_1 1
struct counter_alarm_cfg alarm_cfg;
#ifdef CONFIG_COUNTER_CSK6_GPT
#define TIMER DT_LABEL(DT_NODELABEL(gpt0))
#elif CONFIG_COUNTER_CSK6_DUAL
#define TIMER DT_LABEL(DT_NODELABEL(dual_timer))
#endif

static void test_counter_interrupt_fn(const struct device *counter_dev, uint8_t chan_id,
				      uint32_t ticks, void *user_data)
{
	printk("counter Channel is: %d\n", chan_id);
}

void main(void)
{
	const struct device *counter_dev;
	int err;
	printk("Counter alarm sample\n\n");
	counter_dev = device_get_binding(TIMER);
	if (counter_dev == NULL) {
		printk("Device not found\n");
		return;
	}
	alarm_cfg.flags = 0;
	alarm_cfg.ticks = counter_us_to_ticks(counter_dev, DELAY_US);
	alarm_cfg.callback = test_counter_interrupt_fn;
	alarm_cfg.user_data = &alarm_cfg;
	counter_start(counter_dev);
	err = counter_set_channel_alarm(counter_dev, ALARM_CHANNEL_ID_0, &alarm_cfg);
	if (err < 0) {
		printk("counter_set_channel_alarm err \n");
	}
	err = counter_set_channel_alarm(counter_dev, ALARM_CHANNEL_ID_1, &alarm_cfg);
	if (err < 0) {
		printk("counter_set_channel_alarm err \n");
	}
}
```
