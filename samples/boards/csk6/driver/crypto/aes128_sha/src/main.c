/*
 * SPDX-License-Identifier: Apache-2.0
 */

#include <device.h>
#include <zephyr.h>
#include <string.h>
#include <crypto/crypto.h>

#include <logging/log.h>
LOG_MODULE_REGISTER(main, LOG_LEVEL_DBG);

#if DT_NODE_HAS_STATUS(DT_NODELABEL(crypto), okay)
#define CRYPTO_DRV_NAME DT_NODELABEL(crypto)
#else
#error "can't find crypto dev"
#endif

uint32_t cap_flags;
uint8_t test1[] = {};
uint8_t test2[] = { 0xbd };
uint8_t test3[] = { 0x5f, 0xd4 };
uint8_t test4[] = { 0xb0, 0xbd, 0x69 };
uint8_t test5[] = { 0xc9, 0x8c, 0x8e, 0x55 };
uint8_t test6[] = { 0x81, 0xa7, 0x23, 0xd9, 0x66 };
uint8_t test7[] = {
	0x83, 0x90, 0xcf, 0x0b, 0xe0, 0x76, 0x61, 0xcc, 0x76, 0x69, 0xaa, 0xc5, 0x4c, 0xe0, 0x9a,
	0x37, 0x73, 0x3a, 0x62, 0x9d, 0x45, 0xf5, 0xd9, 0x83, 0xef, 0x20, 0x1f, 0x9b, 0x2d, 0x13,
	0x80, 0x0e, 0x55, 0x5d, 0x9b, 0x10, 0x97, 0xfe, 0xc3, 0xb7, 0x83, 0xd7, 0xa5, 0x0d, 0xcb,
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	0x36, 0x47, 0x64, 0x8b, 0x4f, 0x4a, 0xb0, 0xed, 0x99, 0x5e
};

uint8_t sha256_results[7][32] = {
	{ 0xe3, 0xb0, 0xc4, 0x42, 0x98, 0xfc, 0x1c, 0x14, 0x9a, 0xfb, 0xf4,
	  0xc8, 0x99, 0x6f, 0xb9, 0x24, 0x27, 0xae, 0x41, 0xe4, 0x64, 0x9b,
	  0x93, 0x4c, 0xa4, 0x95, 0x99, 0x1b, 0x78, 0x52, 0xb8, 0x55 },
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	{ 0x41, 0x09, 0xcd, 0xbe, 0xc3, 0x24, 0x0a, 0xd7, 0x4c, 0xc6, 0xc3,
	  0x7f, 0x39, 0x30, 0x0f, 0x70, 0xfe, 0xde, 0x16, 0xe2, 0x1e, 0xfc,
	  0x77, 0xf7, 0x86, 0x59, 0x98, 0x71, 0x4a, 0xad, 0x0b, 0x5e }
};
unsigned int crypto_long_validation_array[] = {
	0x746e6f4d, 0x72726573, 0x6c277461, 0x64657961, 0x56864627, 0x69662297, 0x26747372,
	0x364617d6, 0x236e6982, 0x12939313, 0x26646e61, 0x92c7e6f6, 0x61636562, 0x6624656d,
	0x6d126696, 0x65626d65, 0x96267372, 0x393931e2, 0x66242e36, 0x657922f7, 0x27737261,
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	0x6d726542, 0x2e616475, 0x79656854, 0x66178626, 0x6e6f6c52,
};

unsigned int crypto_sha256_long_ref_arrary[] = {
	0x00652952, 0x2950c4f6, 0xbc095788, 0x3cb6110b,
	0x68e43e2c, 0xa7cf1b50, 0x761150c0, 0xcde4cabf,
};
static void print_buffer_comparison(uint8_t *wanted_result, uint8_t *result, size_t length)
{
	int i, j;

	printk("Was waiting for: \n");

	for (i = 0, j = 1; i < length; i++, j++) {
		printk("0x%02x ", wanted_result[i]);

		if (j == 10) {
			printk("\n");
			j = 0;
		}
	}

	printk("\n But got:\n");

	for (i = 0, j = 1; i < length; i++, j++) {
		printk("0x%02x ", result[i]);

		if (j == 10) {
			printk("\n");
			j = 0;
		}
	}

	printk("\n");
}
static void *Hash256_LightPadding(char *m, uint64_t len, uint64_t *nopadding_len,
				  uint8_t *padding_len)
{
	printk("len = %lld \n",len);
	if (len % 64) {
		*padding_len = 64;

		if ((len * 8 + 1) % 512 > 448) {
			*padding_len += 64;
			printk("111\n");
		}

		*nopadding_len = (len / 64) * 64; // Floor
		printk("123\n");
	} else {
		*nopadding_len = len;
		*padding_len = 64;
		printk("321\n");
	}

	unsigned char *s = (unsigned char *)k_malloc(*padding_len);

	memset(s, 0, *padding_len);

	uint8_t i;

	for (i = 0; i < len - *nopadding_len; i++) {
		s[i] = m[*nopadding_len + i];
	}

	s[i] = 0x80;

	for (i = 0; i < 8; i++) {
		s[*padding_len - 1 - i] =
			(unsigned char)(((uint64_t)(len * 8) & (uint64_t)(0xff << i * 8)) >> 8 * i);
	}

	return s;
}

__attribute__((aligned(32))) static uint32_t crypto_sha_result_data_8w[8] = { 0 };
void hash_mode(const struct device *dev)
{
	int ret;
	int i;
	struct hash_ctx ctx;
	struct hash_pkt pkt;
	volatile uint32_t *source_addr = (volatile uint32_t *)test7;
	volatile uint32_t *padding_source_addr;
	volatile uint32_t *dst_addr = crypto_sha_result_data_8w;
	uint64_t nopadding_len;
	uint8_t padding_len;

	padding_source_addr =
		Hash256_LightPadding((char *)source_addr, sizeof(test7),
				     &nopadding_len, &padding_len);
	// print_buffer_comparison(source_addr, source_addr, nopadding_len);
	ret = hash_begin_session(dev, &ctx, CRYPTO_HASH_ALGO_SHA256);
	ctx.flags = CAP_SYNC_OPS | CAP_SEPARATE_IO_BUFS;
	printk("nopadding_len = %lld  padding_len = %d \n", nopadding_len, padding_len);
	if (nopadding_len != 0) {

		pkt.in_buf = source_addr;
		pkt.in_len = 64;
		pkt.out_buf = dst_addr;
		ret = hash_update(&ctx, &pkt); //hash_update //hash_compute
		source_addr += 0x10; // word
		nopadding_len -= 64;
		printk("11111 nopadding_len=%lld\n", nopadding_len);
	} else { // == 0

		pkt.in_buf = padding_source_addr;
		pkt.in_len = 64;
		pkt.out_buf = dst_addr;
		ret = hash_update(&ctx, &pkt); //hash_update //hash_compute
		padding_len -= 64;
		padding_source_addr += 0x10; // word
		printk("22222 padding_len=%d\n", padding_len);
	}

	for (i = 0; i < nopadding_len / 64; i++) {
		ret = hash_compute(&ctx, &pkt); //hash_update //hash_compute

		source_addr += 0x10; // word
		printk("33333 nopadding_len = %lld \n",nopadding_len);
	}

	for (i = 0; i < padding_len / 64; i++) {
		pkt.in_buf = padding_source_addr;
		pkt.in_len = 64;
		pkt.out_buf = dst_addr;
		ret = hash_compute(&ctx, &pkt); //hash_update //hash_compute

		padding_source_addr += 0x10; // word

		printk("444444 padding_len = %d\n",padding_len);
	}

	print_buffer_comparison(dst_addr, (uint8_t *)sha256_results[6], 32);

	hash_free_session(dev, &ctx);
}

void main(void)
{
	const struct device *dev = DEVICE_DT_GET(CRYPTO_DRV_NAME);

	if (!dev) {
		LOG_ERR("crypto device not found \n");
		return;
	}

	LOG_INF("AES128 HASH Cipher Sample");

	hash_mode(dev);
}
