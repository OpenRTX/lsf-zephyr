## CMakeLists.txt
```
# SPDX-License-Identifier: Apache-2.0

cmake_minimum_required(VERSION 3.20.0)
set(SUPPORT_BOARDS csk6012_nano csk6011a_nano)
if(NOT ${BOARD} IN_LIST SUPPORT_BOARDS)
    message("Please choose one of the following boards:")
    foreach(item ${SUPPORT_BOARDS})
        message(STATUS ${item})
    endforeach()
    message(FATAL_ERROR "\nThe project does not support the ${BOARD}")
endif()

find_package(Zephyr REQUIRED HINTS $ENV{ZEPHYR_BASE})
project(counter_timer)

target_sources(app PRIVATE src/main.c)
```

## sample.yaml
```
sample:
  name: counter_timer

tests:
  sample.board.csk6.driver.counter:
    platform_allow: csk6011a_nano
    tags: csk6
    timeout: 20
    harness: console
    harness_config:
      type: multi_line
      regex:
        - "^g_counter: \\d*$"
        - "^g_counter: \\d*$"
```

## prj.conf
```kconfig
CONFIG_STDOUT_CONSOLE=y
CONFIG_PRINTK=y

CONFIG_COUNTER=y
CONFIG_COUNTER_CSK6_GPTCHANNEL=y
```

## boards/csk6011a_nano.overlay
```dts
&gptchannel0 {
    status = "okay";
    channel_mode = <0>;  /* 0: timer; 1:pwm */
};
```

## boards/csk6012_nano.overlay
```dts
&gptchannel0 {
    status = "okay";
    channel_mode = <0>;  /* 0: timer; 1:pwm */
};
```

## src/main.c
```c
/*
 * SPDX-License-Identifier: Apache-2.0
 */

#include <kernel.h>
#include <string.h>
#include <errno.h>
#include <zephyr.h>
#include <sys/printk.h>
#include <device.h>
#include <drivers/counter.h>

#ifdef CONFIG_COUNTER_CSK6_GPTCHANNEL
	#define DEVICE_NAME  DT_LABEL(DT_NODELABEL(gptchannel0))
#elif CONFIG_COUNTER_CSK6_DUAL
	#define DEVICE_NAME "DUL_TIM"
#endif

#define DELAY_US 1000000


uint32_t g_counter = 0;
static void test_counter_interrupt_fn(const struct device *counter_dev, void *user_data)
{
	printk("g_counter: %d\n",g_counter);
	if(g_counter>=10){
		counter_stop(counter_dev);
	}
	g_counter++;
}


void main(void)
{
	const struct device *counter_dev;
	int err;
	struct counter_top_cfg top_cfg;
	printk("Counter alarm sample\n\n");
	counter_dev = device_get_binding(DEVICE_NAME);
	if (counter_dev == NULL) {
		printk("counter device not found\n");
		return;
	}
	top_cfg.flags = 0;
	top_cfg.ticks = counter_us_to_ticks(counter_dev, DELAY_US);
	top_cfg.callback = test_counter_interrupt_fn;
	top_cfg.user_data = NULL;
	err = counter_set_top_value(counter_dev, &top_cfg);
	if (err < 0) {
		printk("counter_set_channel_alarm err %d\n",err);
	}
	while (1)
	{
		g_counter = 0;
		counter_start(counter_dev);
		k_msleep(12000);
		printk("restart\n");
	}	
}
```
