## CMakeLists.txt
```
# SPDX-License-Identifier: Apache-2.0

cmake_minimum_required(VERSION 3.20.0)
find_package(Zephyr REQUIRED HINTS $ENV{ZEPHYR_BASE})
project(console_shell)

FILE(GLOB app_sources src/*.c)
target_sources(app PRIVATE ${app_sources})
```

## Kconfig
```
# Copyright (c) 2021 listenai Intelligent Technology (anhui) Co., Ltd.
# SPDX-License-Identifier: Apache-2.0

config USB_DEVICE_PID
	default USB_PID_CONSOLE_SAMPLE

source "Kconfig.zephyr"
```

## sample.yaml
```
tests:
  sample.board.csk6.subsys.usb.cdc.console_shell:
    platform_allow: csk6002_c3_nano csk6002_9s_nano csk6011a_9s_nano
    build_only: true
    tags: csk6
```

## prj.conf
```kconfig
CONFIG_USB_DEVICE_STACK=y
CONFIG_USB_DEVICE_PRODUCT="Zephyr USB console sample"

CONFIG_SERIAL=y
CONFIG_UART_LINE_CTRL=y

CONFIG_SHELL=y
CONFIG_SHELL_BACKEND_SERIAL_INIT_PRIORITY=51
```

## app.overlay
```dts
/*
 * Copyright (c) 2021 listenai Intelligent Technology (anhui) Co., Ltd.
 *
 * SPDX-License-Identifier: Apache-2.0
 */

 / {
	chosen {
		zephyr,console = &cdc_acm_uart0;
		zephyr,shell-uart = &cdc_acm_uart0;
	};
};

&zephyr_udc0 {
	cdc_acm_uart0: cdc_acm_uart0 {
		compatible = "zephyr,cdc-acm-uart";
		label = "CDC_ACM_0";
	};
};
```

## src/main.c
```c
/*
 * Copyright (c) 2021 listenai Intelligent Technology (anhui) Co., Ltd.
 *
 * SPDX-License-Identifier: Apache-2.0
 */

#include <zephyr.h>
#include <sys/printk.h>
#include <usb/usb_device.h>
#include <drivers/uart.h>

void main(void)
{
	if (usb_enable(NULL)) {
		return;
	}

	while (1) {
		printk("Hello World! %s\n", CONFIG_ARCH);
		k_sleep(K_SECONDS(1));
	}
}
```
