## Kconfig
```
# Copyright (c) 2021 listenai Intelligent Technology (anhui) Co., Ltd.
# SPDX-License-Identifier: Apache-2.0

config USB_DEVICE_PID
	default USB_PID_DFU_SAMPLE

source "Kconfig.zephyr"
```

## sample.yaml
```
sample:
  name: USB DFU sample
tests:
  sample.board.csk6.subsys.usb.dfu:
    platform_allow: csk6002_c3_nano csk6002_9s_nano csk6011a_9s_nano
    tags: csk6
    build_only: true
```

## prj.conf
```kconfig
CONFIG_STDOUT_CONSOLE=y
CONFIG_GPIO=y
CONFIG_USB_DEVICE_STACK=y
CONFIG_USB_DEVICE_PRODUCT="Zephyr DFU sample"
CONFIG_USB_DFU_CLASS=y
CONFIG_FLASH=y
CONFIG_IMG_MANAGER=y
CONFIG_FLASH_PAGE_LAYOUT=y
CONFIG_LOG=y
CONFIG_USB_DRIVER_LOG_LEVEL_ERR=y
CONFIG_USB_DEVICE_LOG_LEVEL_ERR=y
CONFIG_BOOTLOADER_MCUBOOT=y

CONFIG_IMG_BLOCK_BUF_SIZE=4096
CONFIG_USB_REQUEST_BUFFER_SIZE=4096
CONFIG_SYSTEM_WORKQUEUE_STACK_SIZE=4096
CONFIG_USB_DFU_DEFAULT_POLLTIMEOUT=1
```

## boards/csk6002_9s_nano.overlay
```dts
&flash0 {
    /*
     * For more information, see:
     * http: //docs.zephyrproject.org/latest/guides/dts/index.html#flash-partitions
     */
    partitions {
    
            /* application image slot: 512KB */
            slot0_partition: partition@40000 {
                    label = "image-0";
                    reg = <0x40000 0x80000>;
            };

            /* backup slot: 512KB */
            slot1_partition: partition@c0000 {
                    label = "image-1";
                    reg = <0xc0000 0x80000>;
            };
    };
};
```

## src/main.c
```c
/*
 * Copyright (c) 2021 listenai Intelligent Technology (anhui) Co., Ltd.
 *
 * SPDX-License-Identifier: Apache-2.0
 */

/* Sample app for USB DFU class driver. */

#include <zephyr.h>
#include <logging/log.h>
#include <usb/usb_device.h>
LOG_MODULE_REGISTER(main);

void main(void)
{
	int ret;

	ret = usb_enable(NULL);
	if (ret != 0) {
		LOG_ERR("Failed to enable USB");
		return;
	}

	LOG_INF("This device supports USB DFU class.\n");
}
```
