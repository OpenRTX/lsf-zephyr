## sample.yaml
```
sample:
  name: USB audio headset sample
tests:
  sample.board.csk6.subsys.usb.audio.headset:
    depends_on: usb_device
    tags: csk6 usb
    platform_allow: csk6002_9s_nano csk6011a_nano
    harness: console
    harness_config:
      type: multi_line
      ordered: true
      regex:
        - "Entered main"
        - "Found USB Headset Device"
        - "USB enabled"
```

## prj.conf
```kconfig
CONFIG_STDOUT_CONSOLE=y

#USB related configs
CONFIG_USB_DEVICE_STACK=y
CONFIG_USB_DEVICE_PRODUCT="Zephyr USB audio sample"

#LOG subsystem related configs
CONFIG_LOG=y
CONFIG_LOG_BUFFER_SIZE=10240
CONFIG_USB_DRIVER_LOG_LEVEL_ERR=y
CONFIG_USB_DEVICE_LOG_LEVEL_ERR=y

#net buf options
CONFIG_NET_BUF=y
CONFIG_NET_BUF_USER_DATA_SIZE=0

#USB audio related configs
CONFIG_USB_DEVICE_AUDIO=y

CONFIG_USB_DEVICE_VID=0x3420
CONFIG_USB_DEVICE_PID=0x0108
CONFIG_USB_DEVICE_MANUFACTURER="ListenAi"
CONFIG_USB_DEVICE_PRODUCT="ListenAi USB audio sample"
CONFIG_USB_DEVICE_SN="0123456789ABCDB0"

# CONFIG_USB_AUDIO_LOG_LEVEL_DBG=y

CONFIG_PRINTK_SYNC=y
```

## app.overlay
```dts
/*
 * Copyright (c) 2019 Nordic Semiconductor ASA
 *
 * SPDX-License-Identifier: Apache-2.0
 */


#define MICROPHONE    0x0201
#define DESKTOP_MIC   0x0202
#define PERSONAL_MIC  0x0203

#define SPEAKER        0x0301
#define HEADPHONES     0x0302
#define HEAD_AUDIO     0x0303

&zephyr_udc0 {
	hs_0 {
		label = "HEADSET";
		compatible = "usb-audio-hs";
		mic-feature-mute;
		mic-channel-l;
		mic-channel-r;
		mic-device-type = <MICROPHONE>;

		hp-feature-mute;
		hp-channel-l;
		hp-channel-r;
		hp-feature-volume;
		hp-device-type = <SPEAKER>;
	};
};
```

## src/main.c
```c
/*
 * Copyright (c) 2020 Nordic Semiconductor ASA
 *
 * SPDX-License-Identifier: Apache-2.0
 */

/**
 * @file
 * @brief Sample app for Audio class
 */

#include <zephyr.h>
#include <logging/log.h>
#include <usb/usb_device.h>
#include <usb/class/usb_audio.h>

LOG_MODULE_REGISTER(main, LOG_LEVEL_INF);

static void data_received(const struct device *dev,
			  struct net_buf *buffer,
			  size_t size)
{
	int ret;

	if (!buffer || !size) {
		/* This should never happen */
		return;
	}

	LOG_DBG("Received %d data, buffer %p", size, buffer);

	/* Check if the device OUT buffer can be used for input */
	if (size == usb_audio_get_in_frame_size(dev)) {
		ret = usb_audio_send(dev, buffer, size);
		if (ret) {
			net_buf_unref(buffer);
		}
	} else {
		net_buf_unref(buffer);
	}
}

static void feature_update(const struct device *dev,
			   const struct usb_audio_fu_evt *evt)
{
	LOG_DBG("Control selector %d for channel %d updated",
		evt->cs, evt->channel);
	switch (evt->cs) {
	case USB_AUDIO_FU_MUTE_CONTROL:
		break;
	case USB_AUDIO_FU_VOLUME_CONTROL:
		LOG_INF("[%s] volume: %d, val_len: %d", __FUNCTION__, *((int16_t *)(evt->val)), evt->val_len);
		break;
	default:
		break;
	}
}

static const struct usb_audio_ops ops = {
	.data_received_cb = data_received,
	.feature_update_cb = feature_update,
};

void main(void)
{
	const struct device *hs_dev;
	int ret;

	LOG_INF("Entered %s", __func__);
	hs_dev = device_get_binding("HEADSET");

	if (!hs_dev) {
		LOG_ERR("Can not get USB Headset Device");
		return;
	}

	LOG_INF("Found USB Headset Device");

	usb_audio_register(hs_dev, &ops);

	ret = usb_enable(NULL);
	if (ret != 0) {
		LOG_ERR("Failed to enable USB");
		return;
	}

	LOG_INF("USB enabled");
}
```
