/ {
	chosen {
		zephyr,console = &cdc_acm_uart0;
	};
};

zephyr_udc0: &usbotg {
	status = "okay";
	num-bidir-endpoints = <6>;
	num-in-endpoints = <6>;
	num-out-endpoints = <6>;

	cdc_acm_uart0: cdc_acm_uart0 {
		compatible = "zephyr,cdc-acm-uart";
		label = "CDC_ACM_0";
	};
};
