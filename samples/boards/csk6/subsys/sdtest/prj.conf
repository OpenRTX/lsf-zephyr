## CMakeLists.txt
```
# SPDX-License-Identifier: Apache-2.0

cmake_minimum_required(VERSION 3.20.0)
find_package(Zephyr REQUIRED HINTS $ENV{ZEPHYR_BASE})
project(sdmmc)

target_sources(app PRIVATE src/main.c src/res_storage.c src/spi_mock.c src/loadcp.c)
```

## sample.yaml
```
tests:
```

## prj.conf
```kconfig
CONFIG_DISK_ACCESS=y
CONFIG_DISK_DRIVER_SDMMC=y

CONFIG_LOG=y
CONFIG_LOG_MODE_MINIMAL=y

CONFIG_HEAP_MEM_POOL_SIZE=153600

CONFIG_DMA=y

CONFIG_CSK_HEAP=y
CONFIG_CSK_HEAP_MEM_POOL_SIZE=6291456

CONFIG_SPI=y
```

## src/main.c
```c
/*
 * SPDX-License-Identifier: Apache-2.0
 */

#include <zephyr/zephyr.h>
#include <zephyr/storage/disk_access.h>
#include <zephyr/device.h>
#include <logging/log.h>
#include <csk_malloc.h>
#include <cache.h>
#include "res_storage.h"
LOG_MODULE_REGISTER(sample, LOG_LEVEL_DBG);

#define VALIDATION_DATA		(0)
#define STORAGE_TESTSELF	(0)

//使用限定sram内存下，测试读写不同长度的速率
uint32_t bytes_per_tests[4] = {1024 * 1024 * 2, 1024 * 1024 * 3, 1024 * 1024 * 4, 1024 * 1024 * 5};
uint32_t sram_size[2] = {1024 * 25, 1024 * 50};

void *psram_buf = NULL;

void test_csk_sdcard_setup(void)
{
	int rc;

	rc = res_storage_init();
	if(rc != 0){
		LOG_ERR(" res storage initialization failed\n");
	}

#if STORAGE_TESTSELF
	res_storage_testself();
#endif
}

void test_csk_sdcard_wr(void)
{
	int ret = 0;

	for(uint8_t i = 0; i < sizeof(bytes_per_tests)/sizeof(bytes_per_tests[0]); i++){
		psram_buf = csk_malloc(bytes_per_tests[i]);
		if(!psram_buf){
			LOG_ERR(" psram malloc err(0x%x) \n", bytes_per_tests[i]);
		}
		for(uint8_t j = 0; j < sizeof(sram_size)/sizeof(sram_size[0]); j++){
			res_storage_cgf_t cfg;
			cfg.inner_ram_size = sram_size[j];
			ret = res_storage_config(&cfg);
			if(ret != 0){
				LOG_ERR(" res_storage_config failed 0x%x\n", cfg.inner_ram_size);
				return;
			}

			LOG_DBG(" data size:%d MB  sram buf size:%d KB \n", bytes_per_tests[i] / (1024 * 1024), sram_size[j] / 1024);
#if VALIDATION_DATA
			for(uint32_t j = 0; j < bytes_per_tests[i]; j++){
				*((uint8_t *)psram_buf + j)= (uint8_t)j % (i + 13);
			}
			res_storage_write(psram_buf, 0, bytes_per_tests[i]);
			memset(psram_buf, 0, bytes_per_tests[i]);
#endif
			ret = res_storage_copy(0, psram_buf, bytes_per_tests[i]);
			if(ret != 0){
				LOG_ERR("disk_sdmmc_tests failed, %d", ret);
				return;
			}

#if VALIDATION_DATA
			sys_cache_data_range(psram_buf, bytes_per_tests[i], K_CACHE_INVD);
			for(uint32_t j = 0; j < bytes_per_tests[i]; j++){
				if(*((uint8_t *)psram_buf + j) != (uint8_t)j % (i + 13)){
					LOG_ERR("test_csk_sdcard_wr err psram_buf[%d] = %d", j, *((uint8_t *)psram_buf + j));
					break;
				}
			}
#endif			
		}

		csk_free(psram_buf);
	}
}

extern int load_cp(void);
extern void spi_mock(void);
void main(void)
{
	load_cp();
	spi_mock();
	k_sleep(K_USEC(1000));	//等待CP和SPI MOCK执行起来
	test_csk_sdcard_setup();
	test_csk_sdcard_wr();
}
```

## src/loadcp.c
```c
#include <device.h>
#include <zephyr.h>
#include <stdio.h>
#include <stdlib.h>


// #define LOG_LEVEL 4
#include <logging/log.h>
LOG_MODULE_REGISTER(loadcp);

#include <hal/reg/cmn_sysctrl_reg_venus.h>
#include <hal/venus_ap.h>

int load_cp(void)
{
#define SYSCTRL_RESET_CP    	(0xCAFE000B)
#define SYSCTRL_RELEASE_CP  	(0xCAFE100B)
#define SYSCTRL_RESET_NPU   	(0xCAFE000C)
#define CP_PSRAM_BASE           (0x60000000)
#define AP_PSRAM_BASE           (0x30000000)
#define CP_FLASH_BASE         (0x68400000)  
    SYSCFG_RegDef *cmn_sys_ctrl = (SYSCFG_RegDef *)CMN_SYSCTRL_BASE;

    // set boot address
    cmn_sys_ctrl->REG_CP_CTRL2.all = CP_PSRAM_BASE;
    cmn_sys_ctrl->REG_CP_CTRL1.bit.CP_STAT_VECTOR_SEL = 0x1;

    // stall HIFI4
    cmn_sys_ctrl->REG_CP_CTRL1.bit.CP_HIFI4_RUNSTALL = 0x1;

	// release CP & NPU
	cmn_sys_ctrl->REG_SW_RESET_CP.all = SYSCTRL_RELEASE_CP;
	if(cmn_sys_ctrl->REG_SW_RESET_NPU.all){ // = 1 NPU reset
		cmn_sys_ctrl->REG_SW_RESET_NPU.all = SYSCTRL_RESET_NPU;
	}

	__DMB();
	// copy cp code to psram
	memcpy((void *)AP_PSRAM_BASE, (void *)0x18400000, 290000);
	dcache_clean_range(AP_PSRAM_BASE, AP_PSRAM_BASE + 290000);

	__DSB();

	// run cp
	cmn_sys_ctrl->REG_SW_RESET_CP.all = SYSCTRL_RESET_CP;
	cmn_sys_ctrl->REG_SW_RESET_CP.all = SYSCTRL_RELEASE_CP;
	cmn_sys_ctrl->REG_CP_CTRL1.bit.CP_HIFI4_RUNSTALL = 0x0;

	return 0;
}
```

## src/res_storage.c
```c
#include <zephyr/zephyr.h>
#include <zephyr/device.h>
#include <zephyr/storage/disk_access.h>
#include <drivers/dma.h>
#include "res_storage.h"

// #define LOG_LEVEL 4
#include <logging/log.h>
LOG_MODULE_REGISTER(res_storage);

#define TRACE_TIME_COST (1)
#define TEST_DMA_COPY   (0)

#define DMA_COPY_MAX_SIZE   (4 * 4000)

typedef struct {
    const struct device *dma;
    struct k_sem dma_done;
    uint32_t src;
    uint32_t dst;
    uint32_t size;
    uint32_t burst_size;
} dma_copy_t;

typedef struct {
    const char *disk_pdrv;
    uint32_t disk_sector_count;
    uint32_t disk_sector_size;
    void *inner_buffer;
    uint8_t pingpong;
    uint32_t inner_ram_size;
    dma_copy_t dma_copy;
} res_storage_info_t;

res_storage_info_t res_storage;

static int _dma_copy(uint32_t src, uint32_t dst, uint32_t size);

void dma_callback(const struct device *dev, void *user_data, uint32_t channel, int status)
{
    dma_copy_t *dma_copy = &res_storage.dma_copy;

    if(dma_copy->size > 0){

        dma_copy->src += dma_copy->burst_size;
        dma_copy->dst += dma_copy->burst_size;
        dma_copy->burst_size = dma_copy->size > DMA_COPY_MAX_SIZE ? DMA_COPY_MAX_SIZE : dma_copy->size;
        dma_copy->size -= dma_copy->burst_size;

        _dma_copy(dma_copy->src, dma_copy->dst, dma_copy->burst_size);
        // dma_reload(dma_copy->dma, 1, dma_copy->src, dma_copy->dst, dma_copy->burst_size);
        // dma_start(dma_copy->dma, 1);
    }else{
        k_sem_give(&dma_copy->dma_done);
    }

}

static int _dma_copy(uint32_t src, uint32_t dst, uint32_t size) 
{
    int ret = 0;
    dma_copy_t *dma_copy = &res_storage.dma_copy;

    // LOG_DBG("[%s] src:0x%x dst:0x%x size:0x%x\n", __FUNCTION__, src, dst, size);

    struct dma_block_config block_config = {
        .source_address = src,
        .dest_address = dst,
        .block_size = size,
        .dest_addr_adj = DMA_ADDR_ADJ_INCREMENT,
        .source_addr_adj = DMA_ADDR_ADJ_INCREMENT,
    };

    struct dma_config dma_cfg = {
        .channel_direction = MEMORY_TO_MEMORY,
        .dma_callback = dma_callback,
        .user_data = NULL,
        .block_count = 1,
        .head_block = &block_config,
        .source_data_size = 4,
        .dest_data_size = 4,
        .source_burst_length = 1,
        .dest_burst_length = 1,
        .channel_priority = 1,
    };    

    ret = dma_config(dma_copy->dma, 1, &dma_cfg);
    if (ret != 0) {
        LOG_ERR("DMA config failed, return value:%d\n", ret);
        return -1;
    }

    ret = dma_start(dma_copy->dma, 1);
    if (ret != 0) {
        LOG_ERR("DMA start failed.\n");
        return -1;
    }    

    return 0;
}

static int dma_copy(uint32_t src, uint32_t dst, uint32_t size) 
{
    int ret = 0;
    dma_copy_t *dma_copy = &res_storage.dma_copy;

    LOG_DBG("[%s] src:0x%x dst:0x%x size:0x%x\n", __FUNCTION__, src, dst, size);

    // uint32_t time = k_cycle_get_32();

    ret = k_sem_take(&dma_copy->dma_done, K_NO_WAIT);
    if(ret == -EBUSY){
        LOG_INF("[%s]", __FUNCTION__);
    }
    
    dma_copy->burst_size = size > DMA_COPY_MAX_SIZE ? DMA_COPY_MAX_SIZE : size;
    dma_copy->size = size - dma_copy->burst_size;
    dma_copy->src = src;
    dma_copy->dst = dst;

    _dma_copy(dma_copy->src, dma_copy->dst, dma_copy->burst_size);

    // time = k_cycle_get_32() - time;

    // LOG_INF("DMA copy cost time: %d us\n", (uint32_t)((double)time / sys_clock_hw_cycles_per_sec() * 1000 * 1000));

    return 0;
}

int res_storage_init(void)
{
    int rc = 0;
    uint32_t cmd_buf;
    dma_copy_t *dma_copy = &res_storage.dma_copy;

    dma_copy->dma = DEVICE_DT_GET(DT_NODELABEL(dma0));
    if (!device_is_ready(dma_copy->dma)) {
        LOG_ERR("DMA device failed.\n");
        return -ENODEV;
    }

    k_sem_init(&dma_copy->dma_done, 1, 1);

    res_storage.disk_pdrv = CONFIG_SDMMC_VOLUME_NAME;

	rc = disk_access_init(res_storage.disk_pdrv);
    if(rc != 0){
        LOG_ERR("Disk access initialization failed");
        return -1;
    }

	rc = disk_access_status(res_storage.disk_pdrv);
    if(rc != DISK_STATUS_OK){
        LOG_ERR("Disk status is not OK");
        return -1;
    }

	rc = disk_access_ioctl(res_storage.disk_pdrv, DISK_IOCTL_GET_SECTOR_COUNT, &cmd_buf);
    if(rc != 0){
        LOG_ERR("Disk ioctl get sector count failed");
        return -1;
    }

	LOG_INF("Disk reports %u sectors\n", cmd_buf);
	res_storage.disk_sector_count = cmd_buf;

	rc = disk_access_ioctl(res_storage.disk_pdrv, DISK_IOCTL_GET_SECTOR_SIZE, &cmd_buf);
    if(rc != 0){
        LOG_ERR("Disk ioctl get sector size faileds");
        return -1;
    }

	LOG_INF("Disk reports sector size %u\n", cmd_buf);
	res_storage.disk_sector_size = cmd_buf;

    return 0;
}

int res_storage_config(res_storage_cgf_t *cfg)
{

    if(res_storage.inner_buffer){
        k_free(res_storage.inner_buffer);
    }

    res_storage.pingpong = 0;
    res_storage.inner_buffer = k_malloc(cfg->inner_ram_size * 2);
    res_storage.inner_ram_size = cfg->inner_ram_size;
    if(!res_storage.inner_buffer){
        LOG_ERR("[%s %d] Failed to malloc", __FUNCTION__, __LINE__);
        return -1;
    }

    return 0;
}

int res_storage_write(void *src, void *dst, uint32_t size)
{
    int ret = 0;
    uint32_t i;
	uint32_t num_sector = size/res_storage.disk_sector_size;
	uint32_t burst_num = res_storage.inner_ram_size/res_storage.disk_sector_size;   
    uint32_t src_addr = (uint32_t)src;

	for(i = 0; i < num_sector/burst_num; i++){
        memcpy((void *)res_storage.inner_buffer, (void *)src_addr, res_storage.inner_ram_size);
		ret = disk_access_write(res_storage.disk_pdrv, res_storage.inner_buffer, (uint32_t)dst + i * burst_num, burst_num);
		if (ret) {
			LOG_ERR("disk_access_write failed (%d)\n", ret);
			return -EIO;
		}

        src_addr += res_storage.inner_ram_size;
	}     

    if(num_sector % burst_num != 0){
        memcpy((void *)res_storage.inner_buffer, (void *)src_addr, (num_sector % burst_num) * res_storage.disk_sector_size);
		ret = disk_access_write(res_storage.disk_pdrv, res_storage.inner_buffer, (uint32_t)dst + i * burst_num, num_sector % burst_num);
		if (ret) {
			LOG_ERR("disk_access_write failed (%d)\n", ret);
			return -EIO;
		}

    }

    return 0;
}

int res_storage_testself(void)
{
    uint8_t *buf;
    int ret = 0;

    buf = k_malloc(res_storage.disk_sector_size);
    if(!buf){
        LOG_ERR("[%s] malloc faild! \n", __FUNCTION__);
        return -EIO;
    }

    for(uint32_t i = 0; i < res_storage.disk_sector_count; i++){
        for(uint32_t j = 0; j < res_storage.disk_sector_size; j++){
            buf[j] = (uint8_t)(j + i);
        }

        ret = disk_access_write(res_storage.disk_pdrv, buf, i, 1);
        if (ret) {
            LOG_ERR("[%s] disk_access_write failed (%d) num %d\n", __FUNCTION__, ret, i);
            return -EIO;
        }

        memset((void *)buf, 0, res_storage.disk_sector_size);

        ret = disk_access_read(res_storage.disk_pdrv, buf, i, 1);
        if (ret) {
            LOG_ERR("[%s] disk_access_read failed (%d) num %d\n", __FUNCTION__, ret, i);
            return -EIO;
        }

        for(uint32_t j = 0; j < res_storage.disk_sector_size; j++){
            if(buf[j] != (uint8_t)(j + i)){
                LOG_ERR("[%s] res_storage_testself err buf[%d] = %d\n", __FUNCTION__, j, buf[j]);
                return -EIO;
            }
        }
    }

    LOG_INF("res_storage_testself ok\n");

    return 0;
}

int res_storage_copy(void *src, void *dst, uint32_t size)
{
    int ret = 0;
    uint32_t i;
    uint8_t *databuf;
    uint32_t dst_addr = (uint32_t)dst;
	uint32_t read_time = 0;
	uint32_t num_sector = size/res_storage.disk_sector_size;
	uint32_t burst_num = res_storage.inner_ram_size/res_storage.disk_sector_size;

    if(size % res_storage.disk_sector_size != 0 || size == 0){
        LOG_ERR("[%s %d] Failed to operation", __FUNCTION__, __LINE__);
        return -EIO;
    }

    LOG_DBG("[%s] num_sector:%d burst_num:%d\n", __FUNCTION__, num_sector, burst_num);

	read_time = k_uptime_get_32();
	for(i = 0; i < num_sector/burst_num; i++){
        databuf = (uint8_t *)res_storage.inner_buffer + res_storage.pingpong * res_storage.inner_ram_size;
        res_storage.pingpong ^= 0x01;
#if TEST_DMA_COPY
        for(uint32_t j = 0; j < res_storage.inner_ram_size; j++){
            databuf[j] = j;
        }
#else
		ret = disk_access_read(res_storage.disk_pdrv, databuf, (uint32_t)src + i * burst_num, burst_num);
		if (ret) {
			LOG_ERR("disk_access_write failed (%d)\n", ret);
			return -EIO;
		}
#endif
        dma_copy((uint32_t)databuf, dst_addr, res_storage.inner_ram_size);
        dst_addr += res_storage.inner_ram_size;
	}

    if(num_sector % burst_num != 0){
        databuf = (uint8_t *)res_storage.inner_buffer + res_storage.pingpong * res_storage.inner_ram_size;
        res_storage.pingpong ^= 0x01;
#if TEST_DMA_COPY
        uint8_t *buf = (uint8_t *)res_storage.inner_dma_buffer;
        for(uint32_t j = 0; j < res_storage.inner_ram_size; j++){
            buf[j] = j;
        }
#else
		ret = disk_access_read(res_storage.disk_pdrv, databuf, (uint32_t)src + i * burst_num, num_sector % burst_num);
		if (ret) {
			LOG_ERR("disk_access_write failed (%d)\n", ret);
			return -EIO;
		}
#endif
        dma_copy((uint32_t)databuf, dst_addr, (num_sector % burst_num) * res_storage.disk_sector_size);
    }

	read_time = k_uptime_get_32() - read_time;

	LOG_INF(" read cost:%d(ms), rate:%3.1f MB/s  \n", read_time, (size * 1000.0)/(read_time * 1024 * 1024));

#if TEST_DMA_COPY
    uint8_t *dst_buf = (uint8_t *)dst;
    SCB_InvalidateDCache_by_Addr((void *)dst_buf, size);
    for(uint32_t j = 0; j < size; j++){
        if(dst_buf[j] != (uint8_t)j){
            LOG_ERR("dma copy err (index:%d value:%d)\n", j, dst_buf[j]);
            break;
        }
    }
#endif
	return 0;
}
```

## src/res_storage.h
```c
#ifndef __RES_STORAGE_H__
#define __RES_STORAGE_H__

typedef struct {          
	uint32_t inner_ram_size;
} res_storage_cgf_t;

int res_storage_init(void);

int res_storage_config(res_storage_cgf_t *cfg);

int res_storage_copy(void *src, void *dst, uint32_t size);

int res_storage_write(void *src, void *dst, uint32_t size);

int res_storage_testself(void);

#endif  /* __RES_STORAGE_H__ */
```

## src/spi_mock.c
```c
/*
 * SPDX-License-Identifier: Apache-2.0
 */

#include <kernel.h>
#include <string.h>
#include <errno.h>
#include <zephyr.h>
#include <sys/printk.h>
#include <device.h>
#include <drivers/spi.h>
#include <csk_malloc.h>

#define TX_BUF_LEN	(4096)

// #define LOG_LEVEL 4
#include <logging/log.h>
LOG_MODULE_REGISTER(spi_mock);

K_THREAD_STACK_DEFINE(thread_stack, 2048);
struct k_thread spi_mock_thread;

const struct device *spi;

void spi_mock_thread_func(void *dummy1, void *dummy2, void *dummy3)
{
    (void)dummy1;
    (void)dummy2;
    (void)dummy3;

    struct spi_config spi_cfg = {0};
    /* spi master 8bit, LSB first*/
	spi_cfg.operation = SPI_WORD_SET(8) | SPI_OP_MODE_MASTER | SPI_TRANSFER_LSB;
	spi_cfg.frequency = 25 * 1000000UL;

    /* Make spi transaction package buffers */
	const int tx_package_num = 10;
	struct spi_buf *tx_package = k_calloc(tx_package_num, sizeof(struct spi_buf));
	if (tx_package == NULL) {
		LOG_ERR("tx_package calloc failed\n");
		return;
	}
	struct spi_buf_set tx_set;

	for (int tx_count = 0; tx_count < tx_package_num; tx_count++) {
		uint8_t *temp_buf = csk_malloc(TX_BUF_LEN);
		if (temp_buf == NULL) {
			LOG_ERR("temp_buf calloc failed\n");
			return;
		}

		tx_package[tx_count].len = TX_BUF_LEN;
		tx_package[tx_count].buf = temp_buf;
	}
	tx_set.buffers = tx_package;
	tx_set.count = tx_package_num;

	while (1) {
		LOG_DBG("spi master sending data ...\n");
		spi_write(spi, &spi_cfg, &tx_set);
	}
}

void spi_mock(void)
{
	spi = DEVICE_DT_GET(DT_NODELABEL(spi1));
	if (!device_is_ready(spi)) {
		LOG_ERR("SPI device %s is not ready\n", spi->name);
		return;
	}

    k_thread_create(&spi_mock_thread, thread_stack,
                    K_THREAD_STACK_SIZEOF(thread_stack),
                    spi_mock_thread_func, NULL, NULL, NULL,
                    K_HIGHEST_APPLICATION_THREAD_PRIO, K_USER,
                    K_NO_WAIT);

}
```
