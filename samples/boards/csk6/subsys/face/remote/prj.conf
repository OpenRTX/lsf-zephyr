## CMakeLists.txt
```
cmake_minimum_required(VERSION 3.20.0)

# SPDX-License-Identifier: Apache-2.0
#

if("${BOARD}" STREQUAL "ls_adsp_csk6")
set(ENV{ZEPHYR_TOOLCHAIN_VARIANT} "xcc-clang")
endif()

if("${BOARD}" STREQUAL "ls_adsp_csk6")
	message(STATUS " ${REMOTE_ZEPHYR_DIR} compiles as remote in this sample")
else()
	message(FATAL_ERROR "${BOARD} was not supported for this sample")
endif()
find_package(Zephyr HINTS $ENV{ZEPHYR_BASE})
project(sof_remote)


zephyr_include_directories(
  ./include
  ./include/luna/
  ./include/hifi/
  ./include/opi_cpy/
  ./include/face/
  ./include/img/
)

if(NOT CONFIG_ALGO_RES_BIN)
	message(STATUS "CONFIG_ALGO_RES_BIN is not defined")
	zephyr_include_directories(./include/res/)
else()
message(STATUS "generating inc file")
	set(gen_dir ${ZEPHYR_BINARY_DIR}/include/generated)

	foreach(inc_file
		gesture.bin
		head_shoulder_detect.bin
		)
	generate_inc_file_for_target(
		app
		res/${inc_file}
		${gen_dir}/${inc_file}.inc
		)
	endforeach()

endif()

target_sources(app PRIVATE
    src/main.c
    src/opi_psram_cpy.c
    src/main_app.c
  )


set(LIB_DIR  ${CMAKE_CURRENT_SOURCE_DIR}/lib)

target_link_libraries(app PUBLIC -Wl,--start-group 
						 -lgcc 
						 -lc 
						 -lm 
						 -lgloss 
						 -lminrt 
						#  ${LIB_DIR}/libopi_cpy.a 
             			 		 ${LIB_DIR}/libhifi_dsp.a 
						 ${LIB_DIR}/libluna.a 
						 ${LIB_DIR}/libthinker.a 
						 ${LIB_DIR}/libface.a 
						 -Wl,--end-group)
```

## Kconfig
```
# SPDX-License-Identifier: Apache-2.0

config ALGO_RES_BIN
	bool "Algo Resource Binary.Cmake will convert to inc file."
	default y

source "Kconfig.zephyr"
```

## prj.conf
```kconfig
# CONFIG_SOF=y
CONFIG_LOG=y
CONFIG_LOG_PRINTK=y
CONFIG_LOG_MODE_MINIMAL=y

CONFIG_BUILD_OUTPUT_BIN=y
CONFIG_IPM=y
# Requires heap_info() be implemented, but no Zephyr wrapper
CONFIG_DEBUG_MEMORY_USAGE_SCAN=n

CONFIG_SCHED_DEADLINE=y
CONFIG_SCHED_CPU_MASK=y
CONFIG_SMP_BOOT_DELAY=y

CONFIG_DMA=y

CONFIG_CBPRINTF_FP_SUPPORT=y

CONFIG_ASSERT=y

CONFIG_EXTERNAL_LIBC=y
CONFIG_STDOUT_CONSOLE=n

CONFIG_STACK_SENTINEL=y

CONFIG_HEAP_MEM_POOL_SIZE=20480
CONFIG_MAIN_STACK_SIZE=204800
```

## boards/ls_adsp_csk6.conf
```kconfig
CONFIG_CSK6=y
CONFIG_HAVE_AGENT=n
CONFIG_FORMAT_CONVERT_HIFI3=n
CONFIG_KPB_FORCE_COPY_TYPE_NORMAL=n
```

## src/main.c
```c
/*
 * Copyright (c) 2020 Intel Corporation.
 *
 * SPDX-License-Identifier: Apache-2.0
 */

#include <zephyr.h>

#include <logging/log.h>
#include <venus_cp.h>
#include <luna_bits.h>
#include <ClockManager.h>

LOG_MODULE_REGISTER(main, LOG_LEVEL_DBG);


extern void luna_init();
void sys_init(void)
{
    // enable NPU Clock
	__HAL_CRM_NPU_CLK_ENABLE();

    // release NPU
    if(IP_SYSCTRL->REG_SW_RESET_NPU.all){
        IP_SYSCTRL->REG_SW_RESET_NPU.all = 0xCAFE000C;
    }
    luna_init();

	uint32_t luna_val = *((volatile uint32_t *)(ADDR_LUNA_MODULE_ST));

	LOG_INF("luna_val: %d", luna_val);
}


extern void dma_init();
#define BUFFER_SIZE (1024 * 100)
// uint8_t dst_buffer[BUFFER_SIZE] __attribute__((aligned(4)));
// uint8_t src_buffer[BUFFER_SIZE] __attribute__((aligned(4)));
void main(void)
{

	LOG_INF("pilot app start");
	dma_init();
	sys_init();
	// printk("\nDMA copy start\n");

	// uint32_t start = k_cycle_get_32();
	// dma_cpy_async(0, src_buffer, dst_buffer, BUFFER_SIZE);
	// dma_wait_complete(0);
	// uint32_t time = (double)(k_cycle_get_32() - start) / sys_clock_hw_cycles_per_sec() * 1000 * 1000;
	// printk("DMA copy cost time: %d us\n", time);
	// printk("DMA copy finish\n");
	main_app(0, 0);
}
```

## src/opi_psram_cpy.c
```c
#include <stdio.h>
#include <stdlib.h>
#include <string.h>
#include <stdint.h>
#include <drivers/dma.h>
#include <opi_psram_cpy.h>
#include "hal/reg/dma_venus.h"
#include <zephyr.h>

#define USE_DMA_COPY

#ifdef USE_DMA_COPY
static uint32_t volatile DMAEvent;

static void DMA_DrvEvent(uint32_t event_info, uint32_t xfer_bytes, uint32_t usr_param)
{
    // printk("[%s]: event = %d, channel = %d, xfer_bytes = %d\r\n", __func__,
    //         event_info & 0xFF, (event_info >> 8) & 0xFF, xfer_bytes);
    DMAEvent = event_info & 0xFF;
}

#endif

#ifdef CONFIG_DMA
K_SEM_DEFINE(dma_sem, 0, 1);

void dma_callback(const struct device *dev, void *user_data, uint32_t channel, int status)
{
//     if (status == 0) {
        k_sem_give(&dma_sem);
//     }
}
#endif

void dma_init()
{
#ifdef CONFIG_DMA
    const struct device *dma = DEVICE_DT_GET(DT_NODELABEL(dma0));
    
    struct dma_block_config block_config = {
        .dest_addr_adj = DMA_ADDR_ADJ_INCREMENT,
        .source_addr_adj = DMA_ADDR_ADJ_INCREMENT,
    };
    
    
    struct dma_config dma_cfg = {
        .channel_direction = MEMORY_TO_MEMORY,
        .dma_callback = dma_callback,
        .user_data = NULL,
	.source_data_size = 4,
	.dest_data_size = 4,
	.head_block = &block_config
    };
	dma_config(dma, 0, &dma_cfg);
#else
	extern void dma_irq_handler(void);
	IRQ_CONNECT(3, 1, dma_irq_handler, NULL, 0);                                                                                                          
	irq_enable(3);
	dma_initialize();
#endif
}

void dma_wait_complete(int chn)
{
#ifdef USE_DMA_COPY

#ifdef CONFIG_DMA
	k_sem_take(&dma_sem, K_FOREVER);
#else
	// Block
	while(1){
		// Complete
		if(DMAEvent & DMA_EVENT_TRANSFER_COMPLETE){
			DMAEvent &= (~DMA_EVENT_TRANSFER_COMPLETE);
			break;
		}
		// Error
		if(DMAEvent & DMA_EVENT_ERROR){
			return;
		}
	}
#endif

#else
	return;
#endif
}

void dma_cpy_async(int chn, void *dst, void *src, int32_t size)
{
#ifdef USE_DMA_COPY
	if ((uint32_t)src >> 20 == 0x5fe)
	{
		src = (void *)((uint32_t)src & (uint32_t)0x480FFFFF);
	}
	if ((uint32_t)dst >> 20 == 0x5fe)
	{
		dst = (void *)((uint32_t)dst & (uint32_t)0x480FFFFF);
	}

#ifdef CONFIG_DMA
	const struct device *dma = DEVICE_DT_GET(DT_NODELABEL(dma0));
	dma_reload(dma, 0, (uint32_t)src, (uint32_t)dst, size);
	dma_start(dma, 0);
#else
    uint8_t real_channel = 2;

    dma_channel_select(&real_channel, DMA_DrvEvent, NULL, DMA_CACHE_SYNC_BOTH);

	dma_memcpy(real_channel, src, dst, size);
#endif

#else
	memcpy(dst, src, size);
#endif
}


void opi_psram_cpy_in(void *dst, void *src, int32_t size)
{
	//memcpy(dst, src, size);
	dma_cpy_async(0, dst, src, size);
	dma_wait_complete(0);
}

void opi_psram_cpy_out(void *dst, void *src, int32_t size)
{
	//memcpy(dst, src, size);
	dma_cpy_async(0, dst, src, size);
	dma_wait_complete(0);
}

void opi_psram_cpy_in_pro(void *dst, void *src, int32_t size, dma_sync_call_func func, void* param)
{
	if (NULL != func)
	{
		func(param);
	}
	memcpy(dst, src, size);
}

void opi_psram_cpy_out_pro(void *dst, void *src, int32_t size, dma_sync_call_func func, void* param)
{
	if (NULL != func)
	{
		func(param);
	}
	memcpy(dst, src, size);
}
```
