## CMakeLists.txt
```
# SPDX-License-Identifier: Apache-2.0

cmake_minimum_required(VERSION 3.20.0)

set(SUPPORT_BOARDS csk6012_nano csk6011a_nano)
if(NOT ${BOARD} IN_LIST SUPPORT_BOARDS)
    message("Please choose one of the following boards:")
    foreach(item ${SUPPORT_BOARDS})
        message(STATUS ${item})
    endforeach()
    message(FATAL_ERROR "\nThe project does not support the ${BOARD}")
endif()

set(CONF_FILE
  prj.conf
)

if(EXISTS "${CMAKE_CURRENT_SOURCE_DIR}/boards/${BOARD}.conf")
  list(APPEND CONF_FILE
    ${CMAKE_CURRENT_SOURCE_DIR}/boards/${BOARD}.conf
  )
endif()

if(EXISTS "${CMAKE_CURRENT_SOURCE_DIR}/resource/res.conf")
  list(APPEND CONF_FILE
    ${CMAKE_CURRENT_SOURCE_DIR}/resource/res.conf
  )
endif()

set(DTC_OVERLAY_FILE)

if(EXISTS "${CMAKE_CURRENT_SOURCE_DIR}/boards/${BOARD}.overlay")
  list(APPEND DTC_OVERLAY_FILE
    ${CMAKE_CURRENT_SOURCE_DIR}/boards/${BOARD}.overlay
  )
endif()

if(EXISTS "${CMAKE_CURRENT_SOURCE_DIR}/resource/res.overlay")
  list(APPEND DTC_OVERLAY_FILE
    ${CMAKE_CURRENT_SOURCE_DIR}/resource/res.overlay
  )
endif()

find_package(Zephyr REQUIRED HINTS $ENV{ZEPHYR_BASE})
project(sample_aplay)
target_sources(app PRIVATE src/main.c)

set(gen_dir ${ZEPHYR_BINARY_DIR}/include/generated)

generate_inc_file_for_target(
  app
  resource/audio.wav
  ${gen_dir}/test_audio.inc
)
```

## Kconfig
```
# Private config options for load sencond core firmware app

# SPDX-License-Identifier: Apache-2.0

# Workaround for not being able to have commas in macro arguments

DT_CHOSEN_Z_IPC_SHM := zephyr,ipc_shm

#SOF IPC MEMORY CONFIG
config SOF_IPC_SHM_BASE_ADDRESS
	default "$(dt_chosen_reg_addr_hex,$(DT_CHOSEN_Z_IPC_SHM))"

config SOF_IPC_SHM_SIZE
	default "$(dt_chosen_reg_size_hex,$(DT_CHOSEN_Z_IPC_SHM))"
	help
	  This option specifies size of the memory region to be used
	  for the SOF IPC shared memory

source "Kconfig.zephyr"
```

## sample.yaml
```
tests:
  sample.board.csk6.subsys.avf.audio.aplay:
    platform_allow: csk6011a_nano
    skip: true
    tags: csk6
    timeout: 20
    harness: console
    harness_config:
      type: multi_line
      regex:
      - "aplay run compelete and exit(.*)"
```

## prj.conf
```kconfig
CONFIG_PRINTK=y
CONFIG_DEBUG=y
CONFIG_LOG=y
CONFIG_LOG_MODE_IMMEDIATE=y
CONFIG_LOG_DETECT_MISSED_STRDUP=n
CONFIG_LOG_BACKEND_SHOW_COLOR=y
CONFIG_LOG_BACKEND_FORMAT_TIMESTAMP=y
CONFIG_LOG_BACKEND_UART=y
CONFIG_LOG_BACKEND_UART_OUTPUT_TEXT=y
CONFIG_MAIN_STACK_SIZE=2048

#system heap size,users can define it according to the actual usage
CONFIG_HEAP_MEM_POOL_SIZE=92160

#avf
CONFIG_AVF=y
CONFIG_AVF_DEBUG_LEVEL=1
CONFIG_AVF_USE_BINARY_ARRAY=y

#licak
CONFIG_LICAK=y
CONFIG_LICAK_MODULES_AUDIO_PLAYBACK=y
CONFIG_LICAK_DISABLE_MULTI_HEAP_INIT=y

#IPM and GPIO for avf driver
CONFIG_IPM=y
CONFIG_GPIO=y

#cache
CONFIG_CACHE_MANAGEMENT=y
```

## boards/csk6002_c3_nano.overlay
```dts
/*
 * SPDX-License-Identifier: Apache-2.0
 */
 / {
	 chosen {
		 /*
		  * shared memory reserved for the inter-processor communication
		  */
		 zephyr,ipc_shm = &psram_share;
		 zephyr,ipc = &mailbox0;
	 };
 
	 aliases {
		 avf-audio-pwr-amp = &pwr_amp;
	 };
	 pwr_amp:audio_pwr_amp{
		 compatible = "listenai,pwr-amp";
		 enable-gpios = <&gpioa 4 1>;
		 label = "audio_pwr_amp";	
		 status = "okay";
	 };
 
 };
 
 
```

## boards/csk6011a_nano.overlay
```dts
/*
 * SPDX-License-Identifier: Apache-2.0
 */
 / {
	 chosen {
		 /*
		  * shared memory reserved for the inter-processor communication
		  */
		 zephyr,ipc_shm = &psram_share;
		 zephyr,ipc = &mailbox0;
	 };
 
 };
 
 
```

## boards/csk6012_nano.overlay
```dts
/*
 * Copyright (c) 2023 Anhui(Shenzhen) Listenai Co., Ltd.
 *
 * SPDX-License-Identifier: Apache-2.0
 */
/ {
	chosen {
		/*
		 * shared memory reserved for the inter-processor communication
		 */
		zephyr,ipc_shm = &psram_share;
		zephyr,ipc = &mailbox0;
	};

	aliases {
		avf-audio-pwr-amp = &pwr_amp;
	};
	pwr_amp: audio_pwr_amp{
		compatible = "listenai,pwr-amp";
		enable-gpios = <&gpioa 4 1>;
		label = "audio_pwr_amp";
		status = "okay";
	};

};
```

## src/main.c
```c
/*
 * Copyright (c) 2023 Anhui(Shenzhen) Listenai Co., Ltd.
 *
 * SPDX-License-Identifier: Apache-2.0
 */

#include "dsp_resource.h"

#include "pwr_amp.c"
#include <avf/framework/avf_platform.h>
#include <avf/slogger.h>
#include <licak/licak.h>
#include <licak/modules/audio/aplay.h>
#include <zephyr.h>

#define ID_RIFF 0x46464952
#define ID_WAVE 0x45564157
#define ID_FMT	0x20746d66
#define ID_DATA 0x61746164
struct riff_wave_header {
	uint32_t riff_id;
	uint32_t riff_sz;
	uint32_t wave_id;
};

struct chunk_header {
	uint32_t id;
	uint32_t sz;
};

struct chunk_fmt {
	uint16_t audio_format;
	uint16_t num_channels;
	uint32_t sample_rate;
	uint32_t byte_rate;
	uint16_t block_align;
	uint16_t bits_per_sample;
};

static const char *read_buffer(char *pdest, const char *psrc, uint32_t size)
{
	const char *pos = psrc;

	memcpy(pdest, psrc, size);
	pos += size;
	return pos;
}

static const char *prase_wav_fmt(const char *audio_data, uint32_t size, amedia_fmt_t *fmt)
{
	struct riff_wave_header riff_wave_header;
	struct chunk_header chunk_header;
	struct chunk_fmt chunk_fmt;
	int more_chunks = 1;
	const char *pos = audio_data;

	pos = read_buffer((char *)&riff_wave_header, pos, sizeof(riff_wave_header));
	if ((riff_wave_header.riff_id != ID_RIFF) || (riff_wave_header.wave_id != ID_WAVE)) {
		SLOGE(LOG_TAG, "%s:%d, Error: audio format check failed.", __FUNCTION__, __LINE__);
		return NULL;
	}

	do {
		pos = read_buffer((char *)&chunk_header, pos, sizeof(chunk_header));
		switch (chunk_header.id) {
		case ID_FMT:
			pos = read_buffer((char *)&chunk_fmt, pos, sizeof(chunk_fmt));
			/* If the format header is larger, skip the rest */
			if (chunk_header.sz > sizeof(chunk_fmt)) {
				pos += chunk_header.sz - sizeof(chunk_fmt);
			}
			break;
		case ID_DATA:
			/* Stop looking for chunks */
			more_chunks = 0;
			break;
		default:
			/* Unknown chunk, skip bytes */
			pos += chunk_header.sz;
			break;
		}
	} while (more_chunks);

	fmt->bits = chunk_fmt.bits_per_sample;
	fmt->rate = chunk_fmt.sample_rate;
	fmt->channels = chunk_fmt.num_channels;
	fmt->compr = AMEDIA_COMPR_PCM;

	return pos;
}

#define PERIOD_BYTES(fmt) amedia_frames_to_bytes(fmt, 1000)

void main(void)
{
	aplay_t *aplay = NULL;
	amedia_fmt_t fmt;
	int32_t iret, write_bytes;
	const char *pstart;
	const char *pcm_data;
	uint32_t buffer_end;

	licak_init();

	memset(&fmt, 0, sizeof(amedia_fmt_t));
	pcm_data = prase_wav_fmt(test_audio, sizeof(test_audio), &fmt);
	if (pcm_data == NULL) {
		printk("test audio fmt error!.\n");
		return;
	}

	printk("Prepare start play wav and get audio fmt <PCM/%d/%d /%d>\n", fmt.rate, fmt.channels,
	       fmt.bits);
	/*step1: create aplyer instance*/
	aplay = aplay_create(APLAYER_SUBSTREAM_MAIN);
	if (aplay == NULL) {
		printk("acap_create failed!\n");
		return;
	}
	printk("Create aplay success\n");

	/*step2: set aplayer paramter*/
	if (0 != (iret = aplay_set_fmt(aplay, &fmt))) {
		printk("aplay_set_fmt failed!\n");
		return;
	}
	printk("Set audio fmt to aplay success\n");

	/*Enable audio power-amp*/
	audio_pwr_amp_init();
	audio_pwr_amp_enbale();

	/*step3: start play*/
	if (0 != (iret = aplay_start(aplay))) {
		printk("aplay_set_fmt failed.\n");
		return;
	}
	printk("Trigger play start success.\n");

	buffer_end = (uint32_t)test_audio + sizeof(test_audio);
	pstart = pcm_data;
	while ((uint32_t)pcm_data < buffer_end) {
		write_bytes = buffer_end - (uint32_t)pcm_data > PERIOD_BYTES(&fmt)
				      ? PERIOD_BYTES(&fmt)
				      : buffer_end - (uint32_t)pcm_data;
		/*step4: write data to aplayer*/
		iret = aplay_writei(aplay, (char *)pcm_data, write_bytes);
		if (iret != write_bytes) {
			printk("aplay_writei failed ret %d.\n", iret);
			break;
		}
		pcm_data += iret;
	}
	printk("Write play audio data compelete total size %d with timestamp %lld ms\n",
	       (uint32_t)(pcm_data - pstart), k_uptime_get());
	/*step5: drain or stop aplayer*/
	if (0 != (iret = aplay_drain(aplay))) {
		printk("aplay_drain failed.\n");
		return;
	}
	printk("play drain finsh with timestamp %lld ms\n", k_uptime_get());
	/*step6: destroy aplayer*/
	if (0 != (iret = aplay_destroy(aplay))) {
		printk("aplay_destroy failed.\n");
		return;
	}

	printk("aplay run compelete and exit.\n");
}
```

## src/dsp_resource.h
```c
/*
 * Copyright (c) 2023 Anhui(Shenzhen) Listenai Co., Ltd.
 *
 * SPDX-License-Identifier: Apache-2.0
 */

static const unsigned char test_audio[] = {
#include "test_audio.inc"
};
```

## src/pwr_amp.c
```c
/*
 * Copyright (c) 2023 Anhui(Shenzhen) Listenai Co., Ltd.
 *
 * SPDX-License-Identifier: Apache-2.0
 */

#include <device.h>
#include <drivers/gpio.h>
#include <zephyr.h>

#if defined(__ZEPHYR__) && (DT_NODE_HAS_STATUS(DT_ALIAS(avf_audio_pwr_amp), okay))

#define AVF_AUDIO_PWR_AMP	DT_GPIO_LABEL(DT_ALIAS(avf_audio_pwr_amp), enable_gpios)
#define AVF_AUDIO_PWR_AMP_PIN	DT_GPIO_PIN(DT_ALIAS(avf_audio_pwr_amp), enable_gpios)
#define AVF_AUDIO_PWR_AMP_FLAGS DT_GPIO_FLAGS(DT_ALIAS(avf_audio_pwr_amp), enable_gpios)

static inline void audio_pwr_amp_enbale(void)
{

	const struct device *dev;

	dev = device_get_binding(AVF_AUDIO_PWR_AMP);
	if (dev == NULL) {
		return;
	}
	gpio_pin_set(dev, AVF_AUDIO_PWR_AMP_PIN, 1);
}

static inline void audio_pwr_amp_disable(void)
{

	const struct device *dev;

	dev = device_get_binding(AVF_AUDIO_PWR_AMP);
	if (dev == NULL) {
		return;
	}
	gpio_pin_set(dev, AVF_AUDIO_PWR_AMP_PIN, 0);
}

static inline void audio_pwr_amp_init(void)
{
	int ret;
	const struct device *dev;

	dev = device_get_binding(AVF_AUDIO_PWR_AMP);
	if (dev == NULL) {
		return;
	}

	ret = gpio_pin_configure(dev, AVF_AUDIO_PWR_AMP_PIN, GPIO_OUTPUT_ACTIVE);
	if (ret < 0) {
		return;
	}
}

#else
#warning "The amplifier pins are not defined"

static inline void audio_pwr_amp_enbale(void)
{
}
static inline void audio_pwr_amp_disable(void)
{
}
static inline void audio_pwr_amp_init(void)
{
}

#endif
```
