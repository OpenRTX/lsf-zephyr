## CMakeLists.txt
```
# SPDX-License-Identifier: Apache-2.0

cmake_minimum_required(VERSION 3.20.0)

set(SUPPORT_BOARDS csk6012_nano csk6011a_nano)
if(NOT ${BOARD} IN_LIST SUPPORT_BOARDS)
    message("Please choose one of the following boards:")
    foreach(item ${SUPPORT_BOARDS})
        message(STATUS ${item})
    endforeach()
    message(FATAL_ERROR "\nThe project does not support the ${BOARD}")
endif()

set(CONF_FILE prj.conf)

if(EXISTS "${CMAKE_CURRENT_SOURCE_DIR}/boards/${BOARD}.conf")
  list(APPEND CONF_FILE
    ${CMAKE_CURRENT_SOURCE_DIR}/boards/${BOARD}.conf
  )
endif()

if(EXISTS "${CMAKE_CURRENT_SOURCE_DIR}/resource/res.conf")
  list(APPEND CONF_FILE
    ${CMAKE_CURRENT_SOURCE_DIR}/resource/res.conf
  )
endif()

set(DTC_OVERLAY_FILE)

if(EXISTS "${CMAKE_CURRENT_SOURCE_DIR}/boards/${BOARD}.overlay")
  list(APPEND DTC_OVERLAY_FILE
    ${CMAKE_CURRENT_SOURCE_DIR}/boards/${BOARD}.overlay
  )
endif()

if(EXISTS "${CMAKE_CURRENT_SOURCE_DIR}/resource/res.overlay")
  list(APPEND DTC_OVERLAY_FILE
    ${CMAKE_CURRENT_SOURCE_DIR}/resource/res.overlay
  )
endif()

find_package(Zephyr REQUIRED HINTS $ENV{ZEPHYR_BASE})
project(sample_aplay)
target_sources(app PRIVATE src/main.c)
```

## sample.yaml
```
tests:
  sample.board.csk6.subsys.avf.audio.acapture:
    platform_allow: csk6011a_nano
    skip: true
    tags: csk6
    timeout: 20
    harness: console
    harness_config:
      type: multi_line
      regex:
      - "acapture run compelete and exit(.*)"
```

## prj.conf
```kconfig
CONFIG_PRINTK=y
CONFIG_DEBUG=y
CONFIG_LOG=y
CONFIG_LOG_MODE_IMMEDIATE=y
CONFIG_LOG_DETECT_MISSED_STRDUP=n
CONFIG_LOG_BACKEND_SHOW_COLOR=y
CONFIG_LOG_BACKEND_FORMAT_TIMESTAMP=y
CONFIG_LOG_BACKEND_UART=y
CONFIG_LOG_BACKEND_UART_OUTPUT_TEXT=y
CONFIG_MAIN_STACK_SIZE=2048

#system heap size,users can define it according to the actual usage
CONFIG_HEAP_MEM_POOL_SIZE=92160

#avf
CONFIG_AVF=y
CONFIG_AVF_DEBUG_LEVEL=1
CONFIG_AVF_USE_BINARY_ARRAY=y

#licak
CONFIG_LICAK=y
CONFIG_LICAK_MODULES_AUDIO_CAPTURE=y
CONFIG_LICAK_DISABLE_MULTI_HEAP_INIT=y

#IPM and GPIO for avf driver
CONFIG_IPM=y

#cache
CONFIG_CACHE_MANAGEMENT=y
```

## boards/csk6002_c3_nano.overlay
```dts
/*
 * SPDX-License-Identifier: Apache-2.0
 */
/ {
	chosen {
		/*
		 * shared memory reserved for the inter-processor communication
		 */
		zephyr,ipc_shm = &psram_share;
		zephyr,ipc = &mailbox0;
	};

};
```

## boards/csk6011a_nano.overlay
```dts
/*
 * Copyright (c) 2023 Anhui(Shenzhen) Listenai Co., Ltd.
 *
 * SPDX-License-Identifier: Apache-2.0
 */
/ {
	chosen {
		/*
		 * shared memory reserved for the inter-processor communication
		 */
		zephyr,ipc_shm = &psram_share;
		zephyr,ipc = &mailbox0;
	};

};
```

## src/main.c
```c
/*
 * Copyright (c) 2023 Anhui(Shenzhen) Listenai Co., Ltd.
 *
 * SPDX-License-Identifier: Apache-2.0
 */

#include <avf/framework/avf_platform.h>
#include <avf/slogger.h>
#include <licak/licak.h>
#include <licak/modules/audio/acapture.h>
#include <zephyr.h>

#define ACAPTURE_DATA_EVENT_THRES  (1024)
#define ACAPTURE_DATA_TOTAL_LENGTH (1024 * 100)
#define ACAPTURE_MSGQ_NUMBER	   (10)
typedef struct {
	char *pdata;
	int datalen;
} msgq_data_t;

struct k_msgq acapture_msgq;

static void acapture_data_process(void *priv, acapture_event_msg_t msg)
{
	acapture_t *handle = (acapture_t *)priv;
	msgq_data_t msgq_data;

	uint32_t avail;
	int32_t readlen;
	int ret = 0;

	if (msg.event_flags & AVF_STREAM_EVENT_THRES_NOTIFY) {
		avail = msg.value.value;
		msgq_data.pdata = k_malloc(sizeof(char) * avail);
		if (msgq_data.pdata == NULL) {
			SLOGE(LOG_TAG, "[%s %d]k_malloc FAILED!", __FUNCTION__, __LINE__);
			return;
		}
		readlen = acap_get_datai(handle, msgq_data.pdata, avail);
		if (readlen > 0) {
			msgq_data.datalen = readlen;
			ret = k_msgq_put(&acapture_msgq, &msgq_data, K_NO_WAIT);
			if (ret) {
				k_free(msgq_data.pdata);
				SLOGE(LOG_TAG, "[%s %d]msgq message dropped", __FUNCTION__,
				      __LINE__);
			}
		} else {
			k_free(msgq_data.pdata);
		}
	}
}

void main(void)
{
	acapture_t *acapture = NULL;
	amedia_fmt_t fmt = {
		.rate = 16000,
		.channels = 1,
		.bits = 16,
		.compr = AMEDIA_COMPR_PCM,
	};
	uint32_t recv_bytes = 0;
	int iret = 0;
	static char buffer[sizeof(msgq_data_t) * ACAPTURE_MSGQ_NUMBER];
	msgq_data_t msgq_data;

	licak_init();

	k_msgq_init(&acapture_msgq, buffer, sizeof(msgq_data_t), ACAPTURE_MSGQ_NUMBER);

	/*step1: create acapture instance*/
	acapture = acap_create();
	if (acapture == NULL) {
		printk("acap_create failed!\n");
		return;
	}
	printk("Create acapture success\n");

	/*step2: set callback function*/
	if (0 != (iret = acap_event_register(acapture, AVF_STREAM_EVENT_THRES_NOTIFY,
					     acapture_data_process, acapture,
					     ACAPTURE_DATA_EVENT_THRES))) {
		printk("Register data event callback failed,iret %d\n", iret);
		return;
	}
	printk("Register data event callback success.\n");

	/*step3: set acapture paramter*/
	if (0 != (iret = acap_set_fmt(acapture, &fmt))) {
		printk("acap_set_fmt failed!\n");
		return;
	}
	printk("Set audio fmt<%d %d %d> to acapture success\n", fmt.rate, fmt.channels, fmt.bits);

	/*step4: start capture*/
	if (0 != (iret = acap_start(acapture))) {
		printk("acap_start failed.\n");
		return;
	}
	printk("Trigger capture start success.\n");

	/*step5: get audio data*/
	for (;;) {
		k_msgq_get(&acapture_msgq, &msgq_data, K_FOREVER);
		printk("Get audio data length %d \n", msgq_data.datalen);
		k_free(msgq_data.pdata);
		recv_bytes += msgq_data.datalen;
		if (recv_bytes >= ACAPTURE_DATA_TOTAL_LENGTH) {
			break;
		}
	}
	/*step6: stop acapture*/
	acap_stop(acapture);

	/*step7: destroy aplayer*/
	if (0 != (iret = acap_destroy(acapture))) {
		printk("aplay_destroy failed.\n");
		goto _END;
	}
	printk("acapture run compelete and exit.\n");
_END:
	/*clear message queue*/
	for (;;) {
		if (0 != k_msgq_get(&acapture_msgq, &msgq_data, K_NO_WAIT)) {
			break;
		}
		k_free(msgq_data.pdata);
	}
}
```

## src/dsp_resource.h
```c
/*
 * SPDX-License-Identifier: Apache-2.0
 */

static const unsigned char dsp_firmware[] = {
#include "dsp_firmware.inc"
};

static const unsigned char dsp_tplg[] = {
#include "dsp_tplg.inc"
};
```
