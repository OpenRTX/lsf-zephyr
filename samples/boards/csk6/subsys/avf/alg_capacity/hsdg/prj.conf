## CMakeLists.txt
```
# SPDX-License-Identifier: Apache-2.0

cmake_minimum_required(VERSION 3.20.0)

find_package(Zephyr REQUIRED HINTS $ENV{ZEPHYR_BASE})
project(sample_aplay)
target_sources(app PRIVATE src/main.c src/tts_playback.c)

set(gen_dir ${ZEPHYR_BINARY_DIR}/include/generated)

generate_inc_file_for_target(
  app
  resource/csk6_default.tplg
  ${gen_dir}/dsp_tplg.inc
)


generate_inc_file_for_target(
  app
  resource/zephyr.bin
  ${gen_dir}/cp_firmware.inc
)
```

## prj.conf
```kconfig
CONFIG_PRINTK=y
CONFIG_DEBUG=y
CONFIG_LOG=y
CONFIG_LOG_MODE_IMMEDIATE=y
CONFIG_LOG_DETECT_MISSED_STRDUP=n
CONFIG_LOG_BACKEND_SHOW_COLOR=y
CONFIG_LOG_BACKEND_FORMAT_TIMESTAMP=y
CONFIG_LOG_BACKEND_UART=y
CONFIG_LOG_BACKEND_UART_OUTPUT_TEXT=y
CONFIG_MAIN_STACK_SIZE=2048

#system heap size,users can define it according to the actual usage
CONFIG_HEAP_MEM_POOL_SIZE=92160

#avf 
CONFIG_AVF=y
# CONFIG_AVF_DSP_XIP=y
CONFIG_AVF_DSP_RUN_ADDRESS=0x60000000
CONFIG_AVF_DEBUG_LEVEL=4
CONFIG_AVF_USE_BINARY_ARRAY=y
CONFIG_AVF_MODULES_ALG_TTS=y

#licak
CONFIG_LICAK=y

#IPM and GPIO for avf driver
CONFIG_IPM=y
CONFIG_GPIO=y

#cache
CONFIG_CACHE_MANAGEMENT=y
```

## boards/csk6002_9s_nano.overlay
```dts
/*
 * SPDX-License-Identifier: Apache-2.0
 */
//  /delete-node/ &psram_cp;
//  /delete-node/ &psram_ap;
//  /delete-node/ &psram_share;
 / {
	 chosen {
		 /*
		  * shared memory reserved for the inter-processor communication
		  */
		 zephyr,ipc_shm = &psram_share;
		 zephyr,ipc = &mailbox0;
	 };
 
	 aliases {
		 avf-audio-pwr-amp = &pwr_amp;
	 };
	 pwr_amp:audio_pwr_amp{
		 compatible = "listenai,pwr-amp";
		 enable-gpios = <&gpioa 4 1>;
		 label = "audio_pwr_amp";	
		 status = "okay";
	 };
 
 };
 
//  &psram0{
// 	psram_cp: psram_cp@30000000 {
// 		compatible = "listenai,csk6-psram-partition";
// 		reg = < 0x30000000 0x6b0000 >;
// 		status = "okay";
// 	};
// 	psram_ap: psram_ap@30600000 {
// 		compatible = "zephyr,memory-region","listenai,csk6-psram-partition";
// 		reg = <0x30600000 0x100000>;
// 		status = "okay";
// 		zephyr,memory-region = "PSRAMAP";


// 	};
// 	psram_share: psram_share@30700000 {
// 		compatible = "listenai,csk6-psram-partition";
// 		reg = < 0x30700000 0x50000 >;
// 		status = "okay";
// 	};
// };
```

## src/main.c
```c
/*
 *
 * SPDX-License-Identifier: Apache-2.0
 */

#include <zephyr.h>
#include <avf/framework/avf_platform.h>
#include "dsp_resource.h"

#include "pwr_amp.c"

#define TTS_STRING "聆思科技完成数亿元pre-A轮融资！本轮融资由元禾璞华领投，沄柏资本联合领投，天际资本、中银集团旗下渤海基金、天智投资、连山基金跟投。在本轮融资的加持下，聆思科技必将进一步加速芯片研发，打造极简单芯片系统，助力万物智联时代的爆发。"

extern int  atts_playback(const char* tts_string);

void main(void)
{
	
	if(NULL == avf_stream_platform_register(cp_firmware, sizeof(cp_firmware), dsp_tplg,
				     sizeof(dsp_tplg))){
		printk("avf platform register failed,exit.\n");
		return;
	}
	printk("avf platform register success\n");

	/*Enable audio power-amp*/
	audio_pwr_amp_init();
    audio_pwr_amp_enbale();

	printk("tts playback start\n");
	if(0 != atts_playback(TTS_STRING)){
		printk("tts playback failed\n");
		return;
		
	}
	printk("tts playback over\n");
}
```

## src/dsp_resource.h
```c
/*
 * SPDX-License-Identifier: Apache-2.0
 */

static const unsigned char dsp_tplg[] = {
#include "dsp_tplg.inc"
};

static const unsigned char cp_firmware[] = {
#include "cp_firmware.inc"
};
```
