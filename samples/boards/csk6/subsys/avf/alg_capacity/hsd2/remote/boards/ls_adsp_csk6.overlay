&ls_adsp_csk6_pinctrl{
        pinctrl_uart2_rx_default: uart2_rx_default {
			pinctrls = < &pinmuxb 7 3 >;
		};

		pinctrl_uart2_tx_default: uart2_tx_default {
			pinctrls = < &pinmuxb 6 3 >;
		};
};

// &sram0 {
// 	reg = <0x60000698 DT_SIZE_M(6)>;
// };