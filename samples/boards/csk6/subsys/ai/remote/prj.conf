## CMakeLists.txt
```
cmake_minimum_required(VERSION 3.20.0)

# SPDX-License-Identifier: Apache-2.0
#

if("${BOARD}" STREQUAL "ls_adsp_csk6")
set(ENV{ZEPHYR_TOOLCHAIN_VARIANT} "xcc-clang")
endif()

if("${BOARD}" STREQUAL "ls_adsp_csk6")
	message(STATUS " ${REMOTE_ZEPHYR_DIR} compiles as remote in this sample")
else()
	message(FATAL_ERROR "${BOARD} was not supported for this sample")
endif()
find_package(Zephyr HINTS $ENV{ZEPHYR_BASE})
project(sof_remote)


zephyr_include_directories(
  ./include
  ./include/luna/
  ./include/hifi/
  ./include/opi_cpy/
  ./include/pilot/
  ./include/img/
  ./include/pilot_app/
)

if(NOT CONFIG_ALGO_RES_BIN)
	message(STATUS "CONFIG_ALGO_RES_BIN is not defined")
	zephyr_include_directories(./include/res/)
else()
message(STATUS "generating inc file")
	set(gen_dir ${ZEPHYR_BINARY_DIR}/include/generated)

	foreach(inc_file
		gesture.bin
		head_shoulder_detect.bin
		)
	generate_inc_file_for_target(
		app
		res/${inc_file}
		${gen_dir}/${inc_file}.inc
		)
	endforeach()

endif()

target_sources(app PRIVATE
    src/main.c
    src/opi_psram_cpy.c
    src/pilot_app.c
  )


set(LIB_DIR  ${CMAKE_CURRENT_SOURCE_DIR}/lib)

target_link_libraries(app PUBLIC -Wl,--start-group 
						 -lgcc 
						 -lc 
						 -lm 
						 -lgloss 
						 -lminrt 
						 ${LIB_DIR}/libopi_cpy.a 
             			 ${LIB_DIR}/libhifi_dsp.a 
						 ${LIB_DIR}/libluna.a 
						 ${LIB_DIR}/libthinker.a 
						 ${LIB_DIR}/libpilot.a 
						 -Wl,--end-group)
```

## prj.conf
```kconfig
# CONFIG_SOF=y
CONFIG_LOG=y
CONFIG_LOG_PRINTK=y
CONFIG_LOG_MODE_MINIMAL=y

CONFIG_BUILD_OUTPUT_BIN=y
CONFIG_IPM=y
# Requires heap_info() be implemented, but no Zephyr wrapper
CONFIG_DEBUG_MEMORY_USAGE_SCAN=n

CONFIG_SCHED_DEADLINE=y
CONFIG_SCHED_CPU_MASK=y
CONFIG_SMP_BOOT_DELAY=y

CONFIG_DMA=y

CONFIG_CBPRINTF_FP_SUPPORT=y

CONFIG_ASSERT=y

CONFIG_EXTERNAL_LIBC=y
CONFIG_STDOUT_CONSOLE=n

CONFIG_STACK_SENTINEL=y

CONFIG_HEAP_MEM_POOL_SIZE=10240
CONFIG_MAIN_STACK_SIZE=10240
```

## boards/ls_adsp_csk6.overlay
```dts
&ls_adsp_csk6_pinctrl{
        pinctrl_uart2_rx_default: uart2_rx_default {
			pinctrls = < &pinmuxb 7 3 >;
		};

		pinctrl_uart2_tx_default: uart2_tx_default {
			pinctrls = < &pinmuxb 6 3 >;
		};
};
```

## src/main.c
```c
/*
 * Copyright (c) 2020 Intel Corporation.
 *
 * SPDX-License-Identifier: Apache-2.0
 */

#include <zephyr.h>

#include <logging/log.h>
#include <w_pilot_err.h>
#include <pilot_app.h>
#include <venus_cp.h>
#include <luna_bits.h>
#include <ClockManager.h>

LOG_MODULE_REGISTER(main, LOG_LEVEL_DBG);


//CSK star app
int start_app(void)
{
	int ret_error = IPILOT_SUCCESS;
	IPLT_INST ifr_inst = NULL;
	//init
	ret_error = INIT_ENGINE(&ifr_inst);
	//set params
	SET_PARMA_ENGINE(ifr_inst);
	//test
	CSK_test_function(ifr_inst);
	//unint
	ret_error = UINIT_ENGINE(ifr_inst);
	return 0;
}

extern void luna_init();
void sys_init(void)
{
    // enable NPU Clock
	__HAL_CRM_NPU_CLK_ENABLE();

    // release NPU
    if(IP_SYSCTRL->REG_SW_RESET_NPU.all){
        IP_SYSCTRL->REG_SW_RESET_NPU.all = 0xCAFE000C;
    }
    luna_init();

	uint32_t luna_val = *((volatile uint32_t *)(ADDR_LUNA_MODULE_ST));

	LOG_INF("luna_val: %d", luna_val);
}


extern void dma_init();
void main(void)
{

	LOG_INF("pilot app start");

	dma_init();
	sys_init();
	start_app();

}
```

## src/opi_psram_cpy.c
```c
#include <stdio.h>
#include <stdlib.h>
#include <string.h>
#include <stdint.h>
#include <drivers/dma.h>
#include <opi_psram_cpy.h>
#include "hal/reg/dma_venus.h"
#include <zephyr.h>

#define USE_DMA_COPY

#ifdef USE_DMA_COPY
static uint32_t volatile DMAEvent;

static void DMA_DrvEvent(uint32_t event_info, uint32_t xfer_bytes, uint32_t usr_param)
{
    // printk("[%s]: event = %d, channel = %d, xfer_bytes = %d\r\n", __func__,
    //         event_info & 0xFF, (event_info >> 8) & 0xFF, xfer_bytes);
    DMAEvent = event_info & 0xFF;
}

#endif

#ifdef CONFIG_DMA
K_SEM_DEFINE(dma_sem, 0, 1);

void dma_callback(const struct device *dev, void *user_data, uint32_t channel, int status)
{
    if (status == 0) {
        k_sem_give(&dma_sem);
    }
}
#endif

void dma_init()
{
#ifdef CONFIG_DMA
    const struct device *dma = DEVICE_DT_GET(DT_NODELABEL(dma0));
    struct dma_config dma_cfg = {
        .channel_direction = MEMORY_TO_MEMORY,
        .dma_callback = dma_callback,
        .user_data = NULL
    };
	dma_config(dma, 1, &dma_cfg);
#else
	extern void dma_irq_handler(void);
	IRQ_CONNECT(3, 1, dma_irq_handler, NULL, 0);                                                                                                          
	irq_enable(3);
	dma_initialize();
#endif
}

void dma_wait_complete(int chn)
{
#ifdef USE_DMA_COPY

#ifdef CONFIG_DMA
	k_sem_take(&dma_sem, K_FOREVER);
#else
	// Block
	while(1){
		// Complete
		if(DMAEvent & DMA_EVENT_TRANSFER_COMPLETE){
			DMAEvent &= (~DMA_EVENT_TRANSFER_COMPLETE);
			break;
		}
		// Error
		if(DMAEvent & DMA_EVENT_ERROR){
			return;
		}
	}
#endif

#else
	return;
#endif
}

void dma_cpy_async(int chn, void *dst, void *src, int32_t size)
{
#ifdef USE_DMA_COPY
	if ((uint32_t)src >> 20 == 0x5fe)
	{
		src = (void *)((uint32_t)src & (uint32_t)0x480FFFFF);
	}
	if ((uint32_t)dst >> 20 == 0x5fe)
	{
		dst = (void *)((uint32_t)dst & (uint32_t)0x480FFFFF);
	}

#ifdef CONFIG_DMA
	const struct device *dma = DEVICE_DT_GET(DT_NODELABEL(dma0));
	dma_reload(dma, 1, (uint32_t)src, (uint32_t)dst, size);
	dma_start(dma, 1);
#else
    uint8_t real_channel = 2;

    dma_channel_select(&real_channel, DMA_DrvEvent, NULL, DMA_CACHE_SYNC_BOTH);

	dma_memcpy(real_channel, src, dst, size);
#endif

#else
	memcpy(dst, src, size);
#endif
}


void opi_psram_cpy_in(void *dst, void *src, int32_t size)
{
	//memcpy(dst, src, size);
	dma_cpy_async(0, dst, src, size);
	dma_wait_complete(0);
}

void opi_psram_cpy_out(void *dst, void *src, int32_t size)
{
	//memcpy(dst, src, size);
	dma_cpy_async(0, dst, src, size);
	dma_wait_complete(0);
}

void opi_psram_cpy_in_pro(void *dst, void *src, int32_t size, dma_sync_call_func func, void* param)
{
	if (NULL != func)
	{
		func(param);
	}
	memcpy(dst, src, size);
}

void opi_psram_cpy_out_pro(void *dst, void *src, int32_t size, dma_sync_call_func func, void* param)
{
	if (NULL != func)
	{
		func(param);
	}
	memcpy(dst, src, size);
}
```

## src/pilot_app.c
```c
#include <zephyr.h>
#include <pilot_app.h>
#include <w_pilot_err.h>
#include <stdlib.h>
#include <luna.h>
#include <pilot/w_pilot.h>
#include <logging/log.h>

LOG_MODULE_REGISTER(pilot_app, LOG_LEVEL_DBG);

#define TEST_HEAD_DETECT (1)
// #define TEST_FACE_DETECT (1)
//#define TEST_FACE_ALIGN  (1)
//#define TEST_FACE_VERIFY (1)
#define TEST_GESTURE     (1)


#define CNN_MLP_RES_FLASH_SHOULDER_ADDR				(void *)(0x68000000)//(void *)(0X80400000)
#define CNN_MLP_RES_FLASH_DETECT_ADDR				(void *)(0x68100000)//(void *)(0X80200000)
#define CNN_MLP_RES_FLASH_ALIGN_ADDR				(void *)(0x68200000)//(void *)(0X80100000)
#define CNN_MLP_RES_FLASH_VERIFY_ADDR				(void *)(0x68300000)//(void *)(0X80600000)
#define CNN_MLP_RES_FLASH_GESTURE_ADDR				(void *)(0x68550000)//(void *)(0X80300000)

//thinker res size
#define HEAD_SHOULDER_SIZE (1 * 670 * 1024)

//inst size
#define PSRAM_INST_SIZE (1*1024*1024)
#define SHARE_MEME_SIZE (640*1024)
static char g_psram_inst_buffer[PSRAM_INST_SIZE];

static ePilotResMgr res_type_mgr;

static char *g_share_meme_buffer = (char *)LUNA_SHARE_MEM_BASE;

#ifdef TEST_FACE_DETECT
static char gDetectResBuffer[1 * 380 * 1024];
#include "face_detect_luna.h"
#endif

#ifdef TEST_HEAD_DETECT

#if CONFIG_ALGO_RES_BIN
static const unsigned char castor_luna_thinker_resource[] = {
	#include "head_shoulder_detect.bin.inc"
};
#else
#include "castor_v1.6_luna_thinker.h"
#endif

static char gHeadShoulderBuffer[HEAD_SHOULDER_SIZE];
#endif

#ifdef TEST_FACE_VERIFY
#include "face_verify_luna.h"
static char gVerifyResBuffer[2 * 1024 * 1024 + 1 * 150 * 1024];
#endif

#ifdef TEST_FACE_ALIGN
#include "face_align_luna.h"
static char gAlignResBuffer[1*380*1024];
#endif

#ifdef TEST_GESTURE

#if CONFIG_ALGO_RES_BIN
static const unsigned char mb_tiny_hand_0524_128_16bias_luna_resource[] = {
	#include "gesture.bin.inc"
};
#else
#include "mb_tiny_hand_0524_128_16bias_luna.h"
#endif

static char gGestureResBuffer[1*1024*1024+1*230*1024];
#endif

#include "input_640x480.h"

int SET_PARMA_ENGINE(IPLT_INST ifr_inst)
{
	int inst_size;
	int ret_error = 0;
	float getValue = 0;
	char *value = NULL;
	int valueLen = 0;

	ret_error = IPLTSetParams(ifr_inst, PARAM_DETECT_THRES, "0.73");
	ret_error = IPLTSetParams(ifr_inst, PARAM_HEAD_SHOULDER_DETECT_THRES, "0.25");
	ret_error = IPLTSetParams(ifr_inst, PARAM_HEAD_SHOULDER_DETECT_LOSS_CNT, "6");
	ret_error = IPLTSetParams(ifr_inst, PARAM_HEAD_SHOULDER_DETECT_IOU, "0.2");
	ret_error = IPLTSetParams(ifr_inst, PARAM_HEAD_SHOULDER_DETECT_PIXESIZE, "15");
	ret_error = IPLTSetParams(ifr_inst, PARAM_HEAD_SHOULDER_DETECT_IOA, "0.75");
	ret_error = IPLTSetParams(ifr_inst, PARAM_HEAD_SHOULDER_DETECT_PROTHRES, "0.2");
	ret_error = IPLTSetParams(ifr_inst, PARAM_HEAD_SHOULDER_DETECT_NMSTHRS, "0.6");

	ret_error = IPLTSetParams(ifr_inst, PARAM_GESTURE_YES_THRES, "0.15");
	ret_error = IPLTSetParams(ifr_inst, PARAM_GESTURE_OK_THRES, "0.15");
	ret_error = IPLTSetParams(ifr_inst, PARAM_GESTURE_STOP_THRES, "0.15");
	ret_error = IPLTSetParams(ifr_inst, PARAM_GESTURE_LIKE_THRES, "0.15");

	ret_error = IPLTGetParams(ifr_inst, PARAM_VERIFY_RESVERSION, &value, &valueLen);
	if (ret_error != IPILOT_SUCCESS)
	{
		LOG_INF("PARAM_VERIFY_RESVERSION | erroe code = %d\n", ret_error);
	}
	else
	{
		LOG_INF("PARAM_VERIFY_RESVERSION = %s\n", value);
	}
	
	ret_error = IPLTGetParams(ifr_inst, PARAM_HEAD_SHOULDER_DETECT_RESVERSION, &value, &valueLen);
	if (ret_error != IPILOT_SUCCESS)
	{
		LOG_INF("PARAM_HEAD_SHOULDER_DETECT_RESVERSION | erroe code = %d\n", ret_error);
	}else
	{
		LOG_INF("PARAM_HEAD_SHOULDER_DETECT_RESVERSION = %s\n", value);
	}
	
	ret_error = IPLTGetParams(ifr_inst, PARAM_GESTURE_RESVERSION, &value, &valueLen);
	if (ret_error != IPILOT_SUCCESS)
	{
		LOG_INF("PARAM_GESTURE_RESVERSION | erroe code = %d\n", ret_error);
	}
	else
	{
		LOG_INF("PARAM_GESTURE_RESVERSION = %s\n", value);
	}
	
	return IPILOT_SUCCESS;
}

int UINIT_ENGINE(IPLT_INST ifr_inst)
{
	int ret_error = IPILOT_SUCCESS;
	ret_error = IPLTDestroyInst(ifr_inst);
	if (IPILOT_SUCCESS != ret_error) {
		LOG_INF("IPLTDestroyInst Failed | Error Code = %d", ret_error);
		return ret_error;
	}
	ret_error = IPLTUninit();
	if (IPILOT_SUCCESS != ret_error) {
		LOG_INF("IPLTUninit Failed | Error Code = %d", ret_error);
		return ret_error;
	}

	return IPILOT_SUCCESS;
}

int INIT_ENGINE(IPLT_INST *ifr_inst)
{
	int inst_size;
	int ret_error = 0;
	float getValue = 0;
	char *value = NULL;
	int valueLen = 0;


#ifdef TEST_HEAD_DETECT
	memcpy(gHeadShoulderBuffer, CNN_MLP_RES_FLASH_SHOULDER_ADDR, sizeof(gHeadShoulderBuffer));
#endif

#ifdef TEST_FACE_DETECT
	memcpy(gDetectResBuffer, CNN_MLP_RES_FLASH_DETECT_ADDR, sizeof(gDetectResBuffer));
#endif

#ifdef TEST_FACE_ALIGN
	memcpy(gAlignResBuffer, CNN_MLP_RES_FLASH_ALIGN_ADDR, sizeof(gAlignResBuffer));
#endif

#ifdef TEST_FACE_VERIFY
	memcpy(gVerifyResBuffer, CNN_MLP_RES_FLASH_VERIFY_ADDR, sizeof(gVerifyResBuffer));
#endif

#ifdef TEST_GESTURE
	memcpy(gGestureResBuffer, CNN_MLP_RES_FLASH_GESTURE_ADDR, sizeof(gGestureResBuffer));
#endif


#ifdef TEST_FACE_DETECT
	res_type_mgr.res_type_arr_[0].res_buffer_type = RES_FACE_DETECT;
	res_type_mgr.res_type_arr_[0].res_buffer_addr = gDetectResBuffer;
	res_type_mgr.res_type_arr_[0].res_buffer_addr = face_detect_luna_resource;
#endif

#ifdef TEST_FACE_VERIFY
	res_type_mgr.res_type_arr_[1].res_buffer_type = RES_FACE_VERIFY;
	res_type_mgr.res_type_arr_[1].res_buffer_addr = gVerifyResBuffer;
	res_type_mgr.res_type_arr_[1].res_buffer_addr = face_verify_luna_resource;
#endif

#ifdef TEST_HEAD_DETECT
	res_type_mgr.res_type_arr_[2].res_buffer_type = RES_HEAD_SHOULDER;
	res_type_mgr.res_type_arr_[2].res_buffer_addr = gHeadShoulderBuffer;
	res_type_mgr.res_type_arr_[2].res_buffer_addr = (char *)castor_luna_thinker_resource;
	res_type_mgr.res_type_arr_[2].res_buffer_size = HEAD_SHOULDER_SIZE;
#endif

#ifdef TEST_FACE_ALIGN
	res_type_mgr.res_type_arr_[3].res_buffer_type = RES_FACE_ALIGN;
	res_type_mgr.res_type_arr_[3].res_buffer_addr = gAlignResBuffer;
	res_type_mgr.res_type_arr_[3].res_buffer_addr = face_align_luna_resource;
#endif

#ifdef TEST_GESTURE
	res_type_mgr.res_type_arr_[4].res_buffer_type = RES_GESTURE_RECOGNITION;
	res_type_mgr.res_type_arr_[4].res_buffer_addr = (char *)gGestureResBuffer;
	res_type_mgr.res_type_arr_[4].res_buffer_addr = (char *)mb_tiny_hand_0524_128_16bias_luna_resource;
#endif

	//1.Init 
	ret_error = IPLTInit(&res_type_mgr, NULL);
	if (IPILOT_SUCCESS != ret_error) {
		LOG_INF("pInit Failed | Error Code = %d\n", ret_error);
		return ret_error;
	}
	//2.getInstSize
	inst_size = IPLTGetInstSize();
	if (IPILOT_SUCCESS != ret_error) {
		LOG_INF("pGetInstSize Failed | Error Code = %d\n", ret_error);
		return ret_error;
	}
	LOG_INF("inst_size: %d \n\r", inst_size);
#if 0
	ret_error = IPLTCreateInst(ifr_inst, NULL);
#else
	PILOT_INST_PARAM inst_param = {0};
	memset(&inst_param,0,sizeof(PILOT_INST_PARAM));
	inst_param.psram_addr  = (void*)g_psram_inst_buffer;
	inst_param.psram_total = PSRAM_INST_SIZE;
	inst_param.ram_addr    = (void*)g_share_meme_buffer;
	inst_param.ram_total   = SHARE_MEME_SIZE;

	ret_error = IPLTCreateInst(ifr_inst, &inst_param);
#endif
	if (IPILOT_SUCCESS != ret_error) {
		LOG_INF("pCreateInst Failed | Error Code = %d\n", ret_error);
		return ret_error;
	}

	return IPILOT_SUCCESS;
}

int CSK_ATOMIC_TEST(IPLT_INST ifr_inst)
{
	float *feature = NULL;
	int feature_len = 0;
	int ret_error = 0;
	face_detect *face_detct_t = NULL;
	int face_count = 0;
	head_shoulder_detect *head_detct_t = NULL;
	int head_shoulder_count = 0;

	face_detect f_detect_temp;

	while (1)
	{
		//do face detect
#ifdef TEST_FACE_DETECT
		ret_error = IPLTFaceDetect(ifr_inst, head_640x480, PIX_FMT_BGR888, 640, 480, &face_detct_t, &face_count);
		if (IPILOT_SUCCESS != ret_error) {
			LOG_INF("pDetect Failed | Error Code = %d\n", ret_error);
			return ret_error;
		}
		for (int fi = 0; fi<face_count; fi++)
		{
			LOG_INF("face count = %d\t x = %d\t y=%d\t w=%d\t h=%d\t score=%f",
				face_count, face_detct_t[fi].rect.x, face_detct_t[fi].rect.y, 
				face_detct_t[fi].rect.w, face_detct_t[fi].rect.h, face_detct_t[fi].score);
		}
#endif

#ifdef TEST_FACE_ALIGN
		//266	 y=48	 w=104	 h=161
		f_detect_temp.rect.x = 266;
		f_detect_temp.rect.y = 48;
		f_detect_temp.rect.w = 104;
		f_detect_temp.rect.h = 161;

		face_detct_t = &f_detect_temp;

		ret_error = IPLTFaceAlign(ifr_inst, head_640x480, PIX_FMT_BGR888, 640, 480, 
			&face_detct_t[0], FACE_ALIGN_68P, face_detct_t->p_align_point);
		if (IPILOT_SUCCESS != ret_error) {
			LOG_INF("pDetect Failed | Error Code = %d", ret_error);
			return ret_error;
		}
		for (int i=0;i<68;i++)
		{
			LOG_INF("x=%f,y=%f\n", face_detct_t[0].p_align_point[i].x, face_detct_t[0].p_align_point[i].y);
		}
#endif

#ifdef TEST_HEAD_DETECT
		ret_error = IPLTHeadShoulderDetect(ifr_inst, (unsigned char *)head_640x480, PIX_FMT_BGR888, 640, 480, &head_detct_t, &head_shoulder_count);
		if (IPILOT_SUCCESS != ret_error) {
			LOG_INF("pDetect Failed | Error Code = %d", ret_error);
			return ret_error;
		}
		for (int fi = 0; fi<head_shoulder_count; fi++)
		{
			LOG_INF("head count = %d\t x = %d\t y=%d\t w=%d\t h=%d\t score=%f", 
				head_shoulder_count, head_detct_t[fi].rect.x, head_detct_t[fi].rect.y,
				head_detct_t[fi].rect.w, head_detct_t[fi].rect.h, head_detct_t[fi].score);
		}
#endif

#ifdef TEST_FACE_VERIFY
		//do get featture
		//266	 y=48	 w=104	 h=161
		f_detect_temp.rect.x = 266;
		f_detect_temp.rect.y = 48;
		f_detect_temp.rect.w = 104;
		f_detect_temp.rect.h = 161;
		f_detect_temp.n_align_point = 68;
		for (int i=0;i<68;i++)
		{
			f_detect_temp.p_align_point[i].x = keypoints[i*2+0];
			f_detect_temp.p_align_point[i].y = keypoints[i * 2 + 1];
		}
		face_detct_t = &f_detect_temp;

		ret_error = IPLTFaceGetFea(ifr_inst, head_640x480, PIX_FMT_BGR888, 640, 480, &face_detct_t[0], &feature, &feature_len);
		if (IPILOT_SUCCESS != ret_error)
		{
			LOG_INF("pVerify Failed | Error Code = %d", ret_error);
			return ret_error;
		}
		LOG_INF("[0]=%f\t[192]=%f\t[383]=%f\n", feature[0], feature[192], feature[383]);
#endif

		break;
	}

	return 0;
}

int CSK_GESTURE_TEST_CONSTANCE(IPLT_INST hIPLTTInst)
{
	head_shoulder_detect *head_detct_t = NULL;
	int head_shoulder_count;
	int ret_error = IPLTHeadShoulderDetect(hIPLTTInst, (unsigned char *)head_640x480, PIX_FMT_BGR888, 640, 480, &head_detct_t, &head_shoulder_count);
	if (IPILOT_SUCCESS != ret_error) {
		LOG_INF("pDetect Failed | Error Code = %d\n", ret_error);
		return ret_error;
	}
#ifdef TEST_GESTURE
	//gesture status
	for (int fi = 0; fi < head_shoulder_count; fi++)
	{
		LOG_INF("head count = %d\t x = %d\t y=%d\t w=%d\t h=%d\t score=%f\n",
				head_shoulder_count, head_detct_t[fi].rect.x, head_detct_t[fi].rect.y,
				head_detct_t[fi].rect.w, head_detct_t[fi].rect.h, head_detct_t[fi].score);

		ret_error = IPLTGestureRecognition(hIPLTTInst, (unsigned char *)head_640x480, PIX_FMT_BGR888, 640, 480, &head_detct_t[fi]);
		if (IPILOT_SUCCESS != ret_error)
		{
			LOG_INF("IPLTGestureRecognition Failed | Error Code = %d\n", ret_error);
			return ret_error;
		}
		LOG_INF("gesture status = %d,gesture_scores=%f\n",
			head_detct_t[fi].gesture_state, 
			head_detct_t[fi].gesture_scores[head_detct_t[fi].gesture_state]);
	}
#endif

	return 0;
}

__attribute__ ((section (".iram.text"))) int CSK_EFFECTIVE(IPLT_INST ifr_inst)
{
	int i, j, fi = 0;
	float *feature = NULL;
	int feature_len;
	int ret_error = 0;
	int face_count = 0;
	head_shoulder_detect *head_detct_t = NULL;
	face_detect *face_detct_t = NULL;
	face_detect f_detect_temp;

	int head_shoulder_count = 0;
	unsigned long long ticks_once_head_detect = 0, ticks_total_head_detect = 0;
	unsigned long long ticks_once_face_detect = 0, ticks_total_face_detect = 0;
	unsigned long long ticks_once_face_align = 0, ticks_total_face_align = 0;
	unsigned long long ticks_once_face_verify = 0, ticks_total_face_verify = 0;
	unsigned long long ticks_once_gesture = 0, ticks_total_gesture = 0;
	int32_t loop_num_head_detect = 0;
	int32_t loop_num_face_detect = 0;
	int32_t loop_num_face_align = 0;
	int32_t loop_num_face_verify = 0;
	int32_t loop_num_gesture = 0;
	

	while(1)
	{
/////////////////////////////////////////////////////////////////////////////////////////////////////////////////////////////////////////
		//do face detect
#ifdef TEST_FACE_DETECT
		uint32_t start = k_uptime_get_32();
		ret_error =IPLTFaceDetect(ifr_inst, head_640x480, PIX_FMT_BGR888, 640, 480, &face_detct_t, &face_count);
		if (IPILOT_SUCCESS != ret_error) {
			LOG_INF("pDetect Failed | Error Code = %d\n", ret_error);
			return ret_error;
		}
		ticks_once_face_detect = (k_uptime_get_32() - start);
		ticks_total_face_detect += ticks_once_face_detect;
		loop_num_face_detect++;
		if (10 == loop_num_face_detect)
		{
			float time_cost = (ticks_total_face_detect * 1.0 / loop_num_face_detect / (1000 * 1000.f)/300)*1000;
			int time_cost_int = (int)time_cost;
			LOG_INF("DETECT: total_clks_cost=%lld,average_clk_cost=%lld",
					ticks_total_face_detect,(ticks_total_face_detect/loop_num_face_detect));
			LOG_INF("DETECT: average_time:%d(ms)", time_cost_int);
			ticks_total_face_detect = 0;
			loop_num_face_detect = 0;
		}
#endif

///////////////////////////////////////////////////////////////////////////////////////////////////////////////////////////////////////////
//		//do face aign
#ifdef TEST_FACE_ALIGN
		//266	 y=48	 w=104	 h=161
		f_detect_temp.rect.x = 266;
		f_detect_temp.rect.y = 48;
		f_detect_temp.rect.w = 104;
		f_detect_temp.rect.h = 161;

		face_detct_t = &f_detect_temp;

		uint32_t start = k_uptime_get_32();
		ret_error = IPLTFaceAlign(ifr_inst, head_640x480, PIX_FMT_BGR888, 640, 480, &face_detct_t[0], FACE_ALIGN_68P,
				face_detct_t[0].p_align_point);
		if (IPILOT_SUCCESS != ret_error) {
			LOG_INF("pDetect Failed | Error Code = %d\n", ret_error);
			return ret_error;
		}
		ticks_once_face_align = (k_uptime_get_32() - start);
		ticks_total_face_align += ticks_once_face_align;
		loop_num_face_align++;
		if (10 == loop_num_face_align)
		{
			float time_cost = (ticks_total_face_align * 1.0 / loop_num_face_align / (1000 * 1000.f)/300)*1000;
			int time_cost_int = (int)time_cost;
			LOG_INF("ALIGN: total_clks_cost=%lld,average_clk_cost=%lld",
					ticks_total_face_align,(ticks_total_face_align/loop_num_face_align));
			LOG_INF("ALIGN: average_time:%d(ms)", time_cost_int);
			ticks_total_face_align = 0;
			loop_num_face_align = 0;
		}
#endif
/////////////////////////////////////////////////////////////////////////////////////////////////////////////////////////////////////////
#ifdef TEST_FACE_VERIFY
		//do face get feature
		f_detect_temp.rect.x = 266;
		f_detect_temp.rect.y = 48;
		f_detect_temp.rect.w = 104;
		f_detect_temp.rect.h = 161;
		f_detect_temp.n_align_point = 68;
		for (int i=0;i<68;i++)
		{
			f_detect_temp.p_align_point[i].x = keypoints[i*2+0];
			f_detect_temp.p_align_point[i].y = keypoints[i * 2 + 1];
		}

		face_detct_t = &f_detect_temp;
		uint32_t start = k_uptime_get_32();
		ret_error =IPLTFaceGetFea(ifr_inst, head_640x480, PIX_FMT_BGR888, 640, 480, &face_detct_t[0], &feature, &feature_len);
		if (IPILOT_SUCCESS != ret_error) {
			LOG_INF("pVerify Failed | Error Code = %d\n", ret_error);
			return ret_error;
		}
		loop_num_face_verify++;
		ticks_once_face_verify = (k_uptime_get_32() - start);
		ticks_total_face_verify += ticks_once_face_verify;
		if (10 == loop_num_face_verify)
		{
			float time_cost = (ticks_total_face_verify * 1.0 / loop_num_face_verify / (1000 * 1000.f)/300)*1000;
			int time_cost_int = (int)time_cost;
			LOG_INF("FEATURE: total_clks_cost=%lld,average_clk_cost=%lld",
					ticks_total_face_verify,(ticks_total_face_verify/loop_num_face_verify));
			LOG_INF("FEATURE: average_time:%d(ms)", time_cost_int);
			ticks_total_face_verify = 0;
			loop_num_face_verify = 0;
		}
#endif
/////////////////////////////////////////////////////////////////////////////////////////////////////////////////////////////////////////
#ifdef TEST_HEAD_DETECT
{
		//do head shoulder detect
		uint32_t start = k_uptime_get_32();
		ret_error = IPLTHeadShoulderDetect(ifr_inst, (unsigned char *)head_640x480, PIX_FMT_BGR888, 640, 480, &head_detct_t, &head_shoulder_count);
		if (IPILOT_SUCCESS != ret_error) {
			LOG_INF("pDetect Failed | Error Code = %d\n", ret_error);
			return ret_error;
		}
		ticks_once_head_detect = (k_uptime_get_32() - start);
		ticks_total_head_detect += ticks_once_head_detect;
		loop_num_head_detect++;
		if (10 == loop_num_head_detect)
		{
			float time_cost = (ticks_total_head_detect * 1.0 / loop_num_head_detect / (1000 * 1000.f)/300)*1000;
			int time_cost_int = (int)time_cost;
			LOG_INF("HEAD: total_clks_cost=%lld ms,average_clk_cost=%lld ms" ,
					ticks_total_head_detect,(ticks_total_head_detect/loop_num_head_detect));
			ticks_total_head_detect = 0;
			loop_num_head_detect = 0;
		}
}
#endif
/////////////////////////////////////////////////////////////////////////////////////////////////////////////////////////////////////////
		//gesture time
#ifdef TEST_GESTURE
{
		uint32_t start = k_uptime_get_32();
		int index = 0;
		for (int fi = 0; fi<head_shoulder_count; fi++)
		{
			ret_error = IPLTGestureRecognition(ifr_inst, (unsigned char *)head_640x480, PIX_FMT_BGR888,
				640, 480, &head_detct_t[fi]);
			if (IPILOT_SUCCESS != ret_error) {
				LOG_INF("pDetect Failed | Error Code = %d\n", ret_error);
				return ret_error;
			}
		}
		ticks_once_gesture = (k_uptime_get_32() - start);
		ticks_total_gesture += ticks_once_gesture;
		loop_num_gesture++;
		if (10 == loop_num_gesture)
		{
			float time_cost = (ticks_total_gesture * 1.0 / loop_num_gesture / (1000 * 1000.f) / 300) * 1000;
			int time_cost_int = (int)time_cost;
			LOG_INF("GESTURE: total_clks_cost=%lld ms,average_clk_cost=%lld ms",
					ticks_total_gesture, (ticks_total_gesture/loop_num_gesture));
			for (int fi = 0; fi < head_shoulder_count; fi++)
			{
				LOG_INF("gesture status = %d,gesture_score=%f\n", head_detct_t[fi].gesture_state,
					head_detct_t[fi].gesture_scores[head_detct_t[fi].gesture_state]);
			}
			ticks_total_gesture = 0;
			loop_num_gesture = 0;
		}
}
#endif

	}//end while

	return 0;
}

int CSK_test_function(IPLT_INST ifr_inst)
{
	CSK_ATOMIC_TEST(ifr_inst);
	CSK_GESTURE_TEST_CONSTANCE(ifr_inst);
	CSK_EFFECTIVE(ifr_inst);
	return 0;
}
```
