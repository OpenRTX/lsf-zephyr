## CMakeLists.txt
```
# SPDX-License-Identifier: Apache-2.0

cmake_minimum_required(VERSION 3.20.0)

find_package(Zephyr REQUIRED HINTS $ENV{ZEPHYR_BASE})
project(scanpen)

target_sources(app PRIVATE src/main.c)
```

## prj.conf
```kconfig
# nothing here
CONFIG_HEAP_MEM_POOL_SIZE=16384
CONFIG_STDOUT_CONSOLE=y
CONFIG_PRINTK=y
CONFIG_PINMUX=y
CONFIG_GPIO=y
CONFIG_SHELL=y

CONFIG_LOG=y
CONFIG_PWM=y

CONFIG_DISPLAY=y
CONFIG_SPI=y
CONFIG_ST7789V=y

CONFIG_KSCAN=y
CONFIG_I2C=y
CONFIG_KSCAN_BL6XXX=y
CONFIG_KSCAN_CSK6=y

CONFIG_ADC=y
CONFIG_WIFI=y
CONFIG_CSK_WIFI_STATION=y
CONFIG_NET_L2_ETHERNET=y

CONFIG_NEWLIB_LIBC=y

CONFIG_NETWORKING=y
CONFIG_NET_DHCPV4=y
CONFIG_NET_IPV4=y
CONFIG_NET_SOCKETS=y
CONFIG_NET_SOCKETS_POSIX_NAMES=y

CONFIG_NET_MGMT=y
CONFIG_NET_MGMT_EVENT=y
CONFIG_NET_MGMT_EVENT_STACK_SIZE=4096

CONFIG_NET_RX_STACK_SIZE=2048
CONFIG_NET_TX_STACK_SIZE=2048
CONFIG_NET_PKT_RX_COUNT=16
CONFIG_NET_PKT_TX_COUNT=16
CONFIG_NET_BUF_RX_COUNT=32
CONFIG_NET_BUF_TX_COUNT=32
CONFIG_NET_CONTEXT_NET_PKT_POOL=y

CONFIG_HEAP_MEM_POOL_SIZE=35480
CONFIG_MAIN_STACK_SIZE=4096
CONFIG_TEST_RANDOM_GENERATOR=y
CONFIG_INIT_STACKS=y

CONFIG_LOG=y
CONFIG_THREAD_NAME=y
CONFIG_DEBUG_THREAD_INFO=y
```

## src/main.c
```c
/*
 * Copyright (c) 2012-2014 Wind River Systems, Inc.
 *
 * SPDX-License-Identifier: Apache-2.0
 */
#include <kernel.h>
#include <zephyr.h>
#include <device.h>
#include <sys/printk.h>
#include <sys/sys_heap.h>
#include <devicetree.h>
#include <drivers/gpio.h>
#include <logging/log.h>
#include <drivers/display.h>
#include <drivers/kscan.h>
#include <drivers/pinmux.h>
#include <drivers/pwm.h>
#include <drivers/adc.h>

#include <net/net_if.h>
#include <net/net_core.h>
#include <net/net_context.h>
#include <net/net_mgmt.h>
#include "csk6/csk_wifi.h"

LOG_MODULE_REGISTER(sample, LOG_LEVEL_INF);
// device:ADC
#define ADC_STACKSIZE       512
struct k_thread  adc_task_id;
K_THREAD_STACK_DEFINE(adc_stack_area, ADC_STACKSIZE);

#if !DT_NODE_EXISTS(DT_PATH(vbatt)) || \
	!DT_NODE_HAS_PROP(DT_PATH(vbatt), io_channels)
#error "No suitable devicetree overlay specified"
#endif

#define ADC_NUM_CHANNELS	DT_PROP_LEN(DT_PATH(vbatt), io_channels)

#if ADC_NUM_CHANNELS > 2
#error "Currently only 1 or 2 channels supported in this sample"
#endif

#if ADC_NUM_CHANNELS == 2 && !DT_SAME_NODE( \
	DT_PHANDLE_BY_IDX(DT_PATH(vbatt), io_channels, 0), \
	DT_PHANDLE_BY_IDX(DT_PATH(vbatt), io_channels, 1))
#error "Channels have to use the same ADC."
#endif

#define ADC_NODE		DT_PHANDLE(DT_PATH(vbatt), io_channels)

/* Common settings supported by most ADCs */
#define ADC_RESOLUTION		11
#define ADC_GAIN		ADC_GAIN_1
#define ADC_REFERENCE		ADC_REF_INTERNAL

/* Get the numbers of up to two channels */
static uint8_t channel_ids[ADC_NUM_CHANNELS] = {
	DT_IO_CHANNELS_INPUT_BY_IDX(DT_PATH(vbatt), 0),
#if ADC_NUM_CHANNELS == 2
	DT_IO_CHANNELS_INPUT_BY_IDX(DT_PATH(vbatt), 1)
#endif
};

static int16_t sample_buffer[ADC_NUM_CHANNELS];


static struct adc_channel_cfg channel_cfg = {
	.gain = ADC_GAIN_1,
	.reference = ADC_REFERENCE,
	.channel_id = 0,
};

static struct adc_sequence sequence = {
	/* individual channels will be added below */
	.channels    = 0,
	.buffer      = sample_buffer,
	/* buffer size in bytes, not number of samples */
	.buffer_size = sizeof(sample_buffer),
	.resolution  = ADC_RESOLUTION,
};


// devicetree: LCD PWM
struct pwm_csk_config {
	uint8_t pwm_pin;
	uint8_t pwm_func;
	uint8_t clock_source;
	uint8_t clock_prescaler;
	uint8_t mode;
	const struct device *pinmux_drv;
};

// PWM SWDIO
#define PWM_LED0_NODE	DT_NODELABEL(pwmlcd)
#define PINMUXA_NODE 	DT_NODELABEL(pinmuxa)
#define SWDIO_PIN_NUM 	1
#define SWDIO_PIN_FUNC 	0
#define PWM1_PIN_FUNC 	11

// devicetree: power lock
#define PWR_LOCK_NODE 	DT_NODELABEL(pwrlock)
#define GPIO_PWR_LOCK	DT_GPIO_CTLR(PWR_LOCK_NODE, gpios) 
#define PIN_PWR_LOCK	DT_GPIO_PIN(PWR_LOCK_NODE, gpios) 
#define FLAGS_PWR_LOCK	DT_GPIO_FLAGS(PWR_LOCK_NODE, gpios) 

#define WIFI_STACKSIZE	4096 
struct k_thread  wifi_task_id;
K_THREAD_STACK_DEFINE(wifi_stack_area, WIFI_STACKSIZE);

// devicetree: LED CAM NODE
struct k_thread  camled_task_id;
#define CAM_LED_STACKSIZE	256 
K_THREAD_STACK_DEFINE(camled_stack_area, CAM_LED_STACKSIZE);
#define CAM_LED 		DT_NODELABEL(camleds1)
#define GPIO_LED_CAM 	DT_GPIO_CTLR_BY_IDX(CAM_LED, gpios, 0) 

// devicetree: FY KEY NODE
#define FY_KEY_NODE 	DT_NODELABEL(fy_key)
#define GPIO_FY_KEY 	DT_GPIO_CTLR_BY_IDX(FY_KEY_NODE, gpios, 0) 
static const struct gpio_dt_spec fy_key = GPIO_DT_SPEC_GET_OR(FY_KEY_NODE, gpios,
							      {0});
static struct gpio_callback fy_key_cb_data;
// device: touch and LCD
#define STACKSIZE       1024
struct k_thread  lcdtouch_task_id;
K_THREAD_STACK_DEFINE(lcdtouch_stack_area, STACKSIZE);

#if DT_NODE_HAS_STATUS(DT_INST(0, ilitek_ili9340), okay)
#define DISPLAY_DEV_NAME DT_LABEL(DT_INST(0, ilitek_ili9340))
#endif

#if DT_NODE_HAS_STATUS(DT_INST(0, solomon_ssd1306fb), okay)
#define DISPLAY_DEV_NAME DT_LABEL(DT_INST(0, solomon_ssd1306fb))
#endif

#if DT_NODE_HAS_STATUS(DT_INST(0, solomon_ssd16xxfb), okay)
#define DISPLAY_DEV_NAME DT_LABEL(DT_INST(0, solomon_ssd16xxfb))
#endif

#if DT_NODE_HAS_STATUS(DT_INST(0, sitronix_st7789v), okay)
#define DISPLAY_DEV_NAME DT_LABEL(DT_INST(0, sitronix_st7789v))
#endif

#if DT_NODE_HAS_STATUS(DT_INST(0, sitronix_st7735r), okay)
#define DISPLAY_DEV_NAME DT_LABEL(DT_INST(0, sitronix_st7735r))
#endif

#if DT_NODE_HAS_STATUS(DT_INST(0, fsl_imx6sx_lcdif), okay)
#define DISPLAY_DEV_NAME DT_LABEL(DT_INST(0, fsl_imx6sx_lcdif))
#endif

#if DT_NODE_HAS_STATUS(DT_INST(0, betterlife_bl6xxx), okay)
#define DISPLAY_KSAN_DEV_NAME DT_LABEL(DT_INST(0, betterlife_bl6xxx))
#endif

#ifdef CONFIG_SDL_DISPLAY_DEV_NAME
#define DISPLAY_DEV_NAME CONFIG_SDL_DISPLAY_DEV_NAME
#endif

#ifdef CONFIG_DUMMY_DISPLAY_DEV_NAME
#define DISPLAY_DEV_NAME CONFIG_DUMMY_DISPLAY_DEV_NAME
#endif

#ifdef CONFIG_ARCH_POSIX
#include "posix_board_if.h"
#endif

#ifdef CONFIG_ARCH_POSIX
#define RETURN_FROM_MAIN(exit_code) posix_exit_main(exit_code)
#else
#define RETURN_FROM_MAIN(exit_code) return
#endif

enum corner {
	TOP_LEFT,
	TOP_RIGHT,
	BOTTOM_RIGHT,
	BOTTOM_LEFT
};

typedef void (*fill_buffer)(enum corner corner, uint8_t grey, uint8_t *buf,
			    size_t buf_size);


#ifdef CONFIG_ARCH_POSIX
static void posix_exit_main(int exit_code)
{
#if CONFIG_TEST
	if (exit_code == 0) {
		LOG_INF("PROJECT EXECUTION SUCCESSFUL");
	} else {
		LOG_INF("PROJECT EXECUTION FAILED");
	}
#endif
	posix_exit(exit_code);
}
#endif

static void k_callback(const struct device *dev, uint32_t row, uint32_t col,
		       bool pressed)
{
	ARG_UNUSED(dev);
	printk("row = %u col = %u, pressed:%s\n", row, col, pressed ? "TRUE" : "FLASE");
}

void kscan_init(void)
{
	const struct device *kscan_dev = device_get_binding(DISPLAY_KSAN_DEV_NAME);

	if (!device_is_ready(kscan_dev)) {
		LOG_ERR("kscan device %s not ready", kscan_dev->name);
		return;
	}

	kscan_config(kscan_dev, k_callback);
	kscan_enable_callback(kscan_dev);
}

static void fill_buffer_argb8888(enum corner corner, uint8_t grey, uint8_t *buf,
				 size_t buf_size)
{
	uint32_t color = 0;

	switch (corner) {
	case TOP_LEFT:
		color = 0x00FF0000u;
		break;
	case TOP_RIGHT:
		color = 0x0000FF00u;
		break;
	case BOTTOM_RIGHT:
		color = 0x000000FFu;
		break;
	case BOTTOM_LEFT:
		color = grey << 16 | grey << 8 | grey;
		break;
	}

	for (size_t idx = 0; idx < buf_size; idx += 4) {
		*((uint32_t *)(buf + idx)) = color;
	}
}

static void fill_buffer_rgb888(enum corner corner, uint8_t grey, uint8_t *buf,
			       size_t buf_size)
{
	uint32_t color = 0;

	switch (corner) {
	case TOP_LEFT:
		color = 0x00FF0000u;
		break;
	case TOP_RIGHT:
		color = 0x0000FF00u;
		break;
	case BOTTOM_RIGHT:
		color = 0x000000FFu;
		break;
	case BOTTOM_LEFT:
		color = grey << 16 | grey << 8 | grey;
		break;
	}

	for (size_t idx = 0; idx < buf_size; idx += 3) {
		*(buf + idx + 0) = color >> 16;
		*(buf + idx + 1) = color >> 8;
		*(buf + idx + 2) = color >> 0;
	}
}

static uint16_t get_rgb565_color(enum corner corner, uint8_t grey)
{
	uint16_t color = 0;
	uint16_t grey_5bit;

	switch (corner) {
	case TOP_LEFT:
		color = 0xF800u;
		break;
	case TOP_RIGHT:
		color = 0x07E0u;
		break;
	case BOTTOM_RIGHT:
		color = 0x001Fu;
		break;
	case BOTTOM_LEFT:
		grey_5bit = grey & 0x1Fu;
		/* shift the green an extra bit, it has 6 bits */
		color = grey_5bit << 11 | grey_5bit << (5 + 1) | grey_5bit;
		break;
	}
	return color;
}

static void fill_buffer_rgb565(enum corner corner, uint8_t grey, uint8_t *buf,
			       size_t buf_size)
{
	uint16_t color = get_rgb565_color(corner, grey);

	for (size_t idx = 0; idx < buf_size; idx += 2) {
		*(buf + idx + 0) = (color >> 8) & 0xFFu;
		*(buf + idx + 1) = (color >> 0) & 0xFFu;
	}
}

static void fill_buffer_bgr565(enum corner corner, uint8_t grey, uint8_t *buf,
			       size_t buf_size)
{
	uint16_t color = get_rgb565_color(corner, grey);

	for (size_t idx = 0; idx < buf_size; idx += 2) {
		*(uint16_t *)(buf + idx) = color;
	}
}

static void fill_buffer_mono(enum corner corner, uint8_t grey, uint8_t *buf,
			     size_t buf_size)
{
	uint16_t color;

	switch (corner) {
	case BOTTOM_LEFT:
		color = (grey & 0x01u) ? 0xFFu : 0x00u;
		break;
	default:
		color = 0;
		break;
	}

	memset(buf, color, buf_size);
}

void cam_led_test(){
	bool led_is_on = true;
	const struct device *cam_led = DEVICE_DT_GET(GPIO_LED_CAM);;
	if (!device_is_ready(cam_led)) {
		printk("Error: CAM LED device %s is not ready\n", cam_led->name);
		return;
	}
	int ret = gpio_pin_configure(cam_led, 7, GPIO_OUTPUT_ACTIVE | 0);
	if (ret < 0) {
		LOG_ERR("Error: GPIO pin configure fault!");
		return;
	}
	
	while(1){
		led_is_on = !led_is_on;
		gpio_pin_set(cam_led, 7, (int)led_is_on);
		if(led_is_on)
			k_msleep(1000);
		else
			k_msleep(20);
	}
	return;
}

void lcd_touch_test(){
	size_t x;
	size_t y;
	size_t rect_w;
	size_t rect_h;
	size_t h_step;
	size_t scale;
	size_t grey_count;
	uint8_t *buf;
	int32_t grey_scale_sleep;
	const struct device *display_dev;
	struct display_capabilities capabilities;
	struct display_buffer_descriptor buf_desc;
	size_t buf_size = 0;
	fill_buffer fill_buffer_fnc = NULL;
	LOG_INF("Display sample for %s", DISPLAY_DEV_NAME);

	kscan_init();

	display_dev = device_get_binding(DISPLAY_DEV_NAME);

	if (display_dev == NULL) {
		LOG_ERR("Device %s not found. Aborting sample.",
			DISPLAY_DEV_NAME);
		RETURN_FROM_MAIN(1);
	}

	display_get_capabilities(display_dev, &capabilities);

	if (capabilities.screen_info & SCREEN_INFO_MONO_VTILED) {
		rect_w = 16;
		rect_h = 8;
	} else {
		rect_w = 2;
		rect_h = 1;
	}

	h_step = rect_h;
	scale = (capabilities.x_resolution / 8) / rect_h;

	rect_w *= scale;
	rect_h *= scale;

	if (capabilities.screen_info & SCREEN_INFO_EPD) {
		grey_scale_sleep = 10000;
	} else {
		grey_scale_sleep = 100;
	}

	buf_size = rect_w * rect_h;

	if (buf_size < (capabilities.x_resolution * h_step)) {
		buf_size = capabilities.x_resolution * h_step;
	}

	switch (capabilities.current_pixel_format) {
	case PIXEL_FORMAT_ARGB_8888:
		fill_buffer_fnc = fill_buffer_argb8888;
		buf_size *= 4;
		break;
	case PIXEL_FORMAT_RGB_888:
		fill_buffer_fnc = fill_buffer_rgb888;
		buf_size *= 3;
		break;
	case PIXEL_FORMAT_RGB_565:
		fill_buffer_fnc = fill_buffer_rgb565;
		buf_size *= 2;
		break;
	case PIXEL_FORMAT_BGR_565:
		fill_buffer_fnc = fill_buffer_bgr565;
		buf_size *= 2;
		break;
	case PIXEL_FORMAT_MONO01:
	case PIXEL_FORMAT_MONO10:
		fill_buffer_fnc = fill_buffer_mono;
		buf_size /= 8;
		break;
	default:
		LOG_ERR("Unsupported pixel format. Aborting sample.");
		RETURN_FROM_MAIN(1);
	}

	buf = k_malloc(buf_size);

	if (buf == NULL) {
		LOG_ERR("Could not allocate memory. Aborting sample.");
		RETURN_FROM_MAIN(1);
	}

	(void)memset(buf, 0xFFu, buf_size);

	buf_desc.buf_size = buf_size;
	buf_desc.pitch = capabilities.x_resolution;
	buf_desc.width = capabilities.x_resolution;
	buf_desc.height = h_step;

	for (int idx = 0; idx < capabilities.y_resolution; idx += h_step) {
		display_write(display_dev, 0, idx, &buf_desc, buf);
	}

	buf_desc.pitch = rect_w;
	buf_desc.width = rect_w;
	buf_desc.height = rect_h;

	fill_buffer_fnc(TOP_LEFT, 0, buf, buf_size);
	x = 0;
	y = 0;
	display_write(display_dev, x, y, &buf_desc, buf);

	fill_buffer_fnc(TOP_RIGHT, 0, buf, buf_size);
	x = capabilities.x_resolution - rect_w;
	y = 0;
	display_write(display_dev, x, y, &buf_desc, buf);

	fill_buffer_fnc(BOTTOM_RIGHT, 0, buf, buf_size);
	x = capabilities.x_resolution - rect_w;
	y = capabilities.y_resolution - rect_h;
	display_write(display_dev, x, y, &buf_desc, buf);

	display_blanking_off(display_dev);

	grey_count = 0;
	x = 0;
	y = capabilities.y_resolution - rect_h;

	while (1) {
		fill_buffer_fnc(BOTTOM_LEFT, grey_count, buf, buf_size);
		display_write(display_dev, x, y, &buf_desc, buf);
		++grey_count;
		k_msleep(grey_scale_sleep);
#if CONFIG_TEST
		if (grey_count >= 1024) {
			break;
		}
#endif
	}
	RETURN_FROM_MAIN(0);
}

void adc_test(){
	int err;
	const struct device *dev_adc = DEVICE_DT_GET(ADC_NODE);

	LOG_INF("ADC Sample start");

	if (!device_is_ready(dev_adc)) {
		LOG_INF("ADC device not found");
		return;
	}
	int32_t adc_vref = adc_ref_internal(dev_adc);
	LOG_INF("adc_vref %d.", adc_vref);

/*
	* Configure channels individually prior to sampling
	*/
	for (uint8_t i = 0; i < ADC_NUM_CHANNELS; i++) {
		channel_cfg.channel_id = channel_ids[i];

		adc_channel_setup(dev_adc, &channel_cfg);

		sequence.channels = BIT(channel_ids[i]);	
	/*
		* Read sequence of channels (fails if not supported by MCU)
		*/
		err = adc_read(dev_adc, &sequence);
		if (err != 0) {
			LOG_ERR("ADC reading failed with error %d.", err);
			return;
		}

		int32_t raw_value = sample_buffer[0];

		if (adc_vref > 0) {
		/*
			* Convert raw reading to millivolts if driver
			* supports reading of ADC reference voltage
		*/
			int32_t vcc_value = raw_value - 2048;

			adc_raw_to_millivolts(adc_vref, ADC_GAIN_1,
				ADC_RESOLUTION, &vcc_value); // Output 1/8 Vcc
			
			if(i==0){
				vcc_value *= 8; 
				LOG_INF("vcc_adc(%d)= %d mV", raw_value, vcc_value);
			}
			else{
				LOG_INF("key_adc(%d)= %d mV", raw_value, vcc_value);
			}
		}
	}
}

void power_lock_init(void){
	const struct device *power_lock = DEVICE_DT_GET(GPIO_PWR_LOCK);
	if (!device_is_ready(power_lock)) {
		LOG_ERR("Error: power_lock device %s is not ready", power_lock->name);
		return;
	}
	LOG_INF("Get: power_lock device %s", power_lock->name);

	int ret = gpio_pin_configure(power_lock, PIN_PWR_LOCK, GPIO_OUTPUT_ACTIVE | 0);
	if (ret < 0) {
		LOG_ERR("Error: power_lock configure %d", ret);
		return;
	}
	
	ret = gpio_pin_set(power_lock, PIN_PWR_LOCK, 1);
	if (ret < 0) {
		LOG_ERR("Error: power_lock set %d", ret);
		return;
	}
	LOG_INF("Power is on:%d", ret);
}

enum PIN_FUNC{
	PWM1_FUNC,
	SWD_FUNC
};
void pin_set_func(enum PIN_FUNC func){
	const struct device *pinmuxa = DEVICE_DT_GET(PINMUXA_NODE);
	if (!device_is_ready(pinmuxa)) {
		LOG_ERR("pinmuxa device is not ready");
		return;
	}
	switch (func)
	{
	case PWM1_FUNC:
		pinmux_pin_set(pinmuxa, SWDIO_PIN_NUM, PWM1_PIN_FUNC);
		break;
	case SWD_FUNC:
		pinmux_pin_set(pinmuxa, SWDIO_PIN_NUM, SWDIO_PIN_FUNC);
		break;
	default:
		break;
	}
}



static csk_wifi_event_cb_t wifi_event_cb;

static void wifi_event_handler(csk_wifi_event_t events, void *event_data, uint32_t data_len, void *arg)
{
    if (events & CSK_WIFI_EVT_SCAN_DONE) {
        printk("scan done\n");
    } else {
        //abort();
    }
}

void csk_819s_test()
{
 	csk_wifi_init();
    wifi_event_cb.handler = &wifi_event_handler;
    wifi_event_cb.events = CSK_WIFI_EVT_SCAN_DONE;
    wifi_event_cb.arg = NULL;
    csk_wifi_add_callback(&wifi_event_cb);

    csk_wifi_result_t result;

    while (1) {
        csk_wifi_scan_info_t *ap_list;
        int count = csk_wifi_scan_ap(&ap_list, &result, K_FOREVER);
        if (count < 0) {
            continue;
        }
        printk("-----------------------------------Scan AP list------------------------------------\n");
        for (int i = 0; i < count; i++) {
            printk("|ssid: %-20s | bssid: %-18s | channel: %-3d | rssi: %-3d|\n",
                    ap_list[i].ssid, ap_list[i].bssid, ap_list[i].channel, ap_list[i].rssi);
        }
        printk("-----------------------------------------------------------------------------------\n");
        k_free(ap_list);
        ap_list = NULL;
        k_msleep(1000);
    }
    
}

void fykey_pressed(const struct device *dev, struct gpio_callback *cb,
		    uint32_t pins)
{
	printk("Button pressed at %" PRIu32 "\n", k_cycle_get_32());
}

void fykey_init(){
		int ret;

	if (!device_is_ready(fy_key.port)) {
		printk("Error: button device %s is not ready\n",
		       fy_key.port->name);
		return;
	}

	ret = gpio_pin_configure_dt(&fy_key, GPIO_INPUT);
	if (ret != 0) {
		printk("Error %d: failed to configure %s pin %d\n",
		       ret, fy_key.port->name, fy_key.pin);
		return;
	}

	ret = gpio_pin_interrupt_configure_dt(&fy_key,
					      GPIO_INT_EDGE_BOTH);
	if (ret != 0) {
		printk("Error %d: failed to configure interrupt on %s pin %d\n",
			ret, fy_key.port->name, fy_key.pin);
		return;
	}

	gpio_init_callback(&fy_key_cb_data, fykey_pressed, BIT(fy_key.pin));
	gpio_add_callback(fy_key.port, &fy_key_cb_data);
	printk("Set up button at %s pin %d\n", fy_key.port->name, fy_key.pin);
}

void main(void)
{
	int pri;
	const struct device *pwm = DEVICE_DT_GET(PWM_LED0_NODE);
	power_lock_init();
	#if 0
	pri = k_thread_priority_get(k_current_get());
	k_thread_create(&lcdtouch_task_id, lcdtouch_stack_area,
					K_THREAD_STACK_SIZEOF(lcdtouch_stack_area),
					lcd_touch_test, NULL, NULL, NULL, pri, 0, K_NO_WAIT);
	#endif
	
	pri = k_thread_priority_get(k_current_get());
	k_thread_create(&camled_task_id, camled_stack_area,
					K_THREAD_STACK_SIZEOF(camled_stack_area),
					cam_led_test, NULL, NULL, NULL, pri, 0, K_NO_WAIT);
	
	// WiFi 819s test thread

	pri = k_thread_priority_get(k_current_get());
	k_thread_create(&wifi_task_id, wifi_stack_area,
					K_THREAD_STACK_SIZEOF(wifi_stack_area),
					csk_819s_test, NULL, NULL, NULL, pri, 0, K_NO_WAIT);
	

	// PWM Init
	#if 1
	LOG_INF("下载模式,5s后变为PWM模式不可下载程序，重新下载需要上电并在5s内进行下载");
	pin_set_func(SWD_FUNC);
	k_msleep(5000);
	LOG_INF("PWM模式,需要进入swd模式请输入：swd");
	pin_set_func(PWM1_FUNC);
	int ret;
	ret = pwm_pin_set_nsec(pwm, 1, 20000,  200, 1);
	#endif
	
	// fy key init
	fykey_init();


	while(1){
		//adc_test();
		k_msleep(500);
	}
	return;
}
```
