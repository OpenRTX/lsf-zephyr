// &ls_adsp_csk6_pinctrl{
//         pinctrl_uart2_rx_default: uart2_rx_default {
// 			pinctrls = < &pinmuxb 7 3 >;
// 		};

// 		pinctrl_uart2_tx_default: uart2_tx_default {
// 			pinctrls = < &pinmuxb 6 3 >;
// 		};
// };

// &uart2 {
// 	current-speed = <921600>;
// };


&ls_adsp_csk6_pinctrl{
        pinctrl_uart0_rx_default: uart0_rx_default {
			pinctrls = < &pinmuxb 10 2 >;
		};

		pinctrl_uart0_tx_default: uart0_tx_default {
			pinctrls = < &pinmuxb 11 2 >;
		};
};

&uart0 {
	current-speed = <921600>;
	status = "disabled";
};
