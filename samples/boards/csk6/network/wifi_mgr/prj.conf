## CMakeLists.txt
```
# SPDX-License-Identifier: Apache-2.0

cmake_minimum_required(VERSION 3.20.0)

set(SUPPORT_BOARDS csk6012_c3_nano csk6011a_c3_nano)
if(NOT ${BOARD} IN_LIST SUPPORT_BOARDS)
    message("Please choose one of the following boards:")
    foreach(item ${SUPPORT_BOARDS})
        message(STATUS ${item})
    endforeach()
    message(FATAL_ERROR "\nThe project does not support the ${BOARD}")
endif()

find_package(Zephyr REQUIRED HINTS $ENV{ZEPHYR_BASE})
project(wifi_mgr)

target_sources(app PRIVATE src/main.c)
```

## Kconfig
```
# SPDX-License-Identifier: Apache-2.0

menu "Example Configuration"

    config EXAMPLE_WIFI_SSID
        string "WiFi SSID"
        default "LINGSI_2.4G"

    config EXAMPLE_WIFI_PASSWORD
        string "WiFi password"
        default "LS$123456VIP#"

endmenu

source "Kconfig.zephyr"
```

## sample.yaml
```
tests:
  sample.board.csk6.network.wifi_mgr:
    platform_allow: csk6011a_c3_nano
    tags: csk6
    timeout: 30
    harness: console
    skip: true
    harness_config:
      type: multi_line
      regex:
        - "WiFi scan done"
        - "Connected to AP successfully"
```

## prj.conf
```kconfig
CONFIG_WIFI=y
CONFIG_CSK_WIFI_STATION=y
CONFIG_WIFI_MANAGER=y
CONFIG_NET_L2_ETHERNET=y
CONFIG_REBOOT=y

CONFIG_LOG=y
CONFIG_NVS_LOG_LEVEL_DBG=y

CONFIG_NEWLIB_LIBC=y
CONFIG_NEWLIB_LIBC_NANO=n

CONFIG_NETWORKING=y
CONFIG_NET_DHCPV4=y
CONFIG_NET_IPV4=y
CONFIG_NET_SOCKETS=y
CONFIG_NET_SOCKETS_POSIX_NAMES=y

CONFIG_NET_MGMT=y
CONFIG_NET_MGMT_EVENT=y
CONFIG_NET_MGMT_EVENT_STACK_SIZE=4096

CONFIG_NET_RX_STACK_SIZE=15360
CONFIG_NET_TX_STACK_SIZE=15360
CONFIG_NET_PKT_RX_COUNT=16
CONFIG_NET_PKT_TX_COUNT=16
CONFIG_NET_BUF_RX_COUNT=64
CONFIG_NET_BUF_TX_COUNT=64
CONFIG_NET_CONTEXT_NET_PKT_POOL=y

CONFIG_HEAP_MEM_POOL_SIZE=81920
CONFIG_SYSTEM_WORKQUEUE_STACK_SIZE=5120
CONFIG_SYSTEM_WORKQUEUE_PRIORITY=-1
CONFIG_MAIN_STACK_SIZE=4096
CONFIG_INIT_STACKS=y
```

## boards/csk6002_9s_nano.overlay
```dts
&flash0 {
        /*
         * For more information, see:
         * http: //docs.zephyrproject.org/latest/guides/dts/index.html#flash-partitions
         */
        partitions {
                compatible = "fixed-partitions";
                #address-cells = <1>;
                #size-cells = <1>;

                /* wifi_nvs_storage: 20Kb */
                wifi_nvs_storage: partition@6F0000 {
                        label = "wifi_nvs_storage";
                        reg = <0x6F0000 0x10000>;
                };
        };
};
```

## src/main.c
```c
/*
 * Copyright (c) 2023 Anhui(Shenzhen) Listenai Co., Ltd.
 *
 * SPDX-License-Identifier: Apache-2.0
 */

#include "wifi_manager/wifi_manager.h"

#include <stdlib.h>

#include <net/net_context.h>
#include <net/net_core.h>
#include <net/net_if.h>
#include <net/net_mgmt.h>
#include <sys/printk.h>
#include <sys/reboot.h>

K_SEM_DEFINE(wifi_conn_sem, 0, 1);
K_SEM_DEFINE(ipv4_sem, 0, 1);

static struct net_mgmt_event_callback dhcp_cb;
static void handler_cb(struct net_mgmt_event_callback *cb, uint32_t mgmt_event,
		       struct net_if *iface)
{
	if (mgmt_event != NET_EVENT_IPV4_DHCP_BOUND) {
		return;
	}

	char buf[NET_IPV4_ADDR_LEN];

	printk("Your address: %s\n",
	       net_addr_ntop(AF_INET, &iface->config.dhcpv4.requested_ip, buf, sizeof(buf)));
	printk("Lease time: %u seconds\n", iface->config.dhcpv4.lease_time);
	printk("Subnet: %s\n",
	       net_addr_ntop(AF_INET, &iface->config.ip.ipv4->netmask, buf, sizeof(buf)));
	printk("Router: %s\n",
	       net_addr_ntop(AF_INET, &iface->config.ip.ipv4->gw, buf, sizeof(buf)));
	k_sem_give(&ipv4_sem);
}

static void connection_cb(wifi_mgr_connection_info_t *connection_info, void *arg)
{
	switch (connection_info->status) {
	case WIFI_MGR_STA_DISCONNECTED:
		break;
	case WIFI_MGR_STA_CONNECTING:
		break;
	case WIFI_MGR_STA_CONNECTED:
		printk("Connected to AP successfully\n");
		printk("ssid: %s  bssid: %s  channel: %d  rssi: %d\n",
		       connection_info->sta_info->ssid, connection_info->sta_info->bssid,
		       connection_info->sta_info->channel, connection_info->sta_info->rssi);
		k_sem_give(&wifi_conn_sem);
		break;
	default:
		break;
	}
}

static void scandone_cb(wifi_mgr_scan_info_t *aps_info, int ap_num, void *arg)
{
	printk("WiFi scan done\n");
}

void main(void)
{
	int ret = wifi_mgr_init();
	if (ret != 0) {
		printk("wifi manager init failed\n");
		abort();
	}

	wifi_mgr_add_scan_done_cb(scandone_cb, NULL);

	wifi_mgr_sta_add_connection_cb(connection_cb, NULL);

	wifi_mgr_scan_info_t *aps_info;
	int ap_num = wifi_mgr_scan_ap(&aps_info, false);
	printk("-------------------------------Scan AP list---------------------------------\n");
	for (int i = 0; i < ap_num; i++) {
		printk("|ssid: %-20s | bssid: %-18s | channel: %-3d | rssi: %-3d|\n",
		       aps_info[i].ssid, aps_info[i].bssid, aps_info[i].channel, aps_info[i].rssi);
	}
	printk("----------------------------------------------------------------------------\n");

	wifi_mgr_sta_config_t *saved_infos;
	int saved_infos_num = wifi_mgr_storage_search_ap(&saved_infos, SEARCH_ALL, NULL);
	if (saved_infos_num < 0) {
		printk("wifi search ap info failed\n");
		abort();
	}
	printk("---------------------------wifi storage info list---------------------------\n");
	for (int i = 0; i < saved_infos_num; i++) {
		printk("|ssid: %-20s | bssid: %-18s | channel: %-3d | rssi: %-3d|\n",
		       saved_infos[i].ssid, saved_infos[i].bssid, saved_infos[i].channel,
		       saved_infos[i].rssi);
	}
	printk("----------------------------------------------------------------------------\n");

	static wifi_mgr_sta_config_t sta_config = {
		.ssid = CONFIG_EXAMPLE_WIFI_SSID,
		.pwd = CONFIG_EXAMPLE_WIFI_PASSWORD,
		.encryption_mode = CSK_WIFI_AUTH_WPA2_PSK,
	};

	if (saved_infos_num > 0) {
		wifi_mgr_sta_config_t *hit_infos;
		int hit_num =
			wifi_mgr_storage_search_ap(&hit_infos, SEARCH_BY_SSID, sta_config.ssid);
		if (hit_num > 0) {
			wifi_mgr_autoconn_config_t autoconn_conf = {
				.interval_ms = 3000,
			};
			wifi_mgr_auto_connect_start(&autoconn_conf);
			printk("Found ssid in NVS storage, ssid: %s, bssid: %s, password: %s\nWiFi "
			       "auto connect start ...\n",
			       hit_infos[0].ssid, hit_infos[0].bssid, hit_infos[0].pwd);
			goto __out;
		}
	}

	printk("WiFi connecting to AP ...\n");
	ret = wifi_mgr_sta_connect(&sta_config, false);
	if (ret != 0) {
		printk("wifi station connect failed\n");
		abort();
	}

	printk("WiFi saving AP info into NVS storage\n");
	ret = wifi_mgr_storage_save_ap(&sta_config); /* Save AP info */
	if (ret != 0) {
		printk("wifi save ap info failed\n");
		abort();
	}

__out:
	k_free(aps_info);
	k_free(saved_infos);
	k_sem_take(&wifi_conn_sem, K_FOREVER); /* Wait for WiFi connected */

	net_mgmt_init_event_callback(&dhcp_cb, handler_cb, NET_EVENT_IPV4_DHCP_BOUND);
	net_mgmt_add_event_callback(&dhcp_cb);
	struct net_if *iface = net_if_get_default();
	if (!iface) {
		printk("wifi interface not available\n");
		return;
	}
	net_dhcpv4_start(iface);

	k_sem_take(&ipv4_sem, K_FOREVER);
	for (int i = 3; i >= 0; i--) {
		printk("Waiting for Reboot ...%d\n", i);
		k_msleep(1000);
	}
	sys_reboot(SYS_REBOOT_WARM);
}
```
