## CMakeLists.txt
```
# SPDX-License-Identifier: Apache-2.0

cmake_minimum_required(VERSION 3.20.0)

set(SUPPORT_BOARDS csk6012_c3_nano csk6011a_c3_nano)
if(NOT ${BOARD} IN_LIST SUPPORT_BOARDS)
    message("Please choose one of the following boards:")
    foreach(item ${SUPPORT_BOARDS})
        message(STATUS ${item})
    endforeach()
    message(FATAL_ERROR "\nThe project does not support the ${BOARD}")
endif()

find_package(Zephyr REQUIRED HINTS $ENV{ZEPHYR_BASE})
project(wifi_softap)

target_sources(app PRIVATE src/main.c)
```

## Kconfig
```
# SPDX-License-Identifier: Apache-2.0

menu "Example Configuration"

    config EXAMPLE_WIFI_SSID
        string "WiFi SSID"
        default "CSK6_SoftAP"

    config EXAMPLE_WIFI_PASSWORD
        string "WiFi password"
        default "12345678"

    config EXAMPLE_WIFI_CHANNEL
        int "WiFi channel"
        default 1

    config EXAMPLE_WIFI_MAX_CONNECTTION
        int "WiFi STA max connecttion devices"
        default 3

endmenu

source "Kconfig.zephyr"
```

## sample.yaml
```
tests:
  sample.board.csk6.network.wifi_softap:
    platform_allow: csk6011a_c3_nano
    build_only: true
    tags: csk6
```

## prj.conf
```kconfig
CONFIG_WIFI=y
CONFIG_CSK_WIFI_SOFTAP=y
CONFIG_NET_L2_ETHERNET=y

CONFIG_NEWLIB_LIBC=y

CONFIG_NETWORKING=y
CONFIG_NET_DHCPV4=y
CONFIG_NET_IPV4=y
CONFIG_NET_SOCKETS=y
CONFIG_NET_SOCKETS_POSIX_NAMES=y

CONFIG_NET_MGMT=y
CONFIG_NET_MGMT_EVENT=y
CONFIG_NET_MGMT_EVENT_STACK_SIZE=4096

CONFIG_NET_RX_STACK_SIZE=15360
CONFIG_NET_TX_STACK_SIZE=15360
CONFIG_NET_PKT_RX_COUNT=16
CONFIG_NET_PKT_TX_COUNT=16
CONFIG_NET_BUF_RX_COUNT=64
CONFIG_NET_BUF_TX_COUNT=64
CONFIG_NET_CONTEXT_NET_PKT_POOL=y

CONFIG_HEAP_MEM_POOL_SIZE=20480
CONFIG_SYSTEM_WORKQUEUE_STACK_SIZE=5120
CONFIG_SYSTEM_WORKQUEUE_PRIORITY=-1
CONFIG_MAIN_STACK_SIZE=4096
CONFIG_INIT_STACKS=y
```

## src/main.c
```c
/*
 * Copyright (c) 2023 Anhui(Shenzhen) Listenai Co., Ltd.
 *
 * SPDX-License-Identifier: Apache-2.0
 */
#include <stdlib.h>
#include <zephyr.h>
#include <sys/printk.h>

#include <net/net_if.h>
#include <net/net_core.h>
#include <net/net_context.h>
#include <net/net_mgmt.h>

#include "csk6/csk_wifi.h"

static csk_wifi_event_cb_t wifi_event_cb;

static void wifi_event_handler(csk_wifi_event_t events, void *event_data, uint32_t data_len, void *arg)
{
    if (events & CSK_WIFI_EVT_AP_STARTED) {
        printk("[WiFi softap] started\n");
    } else if (events & CSK_WIFI_EVT_AP_STOPPED) {
        printk("[WiFi softap] stopped\n");
    } else if (events & CSK_WIFI_EVT_AP_STACONNECTED) {
        printk("[WiFi softap] station joined\n");
    } else if (events & CSK_WIFI_EVT_AP_STADISCONNECTED) {
        printk("[WiFi softap] station left\n");
    }
}

void main(void)
{
    csk_wifi_init();
    wifi_event_cb.handler = &wifi_event_handler;
    wifi_event_cb.events = CSK_WIFI_EVT_AP_STARTED |
                            CSK_WIFI_EVT_AP_STOPPED |
                            CSK_WIFI_EVT_AP_STACONNECTED |
                            CSK_WIFI_EVT_AP_STADISCONNECTED;
    wifi_event_cb.arg = NULL;
    csk_wifi_add_callback(&wifi_event_cb);

    csk_wifi_softap_config_t ap_config = {
        .ssid = CONFIG_EXAMPLE_WIFI_SSID,
        .pwd = CONFIG_EXAMPLE_WIFI_PASSWORD,
        .encryption_mode = CSK_WIFI_AUTH_WPA2_PSK, /* TODO: add to menuconfig */
        .bandwidth = CSK_WIFI_BW_HT40,
        .channel = CONFIG_EXAMPLE_WIFI_CHANNEL,
        .max_connections = CONFIG_EXAMPLE_WIFI_MAX_CONNECTTION,
    };

    csk_wifi_result_t wifi_result;
    csk_wifi_ap_start(&ap_config, &wifi_result, K_FOREVER);

    if (wifi_result == CSK_WIFI_ERR_AP_FAILED) {
        abort();
    }
    printk("ssid: %s password: %s\n", ap_config.ssid, ap_config.pwd);
}
```
