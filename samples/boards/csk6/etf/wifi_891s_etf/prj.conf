## CMakeLists.txt
```
# SPDX-License-Identifier: Apache-2.0

cmake_minimum_required(VERSION 3.20.0)

find_package(Zephyr REQUIRED HINTS $ENV{ZEPHYR_BASE})
project(wifi_819s_etf)

target_sources(app PRIVATE src/main.c src/shell_etf.c src/cmd_etf.c)
```

## sample.yaml
```
tests:
  sample.board.csk6.etf.wifi_819s_etf:
    platform_allow: csk6002_9s_nano
    tags: csk6
```

## west.yml
```
manifest:
  remotes:
    - name: listenai
      url-base: https://cloud.listenai.com/zephyr
  projects:
    - name: listenai
      remote: zephyrproject-rtos
      revision: zephyr-v2.6.0
      clone-depth: 1
      import:
        name-allowlist:
          - cmsis
          - xr819s
    - name: xr819s
      remote: listenai
      revision: 3c6c58e0ea84036fe14afcc622b0e1d9e3effeee
      path: ../../../../../../modules/lib/xr819s      
  self: 
    west-commands: ../../../../../scripts/west-commands.yml
```

## prj.conf
```kconfig
CONFIG_HEAP_MEM_POOL_SIZE=80960
CONFIG_MAIN_STACK_SIZE=4096
CONFIG_TEST_RANDOM_GENERATOR=y
CONFIG_INIT_STACKS=y
CONFIG_NEWLIB_LIBC=y
CONFIG_NEWLIB_LIBC_NANO=n

CONFIG_FPU=y
CONFIG_GPIO=y
CONFIG_XR819S=y
CONFIG_ETF_819S_WIFI=y

CONFIG_SHELL_ARGC_MAX=16
CONFIG_SHELL=y
CONFIG_SHELL_STACK_SIZE=20480
# CONFIG_ETF_WORK_QUEUE_STACK_SIZE=10240

CONFIG_THREAD_ANALYZER=y
CONFIG_THREAD_ANALYZER_USE_PRINTK=y
CONFIG_THREAD_RUNTIME_STATS=y
CONFIG_THREAD_NAME=y

CONFIG_REBOOT=y

CONFIG_NEWLIB_LIBC_FLOAT_PRINTF=y

CONFIG_LOG=y
```

## src/main.c
```c
/*
 * SPDX-License-Identifier: Apache-2.0
 */

#include <stdlib.h>
#include <sys/printk.h>
#include <sys/sys_heap.h>
#include "cmd_etf.h"

#include <logging/log.h>
LOG_MODULE_REGISTER(csk_wifi_819s_etf, LOG_LEVEL_DBG);

void main(void)
{
	LOG_DBG("Hello csk_wifi_819s_etf");

	cmd_etf_init();
}
```

## src/cmd_etf.c
```c
#include "sys/util.h"
#include <stdlib.h>
#include <stddef.h>
#include <sys/printk.h>
#include <sys/sys_heap.h>
#include <kernel.h>
#include "cmd_etf.h"
#include "wifi_819s_etf.h"
#include <logging/log.h>


int cmd_etf_cli_exec(const char **argv, const size_t argc)
{
	return etf_cli_main(argv);
}


int cmd_etf_init()
{
	etf_init();
	return 0;
}
```

## src/cmd_etf.h
```c
/*
 * Copyright (C) 2017 XRADIO TECHNOLOGY CO., LTD. All rights reserved.
 *
 *  Redistribution and use in source and binary forms, with or without
 *  modification, are permitted provided that the following conditions
 *  are met:
 *    1. Redistributions of source code must retain the above copyright
 *       notice, this list of conditions and the following disclaimer.
 *    2. Redistributions in binary form must reproduce the above copyright
 *       notice, this list of conditions and the following disclaimer in the
 *       documentation and/or other materials provided with the
 *       distribution.
 *    3. Neither the name of XRADIO TECHNOLOGY CO., LTD. nor the names of
 *       its contributors may be used to endorse or promote products derived
 *       from this software without specific prior written permission.
 *
 *  THIS SOFTWARE IS PROVIDED BY THE COPYRIGHT HOLDERS AND CONTRIBUTORS
 *  "AS IS" AND ANY EXPRESS OR IMPLIED WARRANTIES, INCLUDING, BUT NOT
 *  LIMITED TO, THE IMPLIED WARRANTIES OF MERCHANTABILITY AND FITNESS FOR
 *  A PARTICULAR PURPOSE ARE DISCLAIMED. IN NO EVENT SHALL THE COPYRIGHT
 *  OWNER OR CONTRIBUTORS BE LIABLE FOR ANY DIRECT, INDIRECT, INCIDENTAL,
 *  SPECIAL, EXEMPLARY, OR CONSEQUENTIAL DAMAGES (INCLUDING, BUT NOT
 *  LIMITED TO, PROCUREMENT OF SUBSTITUTE GOODS OR SERVICES; LOSS OF USE,
 *  DATA, OR PROFITS; OR BUSINESS INTERRUPTION) HOWEVER CAUSED AND ON ANY
 *  THEORY OF LIABILITY, WHETHER IN CONTRACT, STRICT LIABILITY, OR TORT
 *  (INCLUDING NEGLIGENCE OR OTHERWISE) ARISING IN ANY WAY OUT OF THE USE
 *  OF THIS SOFTWARE, EVEN IF ADVISED OF THE POSSIBILITY OF SUCH DAMAGE.
 */

#ifndef _CMD_ETF_H_
#define _CMD_ETF_H_

#include "stddef.h"

#ifdef __cplusplus
extern "C" {
#endif

int cmd_etf_cli_exec(const char **argv, const size_t argc);

int cmd_etf_init();

#ifdef __cplusplus
}
#endif

#endif /* _CMD_ETF_H_ */
```

## src/shell_etf.c
```c
/*
 *
 *
 * SPDX-License-Identifier: Apache-2.0
 */
#include <sys/reboot.h>
#include "sys/sys_heap.h"
#include <stdbool.h>
#if (CONFIG_SHELL)

#include <stdlib.h>
#include <string.h>

#include <zephyr.h>
#include <sys/printk.h>
#include <logging/log.h>
#include <shell/shell.h>
#include <fs/fs.h>
#include <device.h>
#include <soc.h>
#include <stdlib.h>

#include "cmd_etf.h"
// #include "thread_analyzer.h"

LOG_MODULE_REGISTER(csk_wifi_819s_shell_etf, LOG_LEVEL_DBG);

#define SHELL_ETF_ROOT_CMD_MIN_ARGC 2

#if (CONFIG_SHELL_ARGC_MAX > 4)
#define ARGC_MAX (CONFIG_SHELL_ARGC_MAX - 4)
#else
#error Please increase CONFIG_SHELL_ARGC_MAX parameter.
#endif

extern void thread_analyzer_print(void);
extern struct heap_t _system_heap;


static int cmd_usage(const struct shell *shell, size_t argc, char **argv)
{
	thread_analyzer_print();
	sys_heap_print_info((struct sys_heap *)&_system_heap, false);
	return 0;
}

static int cmd_etf_disconnect(const struct shell *shell, size_t argc, char **argv)
{
	LOG_DBG("cmd_etf_disconnect, argc: %d", argc);
	LOG_DBG("Use reboot instead of disconnect for now");
	sys_reboot(SYS_REBOOT_WARM);
	return 0;
}

static int cmd_etf(const struct shell *shell, size_t argc, char **argv)
{
	LOG_DBG("cmd_etf, argc: %d", argc);

	size_t argc_without_prefix_cmd = argc - 1;
	char **argv_without_prefix_cmd = argv + 1;

	return cmd_etf_cli_exec((const char **)(argv_without_prefix_cmd), argc_without_prefix_cmd);
}

SHELL_STATIC_SUBCMD_SET_CREATE(sub_etf,
                                /* Alphabetically sorted to ensure correct Tab autocompletion. */
                                /*SHELL_CMD_ARG(syntax, subcmd, help, handler, mand, opt)*/
			       SHELL_CMD_ARG(disconnect,          NULL,        "disconnect for etf",      &cmd_etf_disconnect,  0, 0),

			       SHELL_SUBCMD_SET_END /* Array terminated. */
			       );


SHELL_CMD_REGISTER(etf, &sub_etf, "etf related commands.", &cmd_etf);
SHELL_CMD_REGISTER(usage, NULL, "stack usage and heap usage.", &cmd_usage);
#endif
```

## src/wifi_819s_etf.h
```c
#ifndef __WIFI_819S_ETF_H__
#define __WIFI_819S_ETF_H__

#ifdef __cplusplus
extern "C" {
#endif

extern void etf_init(void);

extern int etf_cli_main(const char **argv);

#ifdef __cplusplus
}
#endif

#endif // __WIFI_819S_ETF_H__
```
